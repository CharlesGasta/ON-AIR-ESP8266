/*
  ============================================================
   CARAC ON AIR MANUAL - V1.0
   ESP8266 - MANUEL / AP AUTONOME + WIFI EXTERNE OPTIONNEL
  ============================================================

  - Wi-Fi externe optionnel pour utilisation avec Internet
  - Aucun TriCaster
  - L'ESP cree son propre reseau Wi-Fi
  - Interface mobile principale avec 4 macros
  - 2 boutons par macro : DIRECT / ALERTE
  - Couleur + intensite 0..100 % par macro
  - Alerte clignotante avec duree et vitesse configurables
  - Nom + logo PNG/JPG personnalisables par macro
  - Page controle : http://192.168.4.1/
  - Page parametres : http://192.168.4.1/settings
  - Bouton BLACKOUT
  - Animation de demarrage optionnelle

  CABLAGE RGB ANALOGIQUE 5 V VIA MOSFETS N :
  D2 / GPIO4  -> ROUGE
  D1 / GPIO5  -> VERT
  D5 / GPIO14 -> BLEU
*/

#include <Arduino.h>
#include <math.h>
#include <ESP8266WiFi.h>
#include <ESP8266WebServer.h>
#include <DNSServer.h>
#include <EEPROM.h>
#include <LittleFS.h>
#include <ESP8266mDNS.h>
#include <Updater.h>
#include <Adafruit_NeoPixel.h>

#define FIRMWARE_VERSION "3.5.0 STUDIO 36LED 100PCT"

// ============================================================
// RUBAN ADRESSABLE WS2812E - LOGO DAMIEN
// Nombre reel confirme sur le montage : 36 LED au total.
// LED 0..35 : ordre physique de DIN vers DOUT autour du contour.
// Disposition vue de face confirmee par utilisateur :
// 0..11 bas droite->gauche ; 12..16 gauche bas->haut ;
// 17..30 haut gauche->droite ; 31..35 droite haut->bas.
// ============================================================
const uint8_t LED_DATA_PIN = D5;       // GPIO14
const uint16_t LED_COUNT = 36;

Adafruit_NeoPixel pixels(
  LED_COUNT,
  LED_DATA_PIN,
  NEO_GRB + NEO_KHZ800
);

const char* DEFAULT_AP_SSID = "ON_AIR-MOC";
const char* DEFAULT_AP_PASSWORD = "12345678";

IPAddress AP_IP(192,168,4,1);
IPAddress AP_GW(192,168,4,1);
IPAddress AP_MASK(255,255,255,0);

// ============================================================
// LOGOS INTEGRES EN FLASH - V1.3
// ============================================================

const uint8_t LOGO_ONE_FM[] PROGMEM = {
  0xFF, 0xD8, 0xFF, 0xE0, 0x00, 0x10, 0x4A, 0x46, 0x49, 0x46, 0x00, 0x01, 0x01, 0x00, 0x00, 0x01,
  0x00, 0x01, 0x00, 0x00, 0xFF, 0xDB, 0x00, 0x43, 0x00, 0x06, 0x04, 0x04, 0x05, 0x04, 0x04, 0x06,
  0x05, 0x05, 0x05, 0x06, 0x06, 0x06, 0x07, 0x09, 0x0E, 0x09, 0x09, 0x08, 0x08, 0x09, 0x12, 0x0D,
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  0x00, 0x00, 0x00, 0x00, 0x00, 0x00, 0x00, 0x00, 0x00, 0x00, 0x00, 0x00, 0x00, 0x00, 0x07, 0xFF,
  0xD9
};
const size_t LOGO_ONE_FM_LEN = sizeof(LOGO_ONE_FM);

const uint8_t LOGO_RADIO_LAC[] PROGMEM = {
  0xFF, 0xD8, 0xFF, 0xE0, 0x00, 0x10, 0x4A, 0x46, 0x49, 0x46, 0x00, 0x01, 0x01, 0x00, 0x00, 0x01,
  0x00, 0x01, 0x00, 0x00, 0xFF, 0xDB, 0x00, 0x43, 0x00, 0x06, 0x04, 0x04, 0x05, 0x04, 0x04, 0x06,
  0x05, 0x05, 0x05, 0x06, 0x06, 0x06, 0x07, 0x09, 0x0E, 0x09, 0x09, 0x08, 0x08, 0x09, 0x12, 0x0D,
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  0x01, 0x11, 0x10, 0x04, 0x44, 0x40, 0x7F, 0xFF, 0xD9
};
const size_t LOGO_RADIO_LAC_LEN = sizeof(LOGO_RADIO_LAC);

const uint8_t LOGO_LFM[] PROGMEM = {
  0xFF, 0xD8, 0xFF, 0xE0, 0x00, 0x10, 0x4A, 0x46, 0x49, 0x46, 0x00, 0x01, 0x01, 0x00, 0x00, 0x01,
  0x00, 0x01, 0x00, 0x00, 0xFF, 0xDB, 0x00, 0x43, 0x00, 0x06, 0x04, 0x04, 0x05, 0x04, 0x04, 0x06,
  0x05, 0x05, 0x05, 0x06, 0x06, 0x06, 0x07, 0x09, 0x0E, 0x09, 0x09, 0x08, 0x08, 0x09, 0x12, 0x0D,
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  0x60, 0x34, 0x58, 0xEE, 0x31, 0x00, 0x2D, 0x16, 0x4A, 0xE3, 0x22, 0x05, 0x34, 0x59, 0xFF, 0xD9
};
const size_t LOGO_LFM_LEN = sizeof(LOGO_LFM);

const uint8_t LOGO_ROUGE[] PROGMEM = {
  0xFF, 0xD8, 0xFF, 0xE0, 0x00, 0x10, 0x4A, 0x46, 0x49, 0x46, 0x00, 0x01, 0x01, 0x00, 0x00, 0x01,
  0x00, 0x01, 0x00, 0x00, 0xFF, 0xDB, 0x00, 0x43, 0x00, 0x06, 0x04, 0x04, 0x05, 0x04, 0x04, 0x06,
  0x05, 0x05, 0x05, 0x06, 0x06, 0x06, 0x07, 0x09, 0x0E, 0x09, 0x09, 0x08, 0x08, 0x09, 0x12, 0x0D,
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  0x46, 0x52, 0x50, 0x07, 0xFF, 0xD9
};
const size_t LOGO_ROUGE_LEN = sizeof(LOGO_ROUGE);


const uint32_t CONFIG_MAGIC = 0xCA0A2011;
const uint32_t LEGACY_CONFIG_MAGIC_V25 = 0xCA0A2010;
const uint32_t LEGACY_CONFIG_MAGIC_V19 = 0xCA0A2009;
const uint32_t LEGACY_CONFIG_MAGIC_V18 = 0xCA0A2005;
const uint32_t LEGACY_CONFIG_MAGIC_V14 = 0xCA0A2003;
const uint32_t LEGACY_CONFIG_MAGIC_V12 = 0xCA0A2002;
const uint32_t LEGACY_CONFIG_MAGIC_V11 = 0xCA0A2001;
const size_t EEPROM_SIZE = 2048;
const uint8_t MACRO_COUNT = 4;
const uint8_t MAX_KNOWN_WIFI = 5;

const char* MDNS_HOSTNAME = "onair-moc";

// Format des macros utilise jusqu'a la V1.9.
struct MacroConfigV19 {
  char name[25];
  uint8_t r;
  uint8_t g;
  uint8_t b;
  uint8_t intensity;
  uint8_t alertDuration;
  uint16_t blinkMs;
  bool alertEndOn;
  char logoPath[32];
};

// Format exact des macros V2.0 -> V2.5.
struct MacroConfigV25 {
  char name[25];

  uint8_t r;
  uint8_t g;
  uint8_t b;
  uint8_t intensity;

  bool idleOff;
  uint8_t idleR;
  uint8_t idleG;
  uint8_t idleB;
  uint8_t idleIntensity;

  uint8_t alertDuration;
  uint16_t blinkMs;
  bool alertEndOn;

  char logoPath[32];
};

enum AlertAnimation : uint8_t {
  ALERT_CLASSIC = 0,
  ALERT_FADE_TO_BLACK = 1,
  ALERT_TRAFFIC_GRADIENT = 2,
  ALERT_ACCELERATING = 3,
  ALERT_DOUBLE_FLASH = 4,
  ALERT_LOGO_CHASE = 5,
  ALERT_LOGO_DRAW = 6,
  ALERT_SWEEP_LR = 7,
  ALERT_SWEEP_RL = 8,
  ALERT_BREATHE = 9,
  ALERT_IRIS = 10,
  ALERT_RAINBOW = 11,
  ALERT_SWEEP_TB = 12,
  ALERT_SWEEP_BT = 13,
  ALERT_CUSTOM = 14
};

// V2.6 : choix d'animation d'alerte par macro.
struct MacroConfig {
  char name[25];

  uint8_t r;
  uint8_t g;
  uint8_t b;
  uint8_t intensity;

  bool idleOff;
  uint8_t idleR;
  uint8_t idleG;
  uint8_t idleB;
  uint8_t idleIntensity;

  uint8_t alertAnimation;
  uint8_t alertDuration;
  uint16_t blinkMs;
  bool alertEndOn;

  char logoPath[32];
};

struct KnownWiFi {
  char ssid[33];
  char password[65];
};

struct ConfigV11 {
  uint32_t magic;
  char apSSID[33];
  char apPassword[65];
  char deviceName[33];
  bool startupAnimation;
  MacroConfigV19 macro[MACRO_COUNT];
};

// Format EEPROM utilise jusqu'a la V1.8.
struct ConfigSingleWiFi {
  uint32_t magic;

  char apSSID[33];
  char apPassword[65];
  char deviceName[33];
  bool startupAnimation;

  bool externalWiFiEnabled;
  char externalSSID[33];
  char externalPassword[65];

  MacroConfigV19 macro[MACRO_COUNT];
};

// Format EEPROM exact de la V1.9.
struct ConfigV19 {
  uint32_t magic;

  char apSSID[33];
  char apPassword[65];
  char deviceName[33];
  bool startupAnimation;

  bool externalWiFiEnabled;
  uint8_t knownWiFiCount;
  KnownWiFi knownWiFi[MAX_KNOWN_WIFI];

  MacroConfigV19 macro[MACRO_COUNT];
};

// Format EEPROM exact V2.0 -> V2.5.
struct ConfigV25 {
  uint32_t magic;

  char apSSID[33];
  char apPassword[65];
  char deviceName[33];
  bool startupAnimation;

  bool externalWiFiEnabled;
  uint8_t knownWiFiCount;
  KnownWiFi knownWiFi[MAX_KNOWN_WIFI];

  MacroConfigV25 macro[MACRO_COUNT];
};

struct Config {
  uint32_t magic;

  char apSSID[33];
  char apPassword[65];
  char deviceName[33];
  bool startupAnimation;

  bool externalWiFiEnabled;
  uint8_t knownWiFiCount;
  KnownWiFi knownWiFi[MAX_KNOWN_WIFI];

  MacroConfig macro[MACRO_COUNT];
};

Config config;

// Extension independante : le format EEPROM historique reste strictement intact.
struct MotionSettings {
  uint32_t magic;
  uint8_t mode[MACRO_COUNT];
  uint16_t cycleMs[MACRO_COUNT];
  uint32_t checksum;
};
const uint32_t MOTION_MAGIC = 0x4D4F5431UL;
MotionSettings motionSettings;
uint32_t motionSavedChecksum = 0;
unsigned long directMotionStartedAt = 0;
unsigned long liveMotionLastFrameAt = 0;
int previewMotionMacro = -1;
bool previewMotionDirect = false;


struct BackupHeader {
  uint32_t signature;
  uint32_t configMagic;
  uint16_t configSize;
  uint16_t backupVersion;
  uint32_t checksum;
};

const uint32_t BACKUP_SIGNATURE = 0x4F414952UL;
const uint16_t BACKUP_VERSION = 2;

uint8_t configImportBuffer[sizeof(BackupHeader) + sizeof(Config) + sizeof(MotionSettings)];
size_t configImportReceived = 0;
bool configImportAccepted = false;
bool configImportApplied = false;

ESP8266WebServer server(80);
DNSServer dnsServer;
File uploadFile;

int activeMacro = -1;
bool outputEnabled = false;
bool alertRunning = false;
int alertMacro = -1;
unsigned long alertStartedAt = 0;
unsigned long alertLastToggleAt = 0;
bool alertVisible = false;
bool alertTestMode = false;
unsigned long alertAnimLastFrameAt = 0;

uint8_t currentLedR = 0;
uint8_t currentLedG = 0;
uint8_t currentLedB = 0;
uint8_t currentLedIntensity = 0;

// Apercu temps reel depuis la page Parametres.
// L'apercu revient automatiquement a l'etat reel apres une courte pause.
bool settingsPreviewActive = false;
unsigned long settingsPreviewUntil = 0;
const unsigned long SETTINGS_PREVIEW_HOLD_MS = 1800UL;

int uploadTargetMacro = -1;
String uploadTargetPath = "";
bool uploadAccepted = false;

bool mdnsStarted = false;
bool externalConnectStarted = false;

// Indicateur visuel de demarrage.
// BLEU   : point d'acces / serveur local en initialisation
// ORANGE : recherche / connexion au Wi-Fi externe
// VIOLET : enregistrement mDNS (.local)
// VERT   : pret, puis extinction automatique
// ROUGE  : erreur critique du point d'acces
enum StartupIndicatorState : uint8_t {
  STARTUP_IND_OFF = 0,
  STARTUP_IND_AP,
  STARTUP_IND_WIFI,
  STARTUP_IND_MDNS,
  STARTUP_IND_READY,
  STARTUP_IND_ERROR,
  STARTUP_IND_INTRO,
  STARTUP_IND_FALLBACK
};

StartupIndicatorState startupIndicatorState = STARTUP_IND_OFF;
bool startupIndicatorVisible = false;
bool startupSequenceComplete = false;
unsigned long startupIndicatorLastToggle = 0;
unsigned long startupReadyStartedAt = 0;
unsigned long startupStateStartedAt = 0;
unsigned long startupSessionStartedAt = 0;
bool startupAPFailed = false;
bool startupTestActive = false;
int startupRestoreMacro = -1;

unsigned long lastExternalReconnectAt = 0;
const unsigned long EXTERNAL_RECONNECT_MS = 30000UL;
int currentKnownWiFiAttempt = -1;

// Applique un changement de Wi-Fi externe APRES avoir repondu au navigateur.
// Evite tout reboot et evite de couper la requete HTTP en cours.
bool pendingExternalWiFiApply = false;
unsigned long pendingExternalWiFiApplyAt = 0;
const unsigned long EXTERNAL_APPLY_DELAY_MS = 700UL;


// Scan Wi-Fi non bloquant.
// Important : un scan ESP8266 fait balayer les canaux 2.4 GHz.
// On lance donc le scan APRES avoir repondu au navigateur, puis
// l'interface recupere les resultats quand le scan est termine.
struct WiFiScanItem {
  char ssid[33];
  int32_t rssi;
  uint8_t channel;
  bool secure;
  bool saved;
};

const uint8_t WIFI_SCAN_MAX_RESULTS = 20;
WiFiScanItem wifiScanItems[WIFI_SCAN_MAX_RESULTS];
uint8_t wifiScanItemCount = 0;

bool wifiScanStartRequested = false;
bool wifiScanRunning = false;
bool wifiScanReady = false;
bool wifiScanFailed = false;

String htmlEscape(const String& s) {
  String o;
  o.reserve(s.length() + 16);
  for (size_t i = 0; i < s.length(); i++) {
    char c = s[i];
    if (c == '&') o += "&amp;";
    else if (c == '<') o += "&lt;";
    else if (c == '>') o += "&gt;";
    else if (c == '"') o += "&quot;";
    else if (c == '\'') o += "&#39;";
    else o += c;
  }
  return o;
}

String jsonEscape(const String& s) {
  String o;
  o.reserve(s.length() + 8);
  for (size_t i = 0; i < s.length(); i++) {
    char c = s[i];
    if (c == '"' || c == '\\') { o += '\\'; o += c; }
    else if (c == '\n') o += "\\n";
    else if (c == '\r') o += "\\r";
    else o += c;
  }
  return o;
}

String rgbToHex(uint8_t r, uint8_t g, uint8_t b) {
  char buf[8];
  snprintf(buf, sizeof(buf), "#%02X%02X%02X", r, g, b);
  return String(buf);
}

bool parseHexColor(String s, uint8_t& r, uint8_t& g, uint8_t& b) {
  s.trim();
  if (s.startsWith("#")) s.remove(0,1);
  if (s.length() != 6) return false;
  char buf[7];
  s.toCharArray(buf, sizeof(buf));
  char* endptr = nullptr;
  long v = strtol(buf, &endptr, 16);
  if (endptr == nullptr || *endptr != '\0') return false;
  r = (v >> 16) & 0xFF;
  g = (v >> 8) & 0xFF;
  b = v & 0xFF;
  return true;
}

bool validImageExtension(String filename) {
  filename.toLowerCase();
  return filename.endsWith(".png") || filename.endsWith(".jpg") || filename.endsWith(".jpeg");
}

String logoPathFor(uint8_t i, String filename) {
  filename.toLowerCase();
  String ext = filename.endsWith(".png") ? ".png" : ".jpg";
  return "/m" + String(i + 1) + ext;
}

const char* builtinLogoPath(uint8_t i) {
  switch (i) {
    case 0: return "builtin:onefm";
    case 1: return "builtin:radiolac";
    case 2: return "builtin:lfm";
    case 3: return "builtin:rouge";
    default: return "";
  }
}

bool isBuiltinLogo(const String& path) {
  return path.startsWith("builtin:");
}

bool logoAvailable(uint8_t i) {
  if (i >= MACRO_COUNT) return false;

  String path = config.macro[i].logoPath;

  if (isBuiltinLogo(path)) return true;
  return path.length() && LittleFS.exists(path);
}

void setBuiltinLogo(uint8_t i) {
  if (i >= MACRO_COUNT) return;
  strlcpy(
    config.macro[i].logoPath,
    builtinLogoPath(i),
    sizeof(config.macro[i].logoPath)
  );
}

void setPreloadedMacroDefaults() {
  // Macro 1 - ONE FM
  setMacroDefaults(0, "ONE FM", 221, 2, 12);
  config.macro[0].intensity = 60;
  setBuiltinLogo(0);

  // Macro 2 - RADIO LAC
  setMacroDefaults(1, "RADIO LAC", 74, 189, 198);
  config.macro[1].intensity = 60;
  setBuiltinLogo(1);

  // Macro 3 - LFM
  setMacroDefaults(2, "LFM", 165, 42, 182);
  config.macro[2].intensity = 60;
  setBuiltinLogo(2);

  // Macro 4 - ROUGE
  setMacroDefaults(3, "ROUGE", 235, 88, 96);
  config.macro[3].intensity = 60;
  setBuiltinLogo(3);
}

int findKnownWiFi(const String& ssid) {
  for (uint8_t i = 0; i < config.knownWiFiCount && i < MAX_KNOWN_WIFI; i++) {
    if (ssid == String(config.knownWiFi[i].ssid)) return i;
  }
  return -1;
}

bool isKnownWiFi(const String& ssid) {
  return findKnownWiFi(ssid) >= 0;
}

void rememberWiFi(const String& ssid, const String& password) {
  if (!ssid.length()) return;

  int existing = findKnownWiFi(ssid);
  KnownWiFi entry;
  memset(&entry, 0, sizeof(entry));

  if (existing >= 0) {
    entry = config.knownWiFi[existing];

    // Mot de passe vide = conserver celui deja memorise.
    if (password.length() > 0) {
      password.toCharArray(entry.password, sizeof(entry.password));
    }

    // Le reseau utilise le plus recemment repasse en tete.
    for (int i = existing; i > 0; i--) {
      config.knownWiFi[i] = config.knownWiFi[i - 1];
    }
    config.knownWiFi[0] = entry;
  } else {
    strlcpy(entry.ssid, ssid.c_str(), sizeof(entry.ssid));
    password.toCharArray(entry.password, sizeof(entry.password));

    int last = min((int)config.knownWiFiCount, (int)MAX_KNOWN_WIFI - 1);

    for (int i = last; i > 0; i--) {
      config.knownWiFi[i] = config.knownWiFi[i - 1];
    }

    config.knownWiFi[0] = entry;

    if (config.knownWiFiCount < MAX_KNOWN_WIFI) {
      config.knownWiFiCount++;
    }
  }

  Serial.println("[WIFI MEM] Memorise : " + ssid);
}

void forgetKnownWiFi(uint8_t index) {
  if (index >= config.knownWiFiCount || index >= MAX_KNOWN_WIFI) return;

  String removed = config.knownWiFi[index].ssid;

  for (uint8_t i = index; i + 1 < config.knownWiFiCount; i++) {
    config.knownWiFi[i] = config.knownWiFi[i + 1];
  }

  if (config.knownWiFiCount > 0) {
    config.knownWiFiCount--;
  }

  memset(&config.knownWiFi[config.knownWiFiCount], 0, sizeof(KnownWiFi));

  Serial.println("[WIFI MEM] Oublie : " + removed);
}

void setMacroDefaults(uint8_t i, const char* name, uint8_t r, uint8_t g, uint8_t b) {
  strlcpy(config.macro[i].name, name, sizeof(config.macro[i].name));
  config.macro[i].r = r;
  config.macro[i].g = g;
  config.macro[i].b = b;
  config.macro[i].intensity = 60;

  // Par defaut le panneau est eteint hors direct.
  // Si Damien desactive "Eteint hors direct", la couleur proposee
  // est la meme que celle du DIRECT mais a 20 %.
  config.macro[i].idleOff = true;
  config.macro[i].idleR = r;
  config.macro[i].idleG = g;
  config.macro[i].idleB = b;
  config.macro[i].idleIntensity = 20;

  config.macro[i].alertAnimation = ALERT_CLASSIC;
  config.macro[i].alertDuration = 5;
  config.macro[i].blinkMs = 400;
  config.macro[i].alertEndOn = true;
  config.macro[i].logoPath[0] = '\0';
}

void setDefaults() {
  memset(&config, 0, sizeof(config));
  config.magic = CONFIG_MAGIC;
  strlcpy(config.apSSID, DEFAULT_AP_SSID, sizeof(config.apSSID));
  strlcpy(config.apPassword, DEFAULT_AP_PASSWORD, sizeof(config.apPassword));
  strlcpy(config.deviceName, "ON_AIR-MOC", sizeof(config.deviceName));
  config.startupAnimation = true;

  config.externalWiFiEnabled = false;
  config.knownWiFiCount = 0;
  memset(config.knownWiFi, 0, sizeof(config.knownWiFi));

  setPreloadedMacroDefaults();
}

void saveConfig() {
  config.magic = CONFIG_MAGIC;
  EEPROM.put(0, config);
  EEPROM.commit();
  Serial.println(F("[CONFIG] Sauvegardee"));
}

void copyLegacyMacroToV2(const MacroConfigV19& oldM, MacroConfig& newM) {
  memset(&newM, 0, sizeof(newM));

  strlcpy(newM.name, oldM.name, sizeof(newM.name));

  newM.r = oldM.r;
  newM.g = oldM.g;
  newM.b = oldM.b;
  newM.intensity = constrain(oldM.intensity, 0, 100);

  // Migration : le comportement precedent etait eteint hors direct.
  newM.idleOff = true;
  newM.idleR = oldM.r;
  newM.idleG = oldM.g;
  newM.idleB = oldM.b;
  newM.idleIntensity = 20;

  newM.alertAnimation = ALERT_CLASSIC;
  newM.alertDuration = constrain(oldM.alertDuration, 1, 60);
  newM.blinkMs = constrain(oldM.blinkMs, 100, 2000);
  newM.alertEndOn = true;

  strlcpy(newM.logoPath, oldM.logoPath, sizeof(newM.logoPath));
}

void copyV25MacroToV26(const MacroConfigV25& oldM, MacroConfig& newM) {
  memset(&newM, 0, sizeof(newM));

  strlcpy(newM.name, oldM.name, sizeof(newM.name));

  newM.r = oldM.r;
  newM.g = oldM.g;
  newM.b = oldM.b;
  newM.intensity = constrain(oldM.intensity, 0, 100);

  newM.idleOff = oldM.idleOff;
  newM.idleR = oldM.idleR;
  newM.idleG = oldM.idleG;
  newM.idleB = oldM.idleB;
  newM.idleIntensity = constrain(oldM.idleIntensity, 0, 100);

  newM.alertAnimation = ALERT_CLASSIC;
  newM.alertDuration = constrain(oldM.alertDuration, 1, 60);
  newM.blinkMs = constrain(oldM.blinkMs, 100, 2000);
  newM.alertEndOn = true;

  strlcpy(newM.logoPath, oldM.logoPath, sizeof(newM.logoPath));
}


void resetMotionSettings() {
  memset(&motionSettings,0,sizeof(motionSettings));
  motionSettings.magic=MOTION_MAGIC;
  for(uint8_t i=0;i<MACRO_COUNT;i++)motionSettings.cycleMs[i]=4000;
  motionSavedChecksum=0;
}
bool validMotionSettings(const MotionSettings& data) {
  if(data.magic!=MOTION_MAGIC)return false;
  if(configChecksum(reinterpret_cast<const uint8_t*>(&data),sizeof(data)-sizeof(data.checksum))!=data.checksum)return false;
  for(uint8_t i=0;i<MACRO_COUNT;i++)if((data.mode[i]>10&&!isLibraryId(data.mode[i]))||data.cycleMs[i]<1000||data.cycleMs[i]>12000)return false;
  return true;
}
bool saveMotionSettings() {
  motionSettings.checksum=configChecksum(reinterpret_cast<const uint8_t*>(&motionSettings),sizeof(motionSettings)-sizeof(motionSettings.checksum));
  if(motionSettings.checksum==motionSavedChecksum)return true;
  File f=LittleFS.open("/motion.tmp","w");
  if(!f)return false;
  size_t written=f.write(reinterpret_cast<const uint8_t*>(&motionSettings),sizeof(motionSettings));
  f.flush();f.close();
  if(written!=sizeof(motionSettings)||!LittleFS.rename("/motion.tmp","/motion.cfg"))return false;
  motionSavedChecksum=motionSettings.checksum;
  return true;
}
void loadMotionSettings() {
  resetMotionSettings();
  File f=LittleFS.open("/motion.cfg","r");
  if(!f)return;
  MotionSettings loaded;
  bool ok=f.size()==sizeof(loaded)&&f.read(reinterpret_cast<uint8_t*>(&loaded),sizeof(loaded))==sizeof(loaded);
  f.close();
  if(ok&&validMotionSettings(loaded)){motionSettings=loaded;motionSavedChecksum=loaded.checksum;}
}
void readMotionRequest(uint8_t i) {
  if(server.hasArg("directMotion")){int mode=server.arg("directMotion").toInt();motionSettings.mode[i]=(mode>=0&&mode<=10)||isLibraryId(mode)?mode:0;}
  if(server.hasArg("motionCycle"))motionSettings.cycleMs[i]=constrain(server.arg("motionCycle").toInt(),1000,12000);
}

void loadConfig() {
  EEPROM.begin(EEPROM_SIZE);

  uint32_t magic = 0;
  EEPROM.get(0, magic);

  if (magic == CONFIG_MAGIC) {
    EEPROM.get(0, config);
  }
  else if (magic == LEGACY_CONFIG_MAGIC_V25) {
    ConfigV25 oldConfig;
    EEPROM.get(0, oldConfig);

    setDefaults();

    strlcpy(config.apSSID, oldConfig.apSSID, sizeof(config.apSSID));
    strlcpy(config.apPassword, oldConfig.apPassword, sizeof(config.apPassword));
    strlcpy(config.deviceName, oldConfig.deviceName, sizeof(config.deviceName));
    config.startupAnimation = oldConfig.startupAnimation;

    config.externalWiFiEnabled = oldConfig.externalWiFiEnabled;
    config.knownWiFiCount = min(oldConfig.knownWiFiCount, MAX_KNOWN_WIFI);

    for (uint8_t i = 0; i < MAX_KNOWN_WIFI; i++) {
      config.knownWiFi[i] = oldConfig.knownWiFi[i];
    }

    for (uint8_t i = 0; i < MACRO_COUNT; i++) {
      copyV25MacroToV26(oldConfig.macro[i], config.macro[i]);
    }

    config.magic = CONFIG_MAGIC;
    saveConfig();

    Serial.println(F("[CONFIG] Migration V2.5 -> V2.6 effectuee"));
  }
  else if (magic == LEGACY_CONFIG_MAGIC_V19) {
    ConfigV19 oldConfig;
    EEPROM.get(0, oldConfig);

    setDefaults();

    strlcpy(config.apSSID, oldConfig.apSSID, sizeof(config.apSSID));
    strlcpy(config.apPassword, oldConfig.apPassword, sizeof(config.apPassword));
    strlcpy(config.deviceName, oldConfig.deviceName, sizeof(config.deviceName));
    config.startupAnimation = oldConfig.startupAnimation;

    config.externalWiFiEnabled = oldConfig.externalWiFiEnabled;
    config.knownWiFiCount = min(oldConfig.knownWiFiCount, MAX_KNOWN_WIFI);

    for (uint8_t i = 0; i < MAX_KNOWN_WIFI; i++) {
      config.knownWiFi[i] = oldConfig.knownWiFi[i];
    }

    for (uint8_t i = 0; i < MACRO_COUNT; i++) {
      copyLegacyMacroToV2(oldConfig.macro[i], config.macro[i]);
    }

    config.magic = CONFIG_MAGIC;
    saveConfig();

    Serial.println(F("[CONFIG] Migration V1.9 -> V2.0 effectuee"));
  }
  else if (magic == LEGACY_CONFIG_MAGIC_V18 ||
           magic == LEGACY_CONFIG_MAGIC_V14 ||
           magic == LEGACY_CONFIG_MAGIC_V12) {

    ConfigSingleWiFi oldConfig;
    EEPROM.get(0, oldConfig);

    setDefaults();

    strlcpy(config.apSSID, oldConfig.apSSID, sizeof(config.apSSID));
    strlcpy(config.apPassword, oldConfig.apPassword, sizeof(config.apPassword));
    strlcpy(config.deviceName, oldConfig.deviceName, sizeof(config.deviceName));
    config.startupAnimation = oldConfig.startupAnimation;

    config.externalWiFiEnabled = oldConfig.externalWiFiEnabled;

    for (uint8_t i = 0; i < MACRO_COUNT; i++) {
      copyLegacyMacroToV2(oldConfig.macro[i], config.macro[i]);
    }

    if (strlen(oldConfig.externalSSID) > 0) {
      rememberWiFi(
        String(oldConfig.externalSSID),
        String(oldConfig.externalPassword)
      );
    }

    config.magic = CONFIG_MAGIC;
    saveConfig();

    Serial.println(F("[CONFIG] Migration ancienne version -> V2.0 effectuee"));
  }
  else if (magic == LEGACY_CONFIG_MAGIC_V11) {
    ConfigV11 oldConfig;
    EEPROM.get(0, oldConfig);

    setDefaults();

    strlcpy(config.apSSID, oldConfig.apSSID, sizeof(config.apSSID));
    strlcpy(config.apPassword, oldConfig.apPassword, sizeof(config.apPassword));
    strlcpy(config.deviceName, oldConfig.deviceName, sizeof(config.deviceName));
    config.startupAnimation = oldConfig.startupAnimation;

    for (uint8_t i = 0; i < MACRO_COUNT; i++) {
      copyLegacyMacroToV2(oldConfig.macro[i], config.macro[i]);
    }

    config.magic = CONFIG_MAGIC;
    saveConfig();

    Serial.println(F("[CONFIG] Migration V1.1 -> V2.0 effectuee"));
  }
  else {
    setDefaults();
    saveConfig();
  }

  config.apSSID[sizeof(config.apSSID)-1] = '\0';
  config.apPassword[sizeof(config.apPassword)-1] = '\0';
  config.deviceName[sizeof(config.deviceName)-1] = '\0';

  config.knownWiFiCount = min(config.knownWiFiCount, MAX_KNOWN_WIFI);

  for (uint8_t i = 0; i < MAX_KNOWN_WIFI; i++) {
    config.knownWiFi[i].ssid[sizeof(config.knownWiFi[i].ssid)-1] = '\0';
    config.knownWiFi[i].password[sizeof(config.knownWiFi[i].password)-1] = '\0';
  }

  for (uint8_t i = 0; i < MACRO_COUNT; i++) {
    config.macro[i].name[sizeof(config.macro[i].name)-1] = '\0';
    config.macro[i].logoPath[sizeof(config.macro[i].logoPath)-1] = '\0';

    config.macro[i].intensity = constrain(config.macro[i].intensity, 0, 100);
    config.macro[i].idleIntensity = constrain(config.macro[i].idleIntensity, 0, 100);
    if(config.macro[i].alertAnimation>ALERT_CUSTOM&&!isLibraryId(config.macro[i].alertAnimation))config.macro[i].alertAnimation=ALERT_CLASSIC;
    config.macro[i].alertDuration = constrain(config.macro[i].alertDuration, 1, 60);
    config.macro[i].blinkMs = constrain(config.macro[i].blinkMs, 100, 2000);
    config.macro[i].alertEndOn = true;
  }
}

uint8_t scaleByPercent(uint8_t value, uint8_t percent) {
  return (uint8_t)(((uint16_t)value * constrain((int)percent, 0, 100)) / 100U);
}

// Sortie 0..100% pour les 36 LED du logo Damien.
// Montage utilisateur USB-C / VV : 1,02 A mesure sur le ruban blanc 100%,
// stable selon essai utilisateur ; courant admissible VV non documente.
// Toute sortie LED passe par pixelColorLevel(), y compris les alertes
// et les effets spatiaux (qui peuvent ignorer le curseur de macro).
const uint8_t LED_GLOBAL_MAX_PERCENT = 100;

uint32_t pixelColorLevel(uint8_t r, uint8_t g, uint8_t b, uint8_t intensity) {
  const uint8_t cappedIntensity =
    min((uint8_t)constrain((int)intensity, 0, 100), LED_GLOBAL_MAX_PERCENT);

  return pixels.Color(
    scaleByPercent(r, cappedIntensity),
    scaleByPercent(g, cappedIntensity),
    scaleByPercent(b, cappedIntensity)
  );
}

void setPixelLevel(uint16_t index,
                   uint8_t r,
                   uint8_t g,
                   uint8_t b,
                   uint8_t intensity) {
  if (index >= LED_COUNT) return;
  pixels.setPixelColor(index, pixelColorLevel(r,g,b,intensity));
}

void setRGBLevel(uint8_t r, uint8_t g, uint8_t b, uint8_t intensity) {
  currentLedR = r;
  currentLedG = g;
  currentLedB = b;
  currentLedIntensity = constrain((int)intensity, 0, 100);

  uint32_t color = pixelColorLevel(r,g,b,currentLedIntensity);

  for (uint16_t i = 0; i < LED_COUNT; i++) {
    pixels.setPixelColor(i, color);
  }

  pixels.show();
}

void ledsOff() {
  currentLedR = 0;
  currentLedG = 0;
  currentLedB = 0;
  currentLedIntensity = 0;

  pixels.clear();
  pixels.show();
}

void updateLedStatusReference(uint8_t r,
                              uint8_t g,
                              uint8_t b,
                              uint8_t intensity) {
  currentLedR = r;
  currentLedG = g;
  currentLedB = b;
  currentLedIntensity = constrain((int)intensity, 0, 100);
}

void renderLogoChase(uint8_t r,
                     uint8_t g,
                     uint8_t b,
                     uint8_t intensity,
                     unsigned long elapsed,
                     unsigned long cycleMs) {
  cycleMs = max(300UL, cycleMs);

  // Une tete lumineuse et une queue de 6 LED font le tour du logo.
  uint16_t head =
    (uint16_t)(((elapsed % cycleMs) * LED_COUNT) / cycleMs);

  pixels.clear();

  const uint8_t tailLength = 6;

  for (uint8_t tail = 0; tail < tailLength; tail++) {
    uint16_t index =
      (head + LED_COUNT - tail) % LED_COUNT;

    uint8_t tailIntensity =
      (uint8_t)(((uint16_t)intensity * (tailLength - tail)) / tailLength);

    setPixelLevel(index, r, g, b, tailIntensity);
  }

  pixels.show();
  updateLedStatusReference(r,g,b,intensity);
}

void renderLogoDraw(uint8_t r,
                    uint8_t g,
                    uint8_t b,
                    uint8_t intensity,
                    unsigned long elapsed,
                    unsigned long cycleMs) {
  uint8_t frame[36][3];
  renderContourFrame(r,g,b,intensity,elapsed,max(700UL,cycleMs),frame);
  showMotionFrame(frame);updateLedStatusReference(r,g,b,intensity);
}


// BEGIN PORTABLE MOTION ENGINE
// Face vue de face : 0 bas droit -> 11 bas gauche -> 16 haut gauche
// -> 30 haut droit -> 35 bas droit. Positions normalisees, pas de mm supposes.
static const uint16_t MOTION_LED_COUNT = 36;
static const uint32_t BOOT_CINEMA_MS = 4500;

float logoX(uint16_t i) {
  if (i < 12) return (11.0f-i)/11.0f;
  if (i < 17) return 0.0f;
  if (i < 31) return (i-17)/13.0f;
  return 1.0f;
}
float logoY(uint16_t i) {
  if (i < 12) return 1.0f;
  if (i < 17) return (17.0f-i)/6.0f;
  if (i < 31) return 0.0f;
  return (i-30)/6.0f;
}
float motionClamp(float x) { return x < 0 ? 0 : x > 1 ? 1 : x; }
float motionSmooth(float x) { x=motionClamp(x); return x*x*(3-2*x); }
void motionRGB(uint8_t out[3], uint8_t r, uint8_t g, uint8_t b, float level) {
  level=motionClamp(level);
  out[0]=(uint8_t)(r*level+0.0001f);out[1]=(uint8_t)(g*level+0.0001f);out[2]=(uint8_t)(b*level+0.0001f);
}
void motionRainbow(float hue, uint8_t out[3], float level) {
  hue=hue-floorf(hue);float h=hue*6;int sector=(int)h;float f=h-sector;
  float r=0,g=0,b=0;
  switch(sector){
    case 0:r=1;g=f;break;case 1:r=1-f;g=1;break;
    case 2:g=1;b=f;break;case 3:g=1-f;b=1;break;
    case 4:r=f;b=1;break;default:r=1;b=1-f;break;
  }
  motionRGB(out,(uint8_t)(255*r),(uint8_t)(255*g),(uint8_t)(255*b),level);
}
// Modes : fixe, respiration, balayage G>D, D>G, comete, aller-retour,
// arc-en-ciel horizontal, ouverture depuis le centre.
void renderMotionFrame(uint8_t mode, uint8_t r, uint8_t g, uint8_t b,
                       uint8_t intensity, uint32_t elapsed, uint32_t cycle,
                       uint8_t frame[][3], bool isolateSurfaces=false) {
  if(cycle<500)cycle=500;
  float p=(elapsed%cycle)/(float)cycle;
  float peak=(intensity>100?100:intensity)/100.0f;
  for(uint16_t i=0;i<MOTION_LED_COUNT;i++){
    float x=logoX(i),level=1;
    if(mode==1)level=.15f+.85f*(.5f-.5f*cosf(p*6.28318530718f));
    else if(mode==2||mode==3||mode==5){
      float pos=(mode==5||isolateSurfaces)?(.5f-.5f*cosf(p*6.28318530718f)):p;
      if(mode==3)pos=1-pos;
      float d=fabsf(x-pos);
      level=.08f+.92f*motionSmooth(1-d/.30f);
    }else if(mode==8||mode==9){
      float pos=.5f-.5f*cosf(p*6.28318530718f);if(mode==9)pos=1-pos;
      level=.08f+.92f*motionSmooth(1-fabsf(logoY(i)-pos)/.30f);
    }else if(mode==4){
      float d=fmodf(p*36-i+36,36);level=d<7?1-d/7:.04f;
    }else if(mode==7){
      float distance=fabsf(x-.5f)*2;
      level=.08f+.92f*motionSmooth((p*1.4f-distance)/.28f);
    }
    bool side=(i>=12&&i<17)||i>=31;
    if((isolateSurfaces&&(mode==2||mode==3||mode==5||mode==7)&&side)||((mode==8||mode==9)&&!side))level=0;
    if(mode==6)motionRainbow(x*.8f-p,frame[i],peak);
    else motionRGB(frame[i],r,g,b,level*peak);
  }
}
// Retour false apres la derniere image. Aucun delay, acces reseau ou flash.
bool renderBootFrame(uint32_t elapsed,uint8_t frame[][3]) {
  for(uint16_t i=0;i<MOTION_LED_COUNT;i++)motionRGB(frame[i],0,0,0,0);
  if(elapsed>=BOOT_CINEMA_MS)return false;
  for(uint16_t i=0;i<MOTION_LED_COUNT;i++){
    float x=logoX(i);
    if(elapsed<1700){
      float pos=-.45f+1.9f*elapsed/1700.0f;
      float level=motionSmooth(1-fabsf(x-pos)/.55f)*.7f;
      motionRainbow(x*.85f-elapsed/2500.0f,frame[i],level);
    }else if(elapsed<1760)motionRGB(frame[i],255,255,255,.7f);
    else if(elapsed<1840){}
    else if(elapsed<2740)motionRGB(frame[i],255,255,255,.65f*motionSmooth((elapsed-1840)/900.0f));
    else if(elapsed<3650){
      float distance=fabsf(x-.5f)*2;
      float wave=motionSmooth(((elapsed-2740)/910.0f*1.35f-distance)/.3f);
      motionRGB(frame[i],255,(uint8_t)(255*(1-wave)),(uint8_t)(255*(1-wave)),.65f);
    }else if(elapsed<4100)motionRGB(frame[i],255,0,0,.65f);
    else motionRGB(frame[i],255,0,0,.65f*(1-motionSmooth((elapsed-4100)/400.0f)));
  }
  return true;
}
bool isLibraryId(int id){return id>=32&&id<48;}
void renderContourFrame(uint8_t r,uint8_t g,uint8_t b,uint8_t intensity,uint32_t elapsed,uint32_t cycle,uint8_t frame[][3]){
  float phase=(elapsed%cycle)*72.0f/cycle;
  for(uint8_t i=0;i<36;i++){
    float level=phase<36?motionClamp(phase-i):1-motionClamp(phase-36-i);
    motionRGB(frame[i],r,g,b,level*(intensity>100?100:intensity)/100.0f);
  }
}
uint16_t cueField(const uint8_t* c){return c[2]|((uint16_t)c[3]<<8);}
uint32_t cueDuration(const uint8_t* c){uint16_t f=cueField(c);return (c[0]|((uint16_t)c[1]<<8))+((f&0x8000)?0:f);}
uint32_t cueFrameInterval(const uint8_t* data){
  for(uint8_t n=0;n<data[5];n++){uint16_t f=cueField(data+8+n*112);if((f&0x8000)&&(f&0x3fff)<66)return 10;}
  return 33;
}
void renderCuePixels(const uint8_t* c,uint32_t t,uint8_t frame[][3]){
  uint16_t f=cueField(c);const uint8_t* rgb=c+4;
  if(!(f&0x8000)){memcpy(frame,rgb,108);return;}
  memset(frame,0,108);uint16_t speed=f&0x3fff;if(speed<20)speed=20;
  if(f&0x4000){
    if((t/speed)%2==0)for(uint8_t led=0;led<36;led++)if(rgb[3+led/8]&(1<<(led%8)))memcpy(frame[led],rgb,3);
  }else{
    int start=rgb[0],end=rgb[1],distance=start>end?start-end:end-start;
    int led=start+(start>end?-1:1)*((t/speed)%(distance+1));
    if(led>=0&&led<36)memcpy(frame[led],rgb+2,3);
  }
}
void renderCueFrame(const uint8_t* data,uint8_t intensity,uint32_t elapsed,uint8_t frame[][3]){
  uint32_t total=0;for(uint8_t n=0;n<data[5];n++)total+=cueDuration(data+8+n*112);
  if(!total){memset(frame,0,108);return;}uint32_t t=elapsed%total;
  float peak=(intensity>100?100:intensity)/100.0f*(data[4]==2?data[6]/100.0f:1.0f);
  for(uint8_t n=0;n<data[5];n++){
    const uint8_t* c=data+8+n*112;uint32_t duration=cueDuration(c);
    if(t>=duration){t-=duration;continue;}
    uint16_t fade=cueField(c);renderCuePixels(c,t,frame);
    if(!(fade&0x8000)&&fade){
      const uint8_t* previous=data+8+(n?n-1:data[5]-1)*112;uint8_t before[36][3];
      renderCuePixels(previous,cueDuration(previous)-1,before);float mix=motionClamp(t/(float)fade);
      for(uint8_t led=0;led<36;led++)for(uint8_t k=0;k<3;k++){
        uint8_t a=(!n&&elapsed<total)?0:before[led][k];frame[led][k]=(uint8_t)(a+(frame[led][k]-a)*mix);
      }
    }
    for(uint8_t led=0;led<36;led++)for(uint8_t k=0;k<3;k++)frame[led][k]=(uint8_t)(frame[led][k]*peak);
    return;
  }
}
// END PORTABLE MOTION ENGINE

void showMotionFrame(const uint8_t frame[][3]) {
  for(uint16_t i=0;i<LED_COUNT;i++)setPixelLevel(i,frame[i][0],frame[i][1],frame[i][2],100);
  pixels.show();
}
void renderSpatialMotion(uint8_t mode,uint8_t r,uint8_t g,uint8_t b,uint8_t intensity,unsigned long elapsed,unsigned long cycle,bool isolateSurfaces=false) {
  uint8_t frame[MOTION_LED_COUNT][3];
  renderMotionFrame(mode,r,g,b,intensity,elapsed,cycle,frame,isolateSurfaces);
  showMotionFrame(frame);updateLedStatusReference(r,g,b,intensity);
}

void cancelStartupIndicator() {
  startupSequenceComplete=true;startupIndicatorState=STARTUP_IND_OFF;startupTestActive=false;
}
// Les evenements reseau ne coupent jamais la cinematrique. L'etat reel est
// consulte apres celle-ci, meme si le Wi-Fi a deja reussi entre-temps.
void setStartupIndicatorState(StartupIndicatorState state) {
  if(state==STARTUP_IND_ERROR)startupAPFailed=true;
}
void enterStartupState(StartupIndicatorState state) {
  startupIndicatorState=state;startupStateStartedAt=millis();
}
void updateStartupIndicatorNetworkState() {
  if(startupSequenceComplete)return;
  if(alertRunning||settingsPreviewActive||activeMacro>=0||outputEnabled)cancelStartupIndicator();
}
void finishStartupSequence() {
  int restore=startupTestActive?startupRestoreMacro:-1;
  cancelStartupIndicator();ledsOff();
  if(restore>=0&&restore<MACRO_COUNT)applyMacroIdle(restore);
}
void updateStartupIndicator() {
  if(startupSequenceComplete||(!config.startupAnimation&&!startupTestActive))return;
  unsigned long now=millis();
  if(now-startupIndicatorLastToggle<25UL)return;
  startupIndicatorLastToggle=now;
  unsigned long elapsed=now-startupStateStartedAt;
  uint8_t frame[MOTION_LED_COUNT][3];
  switch(startupIndicatorState){
    case STARTUP_IND_INTRO:
      if(renderBootFrame(elapsed,frame)){showMotionFrame(frame);return;}
      enterStartupState(STARTUP_IND_AP);return;
    case STARTUP_IND_AP:
      renderSpatialMotion(4,40,130,255,30,elapsed,1000);
      if(elapsed>=900){
        startupAPFailed=WiFi.softAPIP()!=AP_IP;
        if(startupAPFailed)enterStartupState(STARTUP_IND_ERROR);
        else if(config.externalWiFiEnabled&&config.knownWiFiCount>0)enterStartupState(STARTUP_IND_WIFI);
        else enterStartupState(STARTUP_IND_FALLBACK);
      }return;
    case STARTUP_IND_WIFI:
    case STARTUP_IND_MDNS:
      if(WiFi.status()==WL_CONNECTED){enterStartupState(STARTUP_IND_READY);return;}
      if(now-startupSessionStartedAt>=15000UL){enterStartupState(STARTUP_IND_ERROR);return;}
      renderSpatialMotion(5,255,125,15,28,elapsed,1800);return;
    case STARTUP_IND_READY:
      if(elapsed>=1050){finishStartupSequence();return;}
      if((elapsed/175)%2==0)setRGBLevel(40,255,100,35);else ledsOff();return;
    case STARTUP_IND_ERROR:
      if(elapsed>=1500){
        if(startupAPFailed)finishStartupSequence();else enterStartupState(STARTUP_IND_FALLBACK);
        return;
      }
      if(elapsed%500<150)setRGBLevel(255,startupAPFailed?0:115,0,35);else ledsOff();return;
    case STARTUP_IND_FALLBACK:
      if(elapsed>=1600){finishStartupSequence();return;}
      renderSpatialMotion(1,45,125,255,28,elapsed,800);return;
    default:finishStartupSequence();return;
  }
}

// Custom timeline: 12 cues, each hold/fade + 36 RGB pixels; one cache in RAM.
static uint8_t customData[1356];
static int customOwner=-1;
static bool customValid=false;
static bool customPreview=false;
static bool customPreviewAlert=false;
static bool libraryPreviewActive=false,libraryPreviewPlaying=false;
static uint8_t libraryPreviewCue=0;
static unsigned long libraryPreviewStarted=0,libraryPreviewLastFrame=0;
const unsigned long LIBRARY_PREVIEW_LEASE_MS=15000UL;
static char libraryPreviewToken[41]={},libraryPreviewRevokedToken[41]={};

uint16_t customWord(const uint8_t* p){return p[0]|((uint16_t)p[1]<<8);}
bool validCustom(const uint8_t* p){
  if(memcmp(p,"CUE1",4)||(p[4]!=1&&p[4]!=2)||p[5]<1||p[5]>12)return false;
  if(p[4]==1?(p[6]||p[7]):(p[6]>100||p[7]!=0xA5))return false;
  uint32_t stored=0;memcpy(&stored,p+1352,4);
  if(configChecksum(p,1352)!=stored)return false;
  for(uint8_t n=0;n<p[5];n++){
    const uint8_t* c=p+8+n*112;
    uint16_t effect=customWord(c+2);
    if(customWord(c)<100||customWord(c)>60000)return false;
    if(effect&0x8000){
      if(p[4]!=2||(effect&0x3fff)<20||(effect&0x3fff)>10000)return false;
      if(!(effect&0x4000)&&(c[4]>35||c[5]>35))return false;
    }else if(effect>20000)return false;
  }
  return true;
}
bool loadCustom(uint8_t i){
  if(customOwner==i)return customValid;
  customOwner=i;customValid=false;
  char path[24];snprintf(path,sizeof(path),isLibraryId(i)?"/anim%u.bin":"/custom%u.bin",i);
  File f=LittleFS.open(path,"r");
  if(!f)return false;
  bool ok=f.size()==sizeof(customData)+(isLibraryId(i)?64:0);
  if(isLibraryId(i)){uint8_t name[64];ok=ok&&f.read(name,64)==64;}
  ok=ok&&f.read(customData,sizeof(customData))==sizeof(customData);
  f.close();customValid=ok&&validCustom(customData);return customValid;
}
void renderCustomOutput(uint8_t i,unsigned long elapsed,bool alert=false){
  MacroConfig& m=config.macro[i];
  if(!loadCustom(i+(alert?MACRO_COUNT:0))){setRGBLevel(m.r,m.g,m.b,m.intensity);return;}
  uint8_t frame[36][3];renderCueFrame(customData,m.intensity,elapsed,frame);
  showMotionFrame(frame);updateLedStatusReference(m.r,m.g,m.b,m.intensity);
}
void renderLibraryOutput(uint8_t i,uint8_t id,unsigned long elapsed){
  MacroConfig& m=config.macro[i];
  if(!loadCustom(id)){setRGBLevel(m.r,m.g,m.b,m.intensity);return;}
  uint8_t frame[36][3];renderCueFrame(customData,m.intensity,elapsed,frame);
  showMotionFrame(frame);updateLedStatusReference(m.r,m.g,m.b,m.intensity);
}

void renderMacroDirect(uint8_t i) {
  if (i >= MACRO_COUNT) return;

  MacroConfig& m = config.macro[i];
  if(!alertRunning&&isLibraryId(motionSettings.mode[i])){renderLibraryOutput(i,motionSettings.mode[i],millis()-directMotionStartedAt);return;}
  if(!alertRunning&&(motionSettings.mode[i]==10||(settingsPreviewActive&&customPreview))){renderCustomOutput(i,millis()-directMotionStartedAt,settingsPreviewActive&&customPreview&&customPreviewAlert);return;}
  if(!alertRunning&&motionSettings.mode[i])renderSpatialMotion(motionSettings.mode[i],m.r,m.g,m.b,m.intensity,millis()-directMotionStartedAt,motionSettings.cycleMs[i],true);
  else setRGBLevel(m.r, m.g, m.b, m.intensity);
}

void renderMacroIdle(uint8_t i) {
  if (i >= MACRO_COUNT) {
    ledsOff();
    return;
  }

  MacroConfig& m = config.macro[i];

  if (m.idleOff || m.idleIntensity == 0) {
    ledsOff();
  } else {
    setRGBLevel(m.idleR, m.idleG, m.idleB, m.idleIntensity);
  }
}

void renderCurrentOutput() {
  if (alertRunning) return;

  if (activeMacro < 0 || activeMacro >= MACRO_COUNT) {
    ledsOff();
    return;
  }

  if (outputEnabled) {
    renderMacroDirect(activeMacro);
  } else {
    renderMacroIdle(activeMacro);
  }
}

void applyMacro(uint8_t i) {
  if (i >= MACRO_COUNT) return;

  cancelStartupIndicator();
  settingsPreviewActive = false;
  alertRunning = false;
  alertMacro = -1;

  activeMacro = i;
  outputEnabled = true;
  directMotionStartedAt=millis();

  renderMacroDirect(i);

  Serial.println("[MACRO] DIRECT " + String(i+1) + " - " + String(config.macro[i].name));
}

void applyMacroIdle(uint8_t i) {
  if (i >= MACRO_COUNT) return;

  cancelStartupIndicator();
  settingsPreviewActive = false;
  alertRunning = false;
  alertMacro = -1;

  activeMacro = i;
  outputEnabled = false;

  renderMacroIdle(i);

  Serial.println("[MACRO] HORS DIRECT " + String(i+1) + " - " + String(config.macro[i].name));
}

void blackout() {
  cancelStartupIndicator();
  settingsPreviewActive = false;
  alertRunning = false;
  alertTestMode = false;
  alertMacro = -1;
  activeMacro = -1;
  outputEnabled = false;
  ledsOff();

  Serial.println(F("[ON AIR] ETEINT / AUCUNE MACRO SELECTIONNEE"));
}

void startAlert(uint8_t i, bool testMode = false) {
  if (i >= MACRO_COUNT) return;

  cancelStartupIndicator();
  settingsPreviewActive = false;

  alertRunning = true;
  alertTestMode = testMode;
  alertMacro = i;
  activeMacro = i;

  // Pendant la cinematrique on n'est pas encore en DIRECT.
  outputEnabled = false;

  alertStartedAt = millis();
  alertLastToggleAt = millis();
  alertAnimLastFrameAt = 0;
  alertVisible = true;

  renderMacroDirect(i);

  if (alertTestMode) {
    Serial.println("[MACRO] TEST ALERTE " + String(i+1) + " - " + String(config.macro[i].name));
  } else {
    Serial.println("[MACRO] ALERTE " + String(i+1) + " - " + String(config.macro[i].name));
  }
}

uint8_t lerp8(uint8_t a, uint8_t b, float t) {
  if (t < 0.0f) t = 0.0f;
  if (t > 1.0f) t = 1.0f;
  return (uint8_t)(a + (b - a) * t);
}

void renderTrafficGradient(float progress, uint8_t intensity) {
  // Un seul passage sur toute la duree :
  // 0% = vert, 50% = jaune, 100% = rouge.
  if (progress < 0.0f) progress = 0.0f;
  if (progress > 1.0f) progress = 1.0f;

  uint8_t r;
  uint8_t g;

  if (progress <= 0.5f) {
    float t = progress / 0.5f;
    r = lerp8(0, 255, t);
    g = 255;
  } else {
    float t = (progress - 0.5f) / 0.5f;
    r = 255;
    g = lerp8(255, 0, t);
  }

  setRGBLevel(r, g, 0, intensity);
  alertVisible = true;
}

void finishAlert() {
  bool wasTest = alertTestMode;
  int finishedMacro = alertMacro;

  alertRunning = false;
  alertTestMode = false;

  if (wasTest) {
    blackout();
    Serial.println(F("[ALERTE TEST] Fin -> TOUT ETEINT"));
    return;
  }

  // Sortie propre de l'etat ALERTE puis passage DIRECT.
  // Important pour l'interface : le bouton DIRECT devient actif,
  // le bouton ALERTE revient immediatement a son etat normal.
  alertMacro = -1;
  alertVisible = false;

  activeMacro = finishedMacro;
  outputEnabled = true;
  directMotionStartedAt=millis();

  renderMacroDirect(activeMacro);

  Serial.println("[ALERTE] Fin propre -> DIRECT " + String(activeMacro + 1));
}

void updateAlert() {
  if (!alertRunning || alertMacro < 0 || alertMacro >= MACRO_COUNT) return;

  MacroConfig& m = config.macro[alertMacro];

  unsigned long now = millis();
  unsigned long elapsed = now - alertStartedAt;
  unsigned long totalMs = max(1UL, (unsigned long)m.alertDuration * 1000UL);

  if (elapsed >= totalMs) {
    finishAlert();
    return;
  }

  if(isLibraryId(m.alertAnimation)){
    if(now-alertAnimLastFrameAt<cueFrameInterval(customData))return;alertAnimLastFrameAt=now;
    renderLibraryOutput(alertMacro,m.alertAnimation,elapsed);alertVisible=true;return;
  }

  // Progression globale 0.0 -> 1.0 sur EXACTEMENT la duree demandee.
  float progress = (float)elapsed / (float)totalMs;

  switch (m.alertAnimation) {

    case ALERT_FADE_TO_BLACK: {
      // Boucle "flash + fade" :
      // 100 % instantane -> fade progressif jusqu'a 0 % -> retour instantane a 100 %.
      // blinkMs regle la duree d'un cycle complet.
      if (now - alertAnimLastFrameAt < 20UL) return;
      alertAnimLastFrameAt = now;

      unsigned long cycle =
        max(300UL, (unsigned long)m.blinkMs);

      unsigned long pos = elapsed % cycle;
      float cycleProgress = (float)pos / (float)cycle;

      uint8_t level =
        (uint8_t)(100.0f * (1.0f - cycleProgress));

      setRGBLevel(m.r, m.g, m.b, level);
      alertVisible = level > 4;
      break;
    }

    case ALERT_TRAFFIC_GRADIENT: {
      // UN SEUL passage sur toute la duree :
      // vert -> jaune -> rouge.
      if (now - alertAnimLastFrameAt < 20UL) return;
      alertAnimLastFrameAt = now;

      renderTrafficGradient(progress, m.intensity);
      break;
    }

    case ALERT_ACCELERATING: {
      // Toute l'acceleration est calculee sur la duree totale.
      float remain = 1.0f - progress;

      unsigned long startInterval =
        max(300UL, (unsigned long)m.blinkMs * 2UL);

      unsigned long interval =
        60UL +
        (unsigned long)((startInterval - 60UL) * remain * remain);

      if (now - alertLastToggleAt >= interval) {
        alertLastToggleAt = now;
        alertVisible = !alertVisible;

        if (alertVisible) renderMacroDirect(alertMacro);
        else renderMacroIdle(alertMacro);
      }
      break;
    }

    case ALERT_DOUBLE_FLASH: {
      // Heartbeat repete pendant la duree demandee.
      // blinkMs regle ici le rythme du heartbeat.
      if (now - alertAnimLastFrameAt < 20UL) return;
      alertAnimLastFrameAt = now;

      unsigned long pulse =
        constrain((unsigned long)m.blinkMs / 4UL, 55UL, 130UL);

      unsigned long cycle =
        max(500UL, (unsigned long)m.blinkMs * 2UL);

      unsigned long pos = elapsed % cycle;

      bool on =
        (pos < pulse) ||
        (pos >= pulse * 2UL && pos < pulse * 3UL);

      if (on) {
        renderMacroDirect(alertMacro);
        alertVisible = true;
      } else {
        renderMacroIdle(alertMacro);
        alertVisible = false;
      }
      break;
    }

    case ALERT_LOGO_CHASE: {
      if (now - alertAnimLastFrameAt < 25UL) return;
      alertAnimLastFrameAt = now;

      unsigned long cycle =
        max(500UL, (unsigned long)m.blinkMs * 2UL);

      renderLogoChase(
        m.r, m.g, m.b, m.intensity,
        elapsed, cycle
      );

      alertVisible = true;
      break;
    }

    case ALERT_LOGO_DRAW: {
      if (now - alertAnimLastFrameAt < 25UL) return;
      alertAnimLastFrameAt = now;

      unsigned long cycle =
        max(700UL, (unsigned long)m.blinkMs * 3UL);

      renderLogoDraw(
        m.r, m.g, m.b, m.intensity,
        elapsed, cycle
      );

      alertVisible = true;
      break;
    }

    case ALERT_CUSTOM: {
      if(now-alertAnimLastFrameAt<cueFrameInterval(customData))return;
      alertAnimLastFrameAt=now;renderCustomOutput(alertMacro,elapsed,true);
      alertVisible=true;break;
    }
    case ALERT_SWEEP_LR:
    case ALERT_SWEEP_RL:
    case ALERT_BREATHE:
    case ALERT_IRIS:
    case ALERT_SWEEP_TB:
    case ALERT_SWEEP_BT:
    case ALERT_RAINBOW: {
      if(now-alertAnimLastFrameAt<cueFrameInterval(customData))return;
      alertAnimLastFrameAt=now;
      uint8_t mode=m.alertAnimation==ALERT_SWEEP_TB?8:m.alertAnimation==ALERT_SWEEP_BT?9:m.alertAnimation==ALERT_SWEEP_LR?2:m.alertAnimation==ALERT_SWEEP_RL?3:m.alertAnimation==ALERT_BREATHE?1:m.alertAnimation==ALERT_IRIS?7:6;
      renderSpatialMotion(mode,m.r,m.g,m.b,m.intensity,elapsed,max(1000UL,(unsigned long)m.blinkMs*4UL),true);
      alertVisible=true;break;
    }
    case ALERT_CLASSIC:
    default: {
      // Clignotement constant pendant toute la duree demandee.
      if (now - alertLastToggleAt >= m.blinkMs) {
        alertLastToggleAt = now;
        alertVisible = !alertVisible;

        if (alertVisible) renderMacroDirect(alertMacro);
        else renderMacroIdle(alertMacro);
      }
      break;
    }
  }
}

void showMacroPreview(uint8_t i, bool directState) {
  if(libraryPreviewActive)strncpy(libraryPreviewRevokedToken,libraryPreviewToken,40);
  libraryPreviewActive=false;libraryPreviewToken[0]=0;customOwner=-1;
  customPreview=false;
  if (i >= MACRO_COUNT || alertRunning) return;

  cancelStartupIndicator();
  previewMotionMacro=i;previewMotionDirect=directState;
  directMotionStartedAt=millis();
  settingsPreviewActive = true;
  settingsPreviewUntil = millis() + SETTINGS_PREVIEW_HOLD_MS;

  if (directState) {
    renderMacroDirect(i);
  } else {
    renderMacroIdle(i);
  }
}

void updateSettingsPreview() {
  if (!settingsPreviewActive || alertRunning) return;

  if ((long)(millis() - settingsPreviewUntil) >= 0) {
    settingsPreviewActive = false;
    renderCurrentOutput();
  }
}

void updateDirectMotion() {
  if(libraryPreviewActive)return;
  if(alertRunning||!startupSequenceComplete)return;
  int i=settingsPreviewActive&&previewMotionDirect?previewMotionMacro:outputEnabled&&!settingsPreviewActive?activeMacro:-1;
  if(i<0||i>=MACRO_COUNT||(motionSettings.mode[i]==0&&!(settingsPreviewActive&&customPreview)))return;
  unsigned long now=millis();if(now-liveMotionLastFrameAt<(isLibraryId(motionSettings.mode[i])?cueFrameInterval(customData):33UL))return;
  liveMotionLastFrameAt=now;
  renderMacroDirect(i);
}

void startupAnimation() {
  startupRestoreMacro=startupTestActive?activeMacro:-1;
  settingsPreviewActive=false;activeMacro=-1;outputEnabled=false;
  startupSequenceComplete=false;startupAPFailed=false;
  startupSessionStartedAt=millis();startupIndicatorLastToggle=0;
  enterStartupState(STARTUP_IND_INTRO);
}

String mimeTypeForPath(String path) {
  path.toLowerCase();
  if (path.endsWith(".png")) return "image/png";
  if (path.endsWith(".jpg") || path.endsWith(".jpeg")) return "image/jpeg";
  return "application/octet-stream";
}

static const char COMMON_CSS[] PROGMEM = R"CSS(
:root{color-scheme:light;--bg:#f3f4f8;--panel:#fff;--text:#191a20;--muted:#6b6f7d;--line:#e7e8ee;--red:#ee4c58;--amber:#a35d00;--green:#268154;--radius:26px}
*{box-sizing:border-box}[hidden]{display:none!important}html{scroll-behavior:smooth;scroll-padding-top:90px}html,body{margin:0;padding:0;background:var(--bg);color:var(--text);font-family:-apple-system,BlinkMacSystemFont,'Segoe UI',Helvetica,Arial,sans-serif}body{min-height:100vh;line-height:1.45;-webkit-font-smoothing:antialiased;-webkit-tap-highlight-color:transparent}button,input,select{font:inherit}a{color:inherit}button,a,input,select,summary{touch-action:manipulation}:focus-visible{outline:3px solid #4084f4;outline-offset:4px}button:focus:not(:focus-visible){outline:none}.sr-only{position:absolute!important;width:1px;height:1px;padding:0;overflow:hidden;clip:rect(0,0,0,0);white-space:nowrap;border:0}
.top{position:sticky;top:0;z-index:20;display:flex;align-items:center;justify-content:space-between;gap:16px;min-height:70px;padding:14px max(20px,calc((100vw - 880px)/2));background:#f3f4f8ed;backdrop-filter:blur(20px);-webkit-backdrop-filter:blur(20px)}.title{font-size:18px;font-weight:600;letter-spacing:-.5px;min-width:0;overflow-wrap:anywhere}.iconbtn{display:inline-flex;align-items:center;justify-content:center;gap:7px;flex-shrink:0;min-height:44px;padding:10px 14px;border:0;border-radius:22px;background:#fff9;color:#3b68ba;text-decoration:none;font-size:14px;font-weight:500}.iconbtn:hover{background:#fff}.wrap{width:min(920px,100%);margin:auto;padding:20px 20px 40px}
.control{background:radial-gradient(ellipse at 100% 0%,#e7edff 0%,transparent 47%),radial-gradient(ellipse at 0% 90%,#faeae7 0%,transparent 43%),#f3f4f8;background-attachment:fixed}.control-top{position:relative;width:min(920px,100%);margin:auto;padding:28px 24px 22px;background:none;backdrop-filter:none;-webkit-backdrop-filter:none;align-items:flex-start}.control-top .title{font-size:29px;line-height:1.2;font-weight:650;letter-spacing:-1.1px;margin:0 0 8px}.connection{display:inline-flex;align-items:center;gap:6px;font-size:12px;color:var(--muted);font-weight:400;letter-spacing:0}.connection:before{content:'';width:6px;height:6px;border-radius:50%;background:currentColor}.connection[data-state=online]{color:#56826a}.connection[data-state=offline]{color:#a46c28}.settings-button{width:44px;height:44px;padding:0;color:#454a59;background:#fff9;box-shadow:0 2px 12px #242c4905}.settings-button svg{width:22px;height:22px;stroke-width:1.6}.control .wrap{padding:0 24px 118px}.macro-grid{display:grid;grid-template-columns:1fr 1fr;gap:16px}.card{position:relative;border:1px solid #ffffffcc;background:#ffffffd9;border-radius:var(--radius);overflow:hidden;box-shadow:0 4px 22px #28315a05;transition:box-shadow .2s,border-color .2s,background .2s}.card[data-active=true]{border-color:var(--channel);background:#fff;box-shadow:0 0 0 1px var(--channel),0 8px 28px var(--wash)}.card[data-alert=true]{border-color:#e3b556;background:#fffdf7;box-shadow:0 0 0 1px #e3b556}.macrohead{display:flex;gap:13px;align-items:center;padding:18px 18px 14px}.logo,.nologo{flex-shrink:0;width:48px;height:48px;border:0;border-radius:14px;background:transparent}.logo{object-fit:contain;padding:0}.nologo{display:grid;place-items:center;font-size:22px;color:#777b88;background:var(--wash)}.mname{flex:1;min-width:0}.mname h2{font-size:20px;font-weight:600;letter-spacing:-.65px;line-height:1.25;margin:0 0 4px;overflow:hidden;text-overflow:ellipsis;white-space:nowrap}.meta{font-size:12px;color:var(--muted);display:flex;align-items:center;gap:4px;font-variant-numeric:tabular-nums}.meta svg{width:12px;height:12px;stroke-width:1.5}.actions{display:grid;grid-template-columns:1fr 1fr;gap:10px;padding:0 18px 17px}
button{display:inline-flex;align-items:center;justify-content:center;gap:8px;border:0;border-radius:24px;min-height:46px;padding:11px 15px;font-size:14px;font-weight:550;cursor:pointer;transition:background .15s,opacity .15s,transform .12s}button svg{width:18px;height:18px;stroke-width:1.7;flex-shrink:0}button:active{transform:scale(.97)}button:disabled{cursor:not-allowed;opacity:.42;transform:none}.direct{background:var(--wash,#eceef5);color:#30313b}.direct svg{color:var(--channel,#777b88)}.direct.active svg{color:inherit}.alert{background:#fff0d7;color:#9a610c}.alert.active{background:#eab759;color:#3e2b06}.direct:hover:not(:disabled),.alert:hover:not(:disabled){filter:brightness(.97)}.transport{position:fixed;bottom:0;left:0;right:0;z-index:30;padding:14px 24px max(18px,env(safe-area-inset-bottom));background:linear-gradient(0deg,#f3f4f8 20%,#f3f4f8eb 75%,#f3f4f800)}.transport-inner{width:min(872px,100%);margin:auto;display:flex;justify-content:center}.blackout{width:100%;min-height:52px;border-radius:28px;background:#22232a;color:#fff;box-shadow:0 6px 18px #25283612;font-size:14px;font-weight:600;letter-spacing:.04em}.blackout svg{width:18px;height:18px}.feedback{font-size:12px;line-height:1.5;color:#9a4b13;padding:12px 2px 0}.feedback:empty{display:none}
.section{padding:22px;border:0;background:var(--panel);border-radius:var(--radius);margin-bottom:14px;overflow:hidden;box-shadow:0 3px 18px #28315a04}.section h2{font-size:21px;font-weight:600;letter-spacing:-.6px;margin:0 0 12px}.section h3{font-size:16px;font-weight:600;letter-spacing:-.3px}.section>p,.small{font-size:12px;color:var(--muted);line-height:1.65;overflow-wrap:anywhere}.section label{display:block;font-size:13px;font-weight:500;color:#666b78;margin:18px 0 7px}.section input,.section select{width:100%;min-width:0;min-height:48px;padding:12px 14px;background:#f4f5f9;color:var(--text);border:1px solid transparent;border-radius:14px;font-size:16px}.section input[type=checkbox]{width:20px!important;min-height:20px;height:20px;vertical-align:middle;accent-color:#4982e8}.section input[type=color]{height:50px;padding:5px;cursor:pointer}.section input[type=range]{padding:0;min-height:44px;accent-color:#4982e8;border:0;background:transparent}.section input[type=file]{font-size:12px;padding:9px;max-width:100%}.section input::file-selector-button{border:0;border-radius:9px;padding:7px 10px;background:#e6e9f2;color:#333945;margin-right:8px}.grid2,.testrow{display:grid;grid-template-columns:1fr 1fr;gap:14px}.testrow{margin-top:16px}.save{display:flex;width:100%;margin-top:16px;min-height:46px;border:0;border-radius:24px;background:#3478e5;color:#fff;font-size:13px;font-weight:550;text-decoration:none}.danger{width:100%;background:#fff0f0;color:#b3434a;margin-top:10px;font-size:13px}.filebox{padding:16px;border:0;border-radius:18px;background:#f5f6fa}.wifilist{display:flex;flex-direction:column;gap:8px}.wifirow{display:flex;align-items:center;justify-content:space-between;gap:12px;width:100%;min-height:64px;padding:13px;background:#f5f6fa;border:0;border-radius:18px;text-align:left;color:var(--text)}.wifiname{font-weight:550;font-size:15px;overflow-wrap:anywhere}.wifimeta{font-size:11px;color:var(--muted);line-height:1.6;white-space:normal}.settings-intro{margin:0 0 20px}.settings-intro h1{font-size:29px;font-weight:650;letter-spacing:-1px;margin:0}.settings-intro p,.eyebrow{display:none}.jumpnav{display:flex;flex-wrap:wrap;gap:8px;margin:16px 0 22px}.jumpnav a{display:flex;align-items:center;min-height:40px;padding:9px 14px;border:0;border-radius:22px;background:#e6eaf4;color:#4e6184;font-size:12px;text-decoration:none}.section summary{display:flex;align-items:center;justify-content:space-between;gap:12px;min-height:28px;font-size:16px;font-weight:550;cursor:pointer;list-style:none}.section summary::-webkit-details-marker{display:none}.section summary:after{content:'›';font-size:24px;color:#a1a6b0;font-weight:400;transform:rotate(0)}.section[open]>summary{margin-bottom:16px}.section[open]>summary:after{transform:rotate(90deg)}.section[id]{scroll-margin-top:80px}.settings-macros a{text-decoration:none}.settings-macros .logo{width:40px!important;height:40px!important}.autosave{font-size:12px;color:#447b5b;background:#f0f8f2;border:0;border-radius:12px;padding:10px 12px;margin-bottom:18px}.fieldgroup{margin-top:18px;padding-top:4px;border-top:1px solid var(--line)}.fieldgroup h3{margin:14px 0 6px}.fieldgroup>p{display:none}.password-wrap{position:relative}.password-wrap input{padding-right:78px}.password-toggle{position:absolute;right:4px;top:4px;min-height:40px;padding:5px 9px;border-radius:11px;background:#e9ecf4;color:#506384;font-size:11px}.macro-title{overflow:hidden;text-overflow:ellipsis;white-space:nowrap;max-width:55vw}
@media(max-width:600px){.top{padding:12px 20px;min-height:64px}.control-top{padding:28px 22px 22px}.control-top .title{font-size:28px}.control .wrap{padding:0 20px 110px}.macro-grid{grid-template-columns:1fr;gap:13px}.macrohead{padding:15px 17px 12px}.logo,.nologo{width:46px;height:46px}.mname h2{font-size:19px}.actions{padding:0 16px 15px;gap:10px}.actions button{min-height:44px;padding:9px 12px;font-size:14px}.wrap{padding:16px 20px 30px}.section{padding:18px}.grid2{grid-template-columns:1fr}.iconbtn{font-size:13px}.transport{padding-left:20px;padding-right:20px}.settings-button{width:44px;height:44px}.title{font-size:16px}}

.theme-choice{display:flex;gap:6px;padding:5px;border-radius:26px;background:#e9ecf4}.theme-choice button{flex:1;min-height:42px;background:transparent;color:var(--muted)}.theme-choice button[aria-pressed=true]{background:var(--panel);color:var(--text);box-shadow:0 2px 8px #0000000c}
[data-theme=dark]{color-scheme:dark;--bg:#101116;--panel:#1b1e26;--text:#f0f1f6;--muted:#a0a6b5;--line:#323641;--amber:#f2bd70;--green:#82cba0}
[data-theme=dark] .control{background:radial-gradient(ellipse at 100% 0%,#1c2540 0%,transparent 48%),radial-gradient(ellipse at 0% 90%,#291e2b 0%,transparent 44%),#101116;background-attachment:fixed}
[data-theme=dark] .top{background:#101116e8}[data-theme=dark] .control-top{background:transparent}
[data-theme=dark] .iconbtn{background:#272b35;color:#b9cbee}[data-theme=dark] .settings-button{color:#cdd4e4}
[data-theme=dark] .card{background:#1d2029e8;border-color:#ffffff08;box-shadow:0 6px 24px #00000018}[data-theme=dark] .card[data-active=true]{background:#20232d;border-color:var(--channel)}[data-theme=dark] .card[data-alert=true]{background:#29251f;border-color:#d1a052}
[data-theme=dark] .direct{background:var(--wash,#2a2e39);color:#e3e7f1}[data-theme=dark] .alert{background:#3b3020;color:#efbe78}[data-theme=dark] .alert.active{background:#dbad61;color:#241b10}
[data-theme=dark] .transport{background:linear-gradient(0deg,#101116 20%,#101116eb 75%,#10111600)}[data-theme=dark] .blackout{background:#e9edf5;color:#1b1d25;box-shadow:0 6px 22px #00000030}
[data-theme=dark] .section input,[data-theme=dark] .section select,[data-theme=dark] .filebox,[data-theme=dark] .wifirow{background:#252934;color:var(--text)}[data-theme=dark] .section label{color:#b8bfcd}[data-theme=dark] .wifimeta{color:var(--muted)}[data-theme=dark] .jumpnav a,[data-theme=dark] .password-toggle,[data-theme=dark] .theme-choice{background:#262c3b;color:#bdcbe4}
[data-theme=dark] .danger{background:#38232b;color:#f3b2b7}[data-theme=dark] .autosave{background:#20312a;color:#8ac9a2}[data-theme=dark] .feedback{color:#edbe80}[data-theme=dark] .connection[data-state=online]{color:#8cbd9e}[data-theme=dark] .connection[data-state=offline]{color:#e2b679}

@media(prefers-reduced-motion:reduce){html{scroll-behavior:auto}*,*:before,*:after{transition:none!important;animation:none!important}}

.library-entry{display:flex;align-items:center;justify-content:space-between;gap:16px;min-height:78px;color:var(--text);text-decoration:none;font-size:16px;font-weight:550}.library-entry>span:last-child{font-size:24px;font-weight:400;color:var(--muted)}.library-entry:active{opacity:.7}.animation-row{display:flex;align-items:center;justify-content:space-between;gap:12px;padding:17px 0;border-bottom:1px solid var(--line)}.animation-row:last-child{border-bottom:0;padding-bottom:0}.animation-emission{display:flex;align-items:center;gap:12px;min-width:0}.animation-emission>span{font-size:15px;font-weight:550;letter-spacing:-.2px;overflow:hidden;text-overflow:ellipsis;white-space:nowrap}.animation-logo{width:38px;height:38px;object-fit:contain;border-radius:10px;flex-shrink:0}.animation-actions{display:flex;gap:8px;flex-shrink:0}.animation-actions a{display:inline-flex;align-items:center;justify-content:center;gap:8px;min-height:42px;padding:10px 12px;border-radius:14px;font-size:13px;font-weight:550;text-decoration:none;line-height:1.2}.animation-actions a>span{font-size:15px;opacity:.55}.animation-direct{background:#edf0fa;color:#455b94}.animation-alert{background:#fff1da;color:#956317}[data-theme=dark] .animation-direct{background:#282f44;color:#bdccee}[data-theme=dark] .animation-alert{background:#3a3021;color:#efc584}.animation-actions a:active{opacity:.7}.editor-link .save{align-items:center;justify-content:center;text-align:center;padding:12px 16px;line-height:1.4}
@media(max-width:380px){.animation-row{gap:10px}.animation-emission{gap:9px}.animation-emission>span{font-size:13px}.animation-logo{width:30px;height:30px}.animation-actions{gap:6px}.animation-actions a{padding:10px 11px;gap:7px;font-size:12px}}
)CSS";



static const char CONTROL_PAGE_JS[] PROGMEM = R"JS(
<script>
let lastState=null,connected=false,commandBusy=false,pollBusy=false,refreshTimer=null;
let requestId=0,appliedId=0,commandToken=0;
const el=id=>document.getElementById(id);
async function api(url){
  const id=++requestId,controller=new AbortController();
  const timer=setTimeout(()=>controller.abort(),2000);
  try{const r=await fetch(url,{cache:'no-store',signal:controller.signal});
    if(!r.ok)throw Error('HTTP '+r.status);
    const data=await r.json();
    if(typeof data.output_enabled!=='boolean'||typeof data.alert_running!=='boolean')throw Error('Invalid status');
    return {id,data};
  }catch(e){return {id,data:null};}finally{clearTimeout(timer);}
}
function textColor(hex){const h=hex.replace('#','');return (parseInt(h.slice(0,2),16)*299+parseInt(h.slice(2,4),16)*587+parseInt(h.slice(4,6),16)*114)/1000>160?'#151719':'#fff';}
function accept(result){
  if(result.id<appliedId)return;
  appliedId=result.id;connected=!!result.data;
  if(result.data){lastState=result.data;el('feedback').textContent='';}
  renderStatus();
}
function renderStatus(){
  const s=lastState,badge=el('connection'),bar=el('alertbar');
  badge.dataset.state=connected?'online':'offline';
  badge.textContent=connected?'Boîtier connecté':'Connexion à vérifier';
  document.body.dataset.mode=!connected?'unknown':s.alert_running?'alert':s.output_enabled?'live':'idle';
  el('status').textContent=!connected?'État non confirmé':s.alert_running?'Alerte · '+s.active_name:s.output_enabled?'En direct · '+s.active_name:s.active_macro>=0?'Hors direct · '+s.active_name:'OFF';
  bar.hidden=!(connected&&s.alert_running);
  bar.style.display=bar.hidden?'none':'block';
  bar.textContent=connected&&s.alert_running?'Alerte en cours':'';
  for(let i=0;i<4;i++){
    const card=el('macro-'+i),d=el('direct-'+i),a=el('alert-'+i);
    const live=!!(connected&&s.output_enabled&&!s.alert_running&&s.active_macro===i);
    const alert=!!(connected&&s.alert_running&&s.alert_macro===i);
    card.dataset.active=String(live);card.dataset.alert=String(alert);

    d.classList.toggle('active',live);a.classList.toggle('active',alert);
    d.setAttribute('aria-pressed',String(live));a.setAttribute('aria-pressed',String(alert));
    d.style.background=live?d.dataset.color:'';d.style.color=live?textColor(d.dataset.color):'';
    el('direct-label-'+i).textContent=live?'En direct':'Direct';el('alert-label-'+i).textContent=alert?'Alerte…':'Alerte';
    d.setAttribute('aria-label',live?'Quitter le direct':'Direct');
    d.disabled=!connected||commandBusy||s.alert_running||(s.output_enabled&&s.active_macro!==i);
    a.disabled=!connected||commandBusy||s.alert_running||s.output_enabled;

  }
}
async function command(path,blackout=false){
  if(commandBusy&&!blackout)return;
  const token=++commandToken;
  commandBusy=true;
  // Ignore any poll started before this command; show only confirmed device state.
  appliedId=requestId+1;
  renderStatus();el('feedback').textContent=blackout?'Extinction demandée…':'Commande en cours…';
  const result=await api(path);accept(result);
  if(token!==commandToken)return;
  commandBusy=false;renderStatus();
  if(!result.data)el('feedback').textContent='Commande non confirmée. Vérifiez le boîtier avant de réessayer.';
  scheduleRefresh(200);
}
function directMacro(i){return command('/api/direct?i='+i);}
function alertMacro(i){return command('/api/alert?i='+i);}
function offOnAir(){return command('/api/off',true);}
function scheduleRefresh(ms){clearTimeout(refreshTimer);if(!document.hidden)refreshTimer=setTimeout(refreshStatus,ms);}
async function refreshStatus(){
  if(document.hidden)return;
  if(pollBusy||commandBusy){scheduleRefresh(300);return;}
  pollBusy=true;
  try{accept(await api('/api/status'));}finally{pollBusy=false;scheduleRefresh(connected?(lastState.alert_running?350:1000):1500);}
}
document.addEventListener('visibilitychange',()=>{clearTimeout(refreshTimer);if(!document.hidden){connected=false;renderStatus();refreshStatus();}});
window.addEventListener('pageshow',()=>{connected=false;renderStatus();scheduleRefresh(0);});
renderStatus();scheduleRefresh(0);
</script>
)JS";


static uint32_t webMinimumHeap=0,webRefusedPages=0;
bool webMemoryReady(){
  uint32_t free=ESP.getFreeHeap();
  if(!webMinimumHeap||free<webMinimumHeap)webMinimumHeap=free;
  if(free>=12000&&ESP.getMaxFreeBlockSize()>=6000)return true;
  webRefusedPages++;
  server.sendHeader(F("Retry-After"),F("3"));server.sendHeader(F("Connection"),F("close"));
  server.send_P(503,PSTR("text/plain; charset=utf-8"),PSTR("Mémoire temporairement insuffisante. Réessayez dans quelques secondes, ou ouvrez /health."));
  return false;
}
void sendHtmlFlash(PGM_P text){server.sendContent_P(text);yield();}
void handleHealth(){
  char response[240];
  uint32_t heap=ESP.getFreeHeap();if(!webMinimumHeap||heap<webMinimumHeap)webMinimumHeap=heap;
  snprintf(response,sizeof(response),"{\"version\":\"%s\",\"uptime_ms\":%lu,\"heap\":%lu,\"min_heap\":%lu,\"max_block\":%lu,\"free_stack\":%lu,\"refused_pages\":%lu,\"reset_reason\":%u}",
    FIRMWARE_VERSION,millis(),heap,webMinimumHeap,ESP.getMaxFreeBlockSize(),ESP.getFreeContStack(),webRefusedPages,ESP.getResetInfoPtr()->reason);
  server.sendHeader(F("Cache-Control"),F("no-store"));server.send(200,"application/json",response);
}

void sendControlPage() {
  if(!webMemoryReady())return;
  Serial.println(
    "[WEB] GET / stream | heap=" + String(ESP.getFreeHeap()) +
    " | maxblock=" + String(ESP.getMaxFreeBlockSize())
  );

  server.setContentLength(CONTENT_LENGTH_UNKNOWN);

  server.sendHeader("Cache-Control","no-store, no-cache, must-revalidate");
  server.sendHeader("Pragma","no-cache");
  server.sendHeader("Connection","close");

  server.send(
    200,
    "text/html; charset=utf-8",
    ""
  );

  // Entete : petit morceau seulement, pas de grosse String de 10-12 Ko en RAM.
  {
  String chunk;
  chunk.reserve(1200);

  chunk = F("<!doctype html><html lang='fr'><head>"
    "<meta charset='utf-8'>"
    "<meta name='viewport' content='width=device-width,initial-scale=1,viewport-fit=cover'>"
    "<title>");

  chunk += htmlEscape(config.deviceName);

  chunk += F("</title>"
    "<style>html,body{margin:0;background:#f3f4f8;color:#191a20}</style>"
    "<script>(function(){var m;try{m=localStorage.getItem('onair-theme')}catch(e){}if(m!=='dark'&&m!=='light')m=matchMedia('(prefers-color-scheme: dark)').matches?'dark':'light';window.setTheme=function(v){if(v!=='dark'&&v!=='light')return;document.documentElement.dataset.theme=v;try{localStorage.setItem('onair-theme',v)}catch(e){}document.querySelectorAll('[data-theme-choice]').forEach(function(b){b.setAttribute('aria-pressed',String(b.dataset.themeChoice===v))})};document.documentElement.dataset.theme=m})()</script><link rel='stylesheet' href='/style.css?v=343'>"
    "</head><body class='control' data-mode='unknown'>"
    "<header class='top control-top'><div><h1 class='title'>");
  chunk += htmlEscape(config.deviceName);
  chunk += F("</h1><span id='connection' class='connection' data-state='offline'>Connexion…</span></div>"
    "<a class='iconbtn settings-button' href='/settings' aria-label='Réglages'><svg viewBox='0 0 24 24' fill='none' stroke='currentColor' stroke-linecap='round' stroke-linejoin='round' aria-hidden='true'><path d='m9.5 3-.6 2.1-1.7 1-2.2-.5-2.5 4.3L4.1 12l-1.6 2.1L5 18.4l2.2-.5 1.7 1 .6 2.1h5l.6-2.1 1.7-1 2.2.5 2.5-4.3L19.9 12l1.6-2.1L19 5.6l-2.2.5-1.7-1-.6-2.1Z'/><circle cx='12' cy='12' r='3.2'/></svg></a></header>"
    "<main class='wrap'><div id='status' class='sr-only' role='status' aria-live='polite'></div>"
    "<div id='alertbar' class='sr-only' hidden></div><div class='macro-grid'>");

  server.sendContent(chunk);
  chunk = F("");

  // Chaque macro est envoyee separement.
  // La RAM necessaire reste donc tres faible et constante.
  for (uint8_t i = 0; i < MACRO_COUNT; i++) {
    MacroConfig& m = config.macro[i];

    String directColor = rgbToHex(m.r,m.g,m.b);
    String idleColor = rgbToHex(m.idleR,m.idleG,m.idleB);

    chunk.reserve(1500);

    chunk = F("<section class='card' id='macro-");
    chunk += String(i);
    chunk += F("' style='--channel:");
    chunk += directColor;
    chunk += F(";--wash:");
    chunk += directColor;
    chunk += F("16'><div class='macrohead'>");

    if (logoAvailable(i)) {
      chunk += F("<img class='logo' src='/logo?i=");
      chunk += String(i);
      chunk += F("' alt='' decoding='async'>");
    } else {
      chunk += F("<div class='nologo' aria-hidden='true'>");
      chunk += F("•");
      chunk += F("</div>");
    }

    chunk += F("<div class='mname'><h2>");
    chunk += htmlEscape(String(m.name));
    chunk += F("</h2><div class='meta'>");

    chunk += F("<svg viewBox='0 0 24 24' fill='none' stroke='currentColor' stroke-linecap='round' aria-hidden='true'><circle cx='12' cy='12' r='4'/><path d='M12 2v2m0 16v2M2 12h2m16 0h2M5 5l1.5 1.5m11 11L19 19M5 19l1.5-1.5m11-11L19 5'/></svg>");
    chunk += String(m.intensity);
    chunk += F(" %</div></div></div>");

    chunk += F("<div class='actions'>");

    chunk += F("<button id='direct-");
    chunk += String(i);
    chunk += F("' type='button' class='direct' disabled aria-pressed='false' data-color='");
    chunk += directColor;
    chunk += F("' onclick='directMacro(");
    chunk += String(i);
    chunk += F(")'><svg viewBox='0 0 24 24' fill='none' stroke='currentColor' stroke-linecap='round' aria-hidden='true'><circle cx='12' cy='12' r='3' fill='currentColor' stroke='none'/><path d='M7 7a7 7 0 0 0 0 10M17 7a7 7 0 0 1 0 10M4 4a11.3 11.3 0 0 0 0 16M20 4a11.3 11.3 0 0 1 0 16'/></svg><span id='direct-label-");
    chunk += String(i);
    chunk += F("'>Direct</span></button>");

    chunk += F("<button id='alert-");
    chunk += String(i);
    chunk += F("' type='button' class='alert' disabled aria-pressed='false' data-color='");
    chunk += directColor;
    chunk += F("' data-idle-color='");
    chunk += idleColor;
    chunk += F("' data-idle-off='");
    chunk += (m.idleOff ? "1" : "0");
    chunk += F("' onclick='alertMacro(");
    chunk += String(i);
    chunk += F(")'><svg viewBox='0 0 24 24' fill='none' stroke='currentColor' stroke-linecap='round' stroke-linejoin='round' aria-hidden='true'><path d='M18 8a6 6 0 0 0-12 0c0 7-3 7-3 9h18c0-2-3-2-3-9M10 21h4'/></svg><span id='alert-label-");
    chunk += String(i);
    chunk += F("'>Alerte</span></button>");

    chunk += F("</div></section>");

    server.sendContent(chunk);
    chunk = F("");

    yield();
  }

  server.sendContent(
    "</div><div id='feedback' class='feedback' role='status' aria-live='polite'></div>"
    "</main><footer class='transport'><div class='transport-inner'>"
    "<button id='offBtn' class='blackout' type='button' onclick='offOnAir()' aria-label='OFF : tout éteindre'>"
    "<svg viewBox='0 0 24 24' fill='none' stroke='currentColor' stroke-linecap='round' aria-hidden='true'><path d='M12 3v9M6.4 5.4a9 9 0 1 0 11.2 0'/></svg>OFF</button></div></footer>"
  );

  chunk=String();
  server.sendContent_P(CONTROL_PAGE_JS);

  server.sendContent_P(PSTR("</body></html>"));

  // Termine explicitement la reponse chunked.
  server.sendContent_P(PSTR(""));

  }

  Serial.println(
    "[WEB] / stream termine | heap=" + String(ESP.getFreeHeap()) +
    " | maxblock=" + String(ESP.getMaxFreeBlockSize())
  );
}



static const char SETTINGS_PAGE_JS[] PROGMEM = R"SETJS(
<script>
function signalLabel(rssi){
  if(rssi>=-55)return'Excellent';
  if(rssi>=-67)return'Bon';
  if(rssi>=-75)return'Moyen';
  return'Faible';
}

function selectWiFi(ssid,saved){
  document.getElementById('externalSSID').value=ssid;
  document.getElementById('externalWiFiEnabled').checked=true;

  const pw=document.getElementById('externalPassword');

  if(saved){
    document.getElementById('wifiScanStatus').textContent=
      'Reseau deja memorise : '+ssid+' — laisse le mot de passe vide pour conserver celui en memoire.';
    pw.placeholder='deja memorise — laisser vide';
  }else{
    document.getElementById('wifiScanStatus').textContent=
      'Nouveau reseau : '+ssid+' — saisis le mot de passe.';
    pw.placeholder='mot de passe du Wi-Fi';
  }

  pw.focus();
}

async function forgetWiFi(i){
  if(!confirm('Oublier ce reseau Wi-Fi ?'))return;

  await fetch('/forgetWiFi?i='+i,{
    method:'POST',
    cache:'no-store'
  });

  location.reload();
}

function waitMs(ms){
  return new Promise(resolve=>setTimeout(resolve,ms));
}

function renderWiFiResults(data){
  const status=document.getElementById('wifiScanStatus');
  const box=document.getElementById('wifiScanResults');

  if(!data.networks || data.networks.length===0){
    status.textContent='Aucun reseau Wi-Fi 2.4 GHz detecte.';
    box.innerHTML='';
    return;
  }

  status.textContent=
    data.networks.length+
    ' reseau(x) detecte(s). Appuie sur un reseau pour le selectionner.';

  const list=document.createElement('div');
  list.className='wifilist';

  data.networks.forEach(n=>{
    const b=document.createElement('button');
    b.type='button';
    b.className='wifirow';

    const left=document.createElement('div');
    left.style.minWidth='0';

    const name=document.createElement('div');
    name.className='wifiname';
    name.textContent=n.ssid;

    const meta=document.createElement('div');
    meta.className='wifimeta';
    meta.textContent=
      (n.saved?'✓ MEMORISE · ':'')+
      (n.secure?'🔒 ':'🔓 ')+
      signalLabel(n.rssi)+' · '+
      n.rssi+' dBm · canal '+n.channel;

    left.appendChild(name);
    left.appendChild(meta);

    const arrow=document.createElement('div');
    arrow.textContent='›';
    arrow.style.fontSize='26px';

    b.appendChild(left);
    b.appendChild(arrow);
    b.onclick=()=>selectWiFi(n.ssid,n.saved);

    list.appendChild(b);
  });

  box.innerHTML='';
  box.appendChild(list);
}

async function scanWiFi(){
  const btn=document.getElementById('scanWifiBtn');
  const status=document.getElementById('wifiScanStatus');
  const box=document.getElementById('wifiScanResults');

  btn.disabled=true;
  btn.textContent='RECHERCHE...';
  status.textContent='Recherche des reseaux 2.4 GHz...';
  box.innerHTML='';

  try{
    const start=await fetch('/api/wifiscan/start?t='+Date.now(),{
      cache:'no-store'
    });

    if(!start.ok)throw new Error('start HTTP '+start.status);

    for(let attempt=0;attempt<40;attempt++){
      await waitMs(400);

      try{
        const r=await fetch('/api/wifiscan/result?t='+Date.now(),{
          cache:'no-store'
        });

        if(!r.ok)continue;

        const data=await r.json();

        if(data.state==='ready'){
          renderWiFiResults(data);
          return;
        }

        if(data.state==='failed'){
          throw new Error('scan failed');
        }
      }catch(e){}
    }

    status.textContent='Le scan prend trop de temps. Reessaie.';
  }catch(e){
    status.textContent='Erreur detection Wi-Fi : '+e.message;
  }finally{
    btn.disabled=false;
    btn.textContent='📡 DETECTER LES WI-FI';
  }
}

async function startupTest(){
  await fetch('/api/startup',{cache:'no-store'});
}

async function rebootDevice(){
  if(!confirm('Redemarrer l ESP ?'))return;
  await fetch('/reboot',{method:'POST'});
}

async function factoryReset(){
  if(!confirm('Effacer toute la configuration ?'))return;
  await fetch('/factoryReset',{method:'POST'});
}
</script>
)SETJS";


static const char MACRO_PAGE_JS[] PROGMEM = R"MACROJS(
<script>
let saveTimer=null;
let previewTimer=null;
let savePromise=null,saveDirty=false,unsaved=false;
let previewBusy=false,pendingPreview=null;

async function macroRequest(url){
  const controller=new AbortController(),timer=setTimeout(()=>controller.abort(),3000);
  try{
    const r=await fetch(url,{cache:'no-store',signal:controller.signal});
    if(!r.ok)throw new Error('HTTP '+r.status);
    return r;
  }finally{clearTimeout(timer);}
}

function params(){
  const q=new URLSearchParams();

  q.set('i',macroIndex);
  q.set('name',document.getElementById('macroName').value);
  q.set('directColor',document.getElementById('directColor').value);
  q.set('directIntensity',document.getElementById('directIntensity').value);
  q.set('directMotion',document.getElementById('directMotion').value);
  q.set('motionCycle',document.getElementById('motionCycle').value);
  q.set('idleOff',document.getElementById('idleOff').checked?'1':'0');
  q.set('idleColor',document.getElementById('idleColor').value);
  q.set('idleIntensity',document.getElementById('idleIntensity').value);
  q.set('alertAnimation',document.getElementById('alertAnimation').value);
  q.set('alertDuration',document.getElementById('alertDuration').value);
  q.set('blinkMs',document.getElementById('blinkMs').value);

  return q;
}

function saveState(text,color){
  const e=document.getElementById('autosave');
  e.textContent=text;
  e.style.color=document.documentElement.dataset.theme==='dark'?(color==='#26754a'?'#8ac9a2':color==='#b43d45'?'#f3b2b7':'#edbe80'):color;
}

function scheduleSave(){
  unsaved=true;
  saveState('Modifications en attente…','#986100');
  clearTimeout(saveTimer);
  saveTimer=setTimeout(saveNow,650);
}

async function saveNow(){
  clearTimeout(saveTimer);saveTimer=null;
  unsaved=true;
  if(savePromise){saveDirty=true;return savePromise;}
  savePromise=(async()=>{
    try{
      do{
        saveDirty=false;
        const snapshot=params().toString();
        saveState('Enregistrement…','#986100');
        await macroRequest('/api/macroSave?'+snapshot);
        if(snapshot!==params().toString())saveDirty=true;
      }while(saveDirty);
      unsaved=false;
      saveState('✓ Tous les réglages sont enregistrés','#26754a');
      return true;
    }catch(e){
      saveState('Non enregistré · vérifiez la connexion et réessayez.','#b43d45');
      return false;
    }finally{savePromise=null;}
  })();
  return savePromise;
}

function preview(state){
  clearTimeout(previewTimer);
  pendingPreview=state;
  previewTimer=setTimeout(flushPreview,100);
}

async function flushPreview(){
  if(previewBusy||pendingPreview===null)return;
  previewBusy=true;
  const state=pendingPreview;pendingPreview=null;
  const q=params();q.set('state',state);
  try{await macroRequest('/api/macroPreview?'+q.toString());}
  catch(e){saveState('Aperçu non confirmé · vérifiez la connexion.','#986100');}
  finally{previewBusy=false;if(pendingPreview!==null)previewTimer=setTimeout(flushPreview,100);}
}

function updateIdleControls(){
  const off=document.getElementById('idleOff').checked;
  document.getElementById('idleControls').style.opacity=off?'.38':'1';
  document.getElementById('idleColor').disabled=off;
  document.getElementById('idleIntensity').disabled=off;
}

function updateMotionControls(){
  const custom=Number(document.getElementById('directMotion').value)>=32;
  const cycle=document.getElementById('motionCycle');cycle.disabled=custom;cycle.hidden=custom;
  document.querySelector('label[for="motionCycle"]').hidden=custom;
}
function updateAnimationHelp(){
  const v=parseInt(document.getElementById('alertAnimation').value||'0',10);
  const e=document.getElementById('animationHelp');

  const txt=[
    'DIRECT / HORS DIRECT a vitesse constante.',
    'Boucle : 100 % instantane → fade jusqu a 0 % → retour instantane a 100 %.',
    'Un seul passage sur toute la duree : vert → jaune → rouge.',
    'DIRECT / HORS DIRECT accelere progressivement sur toute la duree.',
    'Deux flashs courts suivis d une pause, repetes pendant la duree.',
    'Un point lumineux avec une queue fait le tour des 36 LED du logo.',
    'Le contour du logo se dessine LED par LED puis recommence.',
    'Le faisceau traverse le logo de gauche à droite.',
    'Le faisceau traverse le logo de droite à gauche.',
    'Le logo respire, sans dépasser son intensité réglée.',
    'La lumière s’ouvre depuis le centre du logo.',
    'Un arc-en-ciel traverse le logo.',
    'Balayage vers le bas, uniquement sur les côtés.',
    'Balayage vers le haut, uniquement sur les côtés.',
    'La séquence personnalisée d’alerte boucle pendant la durée réglée, puis le DIRECT reprend.'
  ];

  document.getElementById('blinkMs').disabled=v>=32;
  e.textContent=v>=32?'Cette séquence boucle pendant l’alerte, puis le DIRECT reprend.':txt[v]||txt[0];
}

async function testAlert(){
  if(!await saveNow())return;
  let r;
  try{r=await macroRequest('/api/alertTest?i='+macroIndex);}
  catch(e){saveState('Test non confirmé · vérifiez la connexion.','#986100');return;}

  // Le test se termine automatiquement TOUT ETEINT.
  // Aucun retour au menu principal n'est necessaire.
  return r;
}

async function deleteLogo(){
  if(!confirm('Remettre le logo d origine ?'))return;

  await fetch('/deleteLogo?i='+macroIndex,{
    method:'POST'
  });

  location.reload();
}

updateIdleControls();
updateMotionControls();
updateAnimationHelp();
document.querySelectorAll('a[href]').forEach(a=>a.addEventListener('click',async e=>{
  if(!unsaved&&!savePromise&&!saveTimer)return;
  e.preventDefault();
  if(await saveNow())location.href=a.href;
}));
window.addEventListener('beforeunload',e=>{if(unsaved||savePromise){e.preventDefault();e.returnValue='';}});
</script>
)MACROJS";


void beginChunkedHtml() {
  server.setContentLength(CONTENT_LENGTH_UNKNOWN);

  server.sendHeader("Cache-Control","no-store, no-cache, must-revalidate");
  server.sendHeader("Pragma","no-cache");
  server.sendHeader("Connection","close");

  server.send_P(200,PSTR("text/html; charset=utf-8"),PSTR(""));
}

void sendHtmlChunk(const String& chunk) {
  server.sendContent(chunk);
  yield();
}

void endChunkedHtml() {
  server.sendContent_P(PSTR(""));
  yield();
}



static const char UI_ENHANCEMENT_JS[] PROGMEM = R"UIJS(
<script>
document.querySelectorAll('[data-theme-choice]').forEach(b=>b.setAttribute('aria-pressed',String(b.dataset.themeChoice===document.documentElement.dataset.theme)));
function revealSection(){const id=location.hash.slice(1),node=document.getElementById(id);if(node&&node.tagName==='DETAILS')node.open=true;}
window.addEventListener('hashchange',revealSection);revealSection();
document.querySelectorAll('label').forEach((label,i)=>{if(label.querySelector('input')||label.htmlFor)return;const field=label.nextElementSibling;if(field&&/^(INPUT|SELECT)$/.test(field.tagName)){if(!field.id)field.id='field-'+i;label.htmlFor=field.id;}});
document.querySelectorAll('input[type=password]').forEach(input=>{const wrap=document.createElement('div');wrap.className='password-wrap';input.before(wrap);wrap.append(input);const b=document.createElement('button');b.type='button';b.className='password-toggle';b.textContent='Afficher';b.setAttribute('aria-label','Afficher le mot de passe');b.setAttribute('aria-pressed','false');b.onclick=()=>{const show=input.type==='password';input.type=show?'text':'password';b.textContent=show?'Masquer':'Afficher';b.setAttribute('aria-pressed',String(show));b.setAttribute('aria-label',(show?'Masquer':'Afficher')+' le mot de passe');};wrap.append(b);});
</script>
)UIJS";

void sendSettingsPage() {
  if(!webMemoryReady())return;
  Serial.println(
    "[WEB] GET /settings stream | heap=" + String(ESP.getFreeHeap()) +
    " | maxblock=" + String(ESP.getMaxFreeBlockSize())
  );

  beginChunkedHtml();

  {
  String c;
  c.reserve(2200);

  c = F("<!doctype html><html lang='fr'><head><meta charset='utf-8'>"
    "<meta name='viewport' content='width=device-width,initial-scale=1'>"
    "<title>Réglages · ON AIR</title>"
    "<style>html,body{margin:0;background:#f3f4f8;color:#191a20}</style>"
    "<script>(function(){var m;try{m=localStorage.getItem('onair-theme')}catch(e){}if(m!=='dark'&&m!=='light')m=matchMedia('(prefers-color-scheme: dark)').matches?'dark':'light';window.setTheme=function(v){if(v!=='dark'&&v!=='light')return;document.documentElement.dataset.theme=v;try{localStorage.setItem('onair-theme',v)}catch(e){}document.querySelectorAll('[data-theme-choice]').forEach(function(b){b.setAttribute('aria-pressed',String(b.dataset.themeChoice===v))})};document.documentElement.dataset.theme=m})()</script><link rel='stylesheet' href='/style.css?v=343'>"
    "</head><body>"
    "<header class='top'><div class='title'>Réglages</div>"
    "<a class='iconbtn' href='/'>← Console</a></header>"
    "<main class='wrap'>"
    ""
    "<nav class='jumpnav' aria-label='Rubriques'><a href='#macros'>Émissions</a>"
    "<a href='#animations'>Éditeur d’animation</a><a href='#general'>Boîtier</a><a href='#network'>Wi-Fi</a><a href='#system'>Système</a></nav>");
  sendHtmlChunk(c);
  c = F("");
  sendHtmlFlash(PSTR("<section class='section'><h2>Apparence</h2><div class='theme-choice' role='group' aria-label='Thème'>"
    "<button type='button' data-theme-choice='light' onclick=\"setTheme('light')\" aria-pressed='false'>☀ Clair</button>"
    "<button type='button' data-theme-choice='dark' onclick=\"setTheme('dark')\" aria-pressed='false'>☾ Sombre</button></div></section>"));
  sendHtmlFlash(PSTR(
    "<section id='macros' class='section settings-macros'><h2>Vos émissions</h2>"
    "<div class='small' style='margin-bottom:12px'>"
    ""
    "</div>"
  ));

  for (uint8_t i = 0; i < MACRO_COUNT; i++) {
    MacroConfig& m = config.macro[i];

    c.reserve(1500);
    c = F("<a href='/macro?i=");
    c += String(i);
    c += F("' style='text-decoration:none;color:inherit'>");
    c += F("<div class='wifirow' style='margin-bottom:8px'>");
    c += F("<div style='display:flex;align-items:center;gap:10px;min-width:0'>");

    if (logoAvailable(i)) {
      c += F("<img class='logo' style='width:46px;height:46px' alt='' src='/logo?i=");
      c += String(i);
      c += F("'>");
    } else {
      c += F("<div class='nologo' style='width:46px;height:46px'>LOGO</div>");
    }

    c += F("<div style='min-width:0'><div class='wifiname'>");
    c += htmlEscape(String(m.name));
    c += F("</div><div class='wifimeta'>");
    c += String(m.intensity);
    c += F("%");

    if (m.idleOff) {
      c += F(" · HORS DIRECT eteint");
    } else {
      c += F(" · HORS DIRECT ");

      c += String(m.idleIntensity);
      c += F("%");
    }

    c += F("</div></div></div><div style='font-size:26px'>›</div></div></a>");

    sendHtmlChunk(c);
    c = F("");
  }

  sendHtmlFlash(PSTR("</section>"));
  sendHtmlFlash(PSTR("<a id='animations' class='section library-entry' href='/animation'><span>Éditeur d’animation</span><span aria-hidden='true'>›</span></a>"));

  c = F("<form method='POST' action='/saveGeneral'>"
    "<details id='general' class='section'><summary>Identité du boîtier</summary>"
    "<label>Nom de l'appareil</label><input name='deviceName' maxlength='32' value='");

  c += htmlEscape(config.deviceName);
  c += F("'><label>Nom du Wi-Fi du boîtier</label>");
  c += F("<input name='apSSID' maxlength='32' value='");
  c += htmlEscape(config.apSSID);
  c += F("'><label>Mot de passe Wi-Fi</label>");
  c += F("<input name='apPassword' type='password' minlength='8' maxlength='64' placeholder='laisser vide pour conserver'>");
  c += F("<label><input type='checkbox' name='startupAnimation' value='1' style='width:auto;margin-right:8px'");

  if (config.startupAnimation) c += F(" checked");

  c += F("> Cinématique et indications Wi-Fi au démarrage</label>");
  c += F("<button class='save' type='submit'>ENREGISTRER LE BOÎTIER</button>");
  c += F("<div class='small' style='margin-top:10px'>Changer le SSID ou le mot de passe redemarre l ESP.</div>");
  c += F("</details></form>");

  sendHtmlChunk(c);
  c = F("");

  c.reserve(2500);
  c = F("<form method='POST' action='/saveExternalWiFi'>"
    "<details id='network' class='section'><summary>Connexion Wi-Fi externe</summary>"
    "<label><input id='externalWiFiEnabled' type='checkbox' name='externalWiFiEnabled' value='1' style='width:auto;margin-right:8px'");

  if (config.externalWiFiEnabled) c += F(" checked");

  c += F("> Connecter aussi l ESP a un reseau Wi-Fi externe</label>");
  c += F("<button id='scanWifiBtn' type='button' class='save' style='width:100%;margin-top:10px' onclick='scanWiFi()'>📡 DETECTER LES WI-FI</button>");
  c += F("<div id='wifiScanStatus' class='small' style='margin-top:8px'>Appuie sur le bouton pour rechercher les reseaux 2.4 GHz.</div>");
  c += F("<div id='wifiScanResults' style='margin-top:10px'></div>");
  c += F("<label>SSID du reseau externe</label>");
  c += F("<input id='externalSSID' name='externalSSID' maxlength='32' value='' placeholder='Selectionne un Wi-Fi ci-dessus'>");
  c += F("<label>Mot de passe</label>");
  c += F("<input id='externalPassword' name='externalPassword' type='password' maxlength='64' placeholder='vide = conserver le mot de passe memorise'>");
  c += F("<div class='small' style='margin-top:12px;padding:12px;background:#f4f5f9;border:0;border-radius:14px'>");
  c += F("<b>ACCES AU BOITIER</b><br>");
  c += F("Direct : <b>");
  c += htmlEscape(String(config.apSSID));
  c += F("</b> → <b>http://192.168.4.1</b><br>");
  c += F("Via le routeur : <b>http://onair-moc.local</b></div>");
  c += F("<div class='small' style='margin-top:12px'>");

  if (config.externalWiFiEnabled) {
    if (WiFi.status() == WL_CONNECTED) {
      c += F("Etat : <b style='color:#65d487'>CONNECTE</b><br>");
      c += F("Reseau : <b>");
      c += htmlEscape(WiFi.SSID());
      c += F("</b><br>IP actuelle : <b>");
      c += WiFi.localIP().toString();
      c += F("</b>");
    } else {
      c += F("Etat : <b style='color:#ffbc42'>ACTIF - EN ATTENTE D UN RESEAU MEMORISE</b>");
    }
  } else {
    c += F("Connexion externe : desactivee");
  }

  c += F("</div>");
  c += F("<button class='save' type='submit'>ENREGISTRER ET CONNECTER</button>");
  c += F("</details></form>");

  sendHtmlChunk(c);
  c = F("");

  sendHtmlFlash(PSTR("<details class='section'><summary>Réseaux mémorisés</summary>"));

  if (config.knownWiFiCount == 0) {
    sendHtmlFlash(PSTR("<div class='small'>Aucun reseau memorise.</div>"));
  } else {
    sendHtmlFlash(PSTR("<div class='wifilist'>"));

    for (uint8_t k = 0; k < config.knownWiFiCount; k++) {
      c.reserve(900);
      c = F("<div class='wifirow' style='cursor:default'><div style='min-width:0'>");
      c += F("<div class='wifiname'>");
      c += htmlEscape(String(config.knownWiFi[k].ssid));
      c += F("</div><div class='wifimeta'>Mot de passe memorise dans l ESP</div></div>");
      c += F("<button type='button' style='min-height:38px;padding:6px 10px;background:#fff0f0;color:#b3434a' onclick='forgetWiFi(");
      c += String(k);
      c += F(")'>OUBLIER</button></div>");

      sendHtmlChunk(c);
      c = F("");
    }

    sendHtmlFlash(PSTR("</div>"));
  }

  sendHtmlFlash(PSTR("</details>"));

  c.reserve(2300);
  c = F("<details id='system' class='section'><summary>Système & maintenance</summary><div class='small'>");
  c += F("Firmware : ");
  c += String(FIRMWARE_VERSION);
  c += F("<br>Wi-Fi autonome : ");
  c += htmlEscape(String(config.apSSID));
  c += F("<br>Adresse : http://192.168.4.1");

  if (WiFi.status() == WL_CONNECTED) {
    c += F("<br>Wi-Fi externe : ");
    c += htmlEscape(WiFi.SSID());
    c += F("<br>IP externe : http://");
    c += WiFi.localIP().toString();
    c += F("<br>Acces stable : http://onair-moc.local");
  }

  c += F("</div>");
  c += F("<a class='save' style='display:block;text-align:center;text-decoration:none;padding:16px' href='/diagnostics'>DIAGNOSTIC</a>");
  c += F("<a class='save' style='display:block;text-align:center;text-decoration:none;padding:16px;background:#eef1f8;color:#405d88' href='/config/export'>EXPORTER LA CONFIGURATION</a>");
  c += F("<div class='filebox' style='margin-top:12px'>");
  c += F("<label style='margin-top:0'>Restaurer une configuration</label>");
  c += F("<div class='small'>Le fichier de backup contient aussi les mots de passe Wi-Fi.</div>");
  c += F("<form method='POST' action='/config/import' enctype='multipart/form-data'>");
  c += F("<input type='file' name='backup' accept='.cfg,application/octet-stream'>");
  c += F("<button class='save' type='submit'>IMPORTER LE BACKUP</button></form></div>");
  c += F("<a class='save' style='display:block;text-align:center;text-decoration:none;padding:16px;background:#eef1f8;color:#405d88' href='/firmware'>METTRE À JOUR LE BOÎTIER</a>");
  c += F("<div class='small' style='margin-top:7px'>Charge un fichier .bin compile pour cet ESP8266.</div>");
  c += F("<button type='button' class='direct' style='width:100%;margin-top:12px' onclick='startupTest()'>TEST ANIMATION DEMARRAGE</button>");
  c += F("<button type='button' class='danger' onclick='rebootDevice()'>REDÉMARRER LE BOÎTIER</button>");
  c += F("<button type='button' class='danger' onclick='factoryReset()'>RÉINITIALISER LA CONFIGURATION</button>");
  c += F("</details>");

  sendHtmlChunk(c);
  c = F("");

  c=String();
  server.sendContent_P(SETTINGS_PAGE_JS);
  server.sendContent_P(UI_ENHANCEMENT_JS);
  sendHtmlFlash(PSTR("</main></body></html>"));
  endChunkedHtml();

  }

  Serial.println(
    "[WEB] /settings stream termine | heap=" + String(ESP.getFreeHeap()) +
    " | maxblock=" + String(ESP.getMaxFreeBlockSize())
  );
}


void sendMacroSettingsPage(uint8_t i) {
  if(!webMemoryReady())return;
  if (i >= MACRO_COUNT) {
    server.send_P(400,PSTR("text/plain"),PSTR("Macro invalide"));
    return;
  }

  MacroConfig& m = config.macro[i];

  Serial.println(
    "[WEB] GET /macro stream " + String(i + 1) +
    " | heap=" + String(ESP.getFreeHeap()) +
    " | maxblock=" + String(ESP.getMaxFreeBlockSize())
  );

  beginChunkedHtml();

  {
  String c;
  c.reserve(2200);

  c = F("<!doctype html><html lang='fr'><head><meta charset='utf-8'>"
    "<meta name='viewport' content='width=device-width,initial-scale=1'>"
    "<title>Macro ");

  c += String(i + 1);
  c += F("</title>");
  c += F("<style>html,body{margin:0;background:#f3f4f8;color:#191a20}</style>");
  c += F("<script>(function(){var m;try{m=localStorage.getItem('onair-theme')}catch(e){}if(m!=='dark'&&m!=='light')m=matchMedia('(prefers-color-scheme: dark)').matches?'dark':'light';window.setTheme=function(v){if(v!=='dark'&&v!=='light')return;document.documentElement.dataset.theme=v;try{localStorage.setItem('onair-theme',v)}catch(e){}document.querySelectorAll('[data-theme-choice]').forEach(function(b){b.setAttribute('aria-pressed',String(b.dataset.themeChoice===v))})};document.documentElement.dataset.theme=m})()</script><link rel='stylesheet' href='/style.css?v=343'></head><body>");
  c += F("<header class='top'><div class='title macro-title'>Émission ");
  c += String(i + 1);
  c += F(" — ");
  c += htmlEscape(String(m.name));
  c += F("</div><a class='iconbtn' href='/settings#macros'>← Émissions</a></header>");
  c += F("<main class='wrap'><div class='section'>");

  if (logoAvailable(i)) {
    c += F("<div style='display:flex;justify-content:center;margin-bottom:14px'>");
    c += F("<img alt='' class='logo' style='width:64px;height:64px' src='/logo?i=");
    c += String(i);
    c += F("'></div>");
  }

  c += F("<div id='autosave' class='autosave' role='status' aria-live='polite'>Tous les réglages sont enregistrés</div>");
  c += F("<label>Nom de l’émission</label><input id='macroName' maxlength='24' value='");
  c += htmlEscape(String(m.name));
  c += F("' oninput='scheduleSave()'>");

  sendHtmlChunk(c);
  c = F("");

  c.reserve(2100);
  c = F("<section class='fieldgroup'>");
  c += F("<h3>En direct</h3><p>La signature lumineuse de cette émission.</p><div class='grid2'>");
  c += F("<div><label>Couleur DIRECT</label><input id='directColor' type='color' value='");
  c += rgbToHex(m.r,m.g,m.b);
  c += F("' oninput=\"preview('direct');scheduleSave()\" onchange='saveNow()'></div>");
  c += F("<div><label>Intensité DIRECT : <span id='directIv'>");
  c += String(m.intensity);
  c += F("%</span></label><input id='directIntensity' type='range' min='0' max='100' value='");
  c += String(m.intensity);
  c += F("' oninput=\"document.getElementById('directIv').textContent=this.value+'%';preview('direct');scheduleSave()\" onchange='saveNow()'></div>");
  c += F("</div><label for='directMotion'>Animation en direct</label><select id='directMotion' onchange=\"updateMotionControls();preview('direct');saveNow()\">");
  c += F("<option value='0'");if(motionSettings.mode[i]==0)c += F(" selected");c += F(">Fixe</option>");
  c += F("<option value='1'");if(motionSettings.mode[i]==1)c += F(" selected");c += F(">Respiration</option>");
  c += F("<option value='2'");if((motionSettings.mode[i]==2||motionSettings.mode[i]==3||motionSettings.mode[i]==5))c += F(" selected");c += F(">Balayage gauche ↔ droite</option>");
  c += F("<option value='4'");if(motionSettings.mode[i]==4)c += F(" selected");c += F(">Comète autour du logo</option>");
  c += F("<option value='6'");if(motionSettings.mode[i]==6)c += F(" selected");c += F(">Arc-en-ciel</option>");
  c += F("<option value='7'");if(motionSettings.mode[i]==7)c += F(" selected");c += F(">Ouverture depuis le centre</option>");
  c += F("<option value='8'");if((motionSettings.mode[i]==8||motionSettings.mode[i]==9))c += F(" selected");c += F(">Balayage haut ↔ bas</option>");
  if(motionSettings.mode[i]==10)c += F("<option value='10' selected>Ancienne séquence DIRECT</option>");
  c += libraryOptions(motionSettings.mode[i]);
  c += F("</select><label for='motionCycle'>Durée d’un cycle</label><select id='motionCycle' onchange=\"preview('direct');saveNow()\">");
  const uint16_t cycles[]={1000,2000,3000,4000,6000,8000,12000};
  for(uint8_t n=0;n<7;n++){
    c += F("<option value='");c += String(cycles[n]);c += F("'");
    if(motionSettings.cycleMs[i]==cycles[n])c += F(" selected");
    c += F(">");c += String(cycles[n]/1000);c += F(" s</option>");
  }
  c += F("</select><div class='editor-link'><a class='save' href='/animation'>Éditeur d’animation →</a></div></section>");

  sendHtmlChunk(c);
  c = F("");

  c.reserve(2200);
  c = F("<section class='fieldgroup'>");
  c += F("<h3>Hors direct</h3><label>");
  c += F("<input id='idleOff' type='checkbox' style='width:auto;margin-right:8px'");

  if (m.idleOff) c += F(" checked");

  c += F(" onchange=\"updateIdleControls();preview('idle');saveNow()\">");
  c += F(" Eteindre completement le ON AIR hors direct</label>");
  c += F("<div id='idleControls' class='grid2'>");
  c += F("<div><label>Couleur HORS DIRECT</label><input id='idleColor' type='color' value='");
  c += rgbToHex(m.idleR,m.idleG,m.idleB);
  c += F("' oninput=\"preview('idle');scheduleSave()\" onchange='saveNow()'></div>");
  c += F("<div><label>Intensité HORS DIRECT : <span id='idleIv'>");
  c += String(m.idleIntensity);
  c += F("%</span></label><input id='idleIntensity' type='range' min='0' max='100' value='");
  c += String(m.idleIntensity);
  c += F("' oninput=\"document.getElementById('idleIv').textContent=this.value+'%';preview('idle');scheduleSave()\" onchange='saveNow()'></div>");
  c += F("</div><div class='small' style='margin-top:8px'>État lumineux lorsque cette émission quitte le DIRECT.</div></section>");

  sendHtmlChunk(c);
  c = F("");

  c.reserve(2500);
  c = F("<section class='fieldgroup'>");
  c += F("<h3>Alerte</h3><p>Une séquence d’alerte, puis le passage automatique en DIRECT.</p>");
  c += F("<label>Animation</label><select id='alertAnimation' onchange='updateAnimationHelp();saveNow()'>");

  c += F("<option value='0'");
  if (m.alertAnimation == ALERT_CLASSIC) c += F(" selected");
  c += F(">Clignotement classique</option>");

  c += F("<option value='1'");
  if (m.alertAnimation == ALERT_FADE_TO_BLACK) c += F(" selected");
  c += F(">Flash 100% → fade 0% (boucle)</option>");

  c += F("<option value='2'");
  if (m.alertAnimation == ALERT_TRAFFIC_GRADIENT) c += F(" selected");
  c += F(">Gradient vert → jaune → rouge (1 passage)</option>");

  c += F("<option value='3'");
  if (m.alertAnimation == ALERT_ACCELERATING) c += F(" selected");
  c += F(">Clignotement accelere</option>");

  c += F("<option value='4'");
  if (m.alertAnimation == ALERT_DOUBLE_FLASH) c += F(" selected");
  c += F(">Double flash / heartbeat</option>");

  c += F("<option value='5'");
  if (m.alertAnimation == ALERT_LOGO_CHASE) c += F(" selected");
  c += F(">Logo : point lumineux tournant</option>");

  c += F("<option value='6'");
  if (m.alertAnimation == ALERT_LOGO_DRAW) c += F(" selected");
  c += F(">Logo : dessin progressif du contour</option>");
  c += F("<option value='7'");if((m.alertAnimation==7||m.alertAnimation==8))c += F(" selected");c += F(">Balayage gauche ↔ droite</option>");
  c += F("<option value='9'");if(m.alertAnimation==9)c += F(" selected");c += F(">Respiration</option>");
  c += F("<option value='10'");if(m.alertAnimation==10)c += F(" selected");c += F(">Ouverture depuis le centre</option>");
  c += F("<option value='11'");if(m.alertAnimation==11)c += F(" selected");c += F(">Arc-en-ciel horizontal</option>");
  c += F("<option value='12'");if((m.alertAnimation==ALERT_SWEEP_TB||m.alertAnimation==ALERT_SWEEP_BT))c += F(" selected");c += F(">Balayage haut ↔ bas</option>");
  if(m.alertAnimation==ALERT_CUSTOM)c += F("<option value='14' selected>Ancienne séquence ALERTE</option>");
  c += libraryOptions(m.alertAnimation);
  c += F("</select>");
  c += F("<div class='editor-link'><a class='save' href='/animation'>Éditeur d’animation →</a></div>");


  c += F("<div id='animationHelp' class='small' style='margin-top:7px'></div>");
  c += F("<div class='grid2'><div><label>Durée de l’alerte</label>");
  c += F("<input id='alertDuration' type='number' min='1' max='60' value='");
  c += String(m.alertDuration);
  c += F("' onchange='saveNow()'><div class='small'>secondes</div></div>");
  c += F("<div><label>Vitesse / rythme</label>");
  c += F("<input id='blinkMs' type='number' min='100' max='2000' step='50' value='");
  c += String(m.blinkMs);
  c += F("' onchange='saveNow()'><div class='small'>100 ms = rapide · 2000 ms = lent</div></div></div>");
  c += F("<div class='small' style='margin-top:10px'>La fin de l alerte passe automatiquement en DIRECT.</div>");
  c += F("<div class='testrow'><button type='button' class='direct' onclick=\"preview('direct')\">APERÇU DIRECT</button>");
  c += F("<button type='button' class='alert' onclick='testAlert()'>TEST ALERTE</button></div></section>");

  sendHtmlChunk(c);
  c = F("");

  c.reserve(2000);
  c = F("<div class='filebox' style='margin-top:16px'><label style='margin-top:0'>Logo PNG / JPG</label>");

  if (logoAvailable(i)) {
    c += F("<div style='display:flex;align-items:center;gap:12px;margin-bottom:10px'>");
    c += F("<img alt='' class='logo' src='/logo?i=");
    c += String(i);
    c += F("'><div class='small'>");

    if (isBuiltinLogo(String(m.logoPath))) c += F("Logo integre");
    else c += htmlEscape(String(m.logoPath));

    c += F("</div></div>");
  }

  c += F("<form method='POST' action='/uploadLogo?i=");
  c += String(i);
  c += F("' enctype='multipart/form-data'>");
  c += F("<input type='file' name='logo' accept='.png,.jpg,.jpeg,image/png,image/jpeg'>");
  c += F("<button class='save' type='submit'>IMPORTER LE LOGO</button></form>");

  if (strlen(m.logoPath) && !isBuiltinLogo(String(m.logoPath))) {
    c += F("<button type='button' class='danger' onclick='deleteLogo()'>REMETTRE LE LOGO D ORIGINE</button>");
  }

  c += F("</div><button type='button' class='save' onclick='saveNow()'>ENREGISTRER MAINTENANT</button></div>");

  sendHtmlChunk(c);
  c = F("");

  c = F("<script>const macroIndex=");
  c += String(i);
  c += F(";</script>");
  sendHtmlChunk(c);

  c=String();
  server.sendContent_P(MACRO_PAGE_JS);
  server.sendContent_P(UI_ENHANCEMENT_JS);
  sendHtmlFlash(PSTR("</main></body></html>"));
  endChunkedHtml();

  }

  Serial.println(
    "[WEB] /macro stream termine | heap=" + String(ESP.getFreeHeap()) +
    " | maxblock=" + String(ESP.getMaxFreeBlockSize())
  );
}


String statusJSON() {
  String j;
  j.reserve(260);

  j = "{";

  j += "\"output_enabled\":";
  j += outputEnabled ? "true" : "false";

  j += ",\"alert_running\":";
  j += alertRunning ? "true" : "false";

  j += ",\"alert_visible\":";
  j += alertVisible ? "true" : "false";

  j += ",\"alert_macro\":";
  j += String(alertMacro);

  j += ",\"led_hex\":\"";
  j += rgbToHex(currentLedR,currentLedG,currentLedB);
  j += "\"";

  j += ",\"led_intensity\":";
  j += String(currentLedIntensity);

  j += ",\"active_macro\":";
  j += String(activeMacro);

  j += ",\"active_name\":\"";
  if (activeMacro >= 0 && activeMacro < MACRO_COUNT) {
    j += jsonEscape(String(config.macro[activeMacro].name));
  }
  j += "\"";

  j += "}";

  return j;
}

bool parseMacroIndex(uint8_t& i) {
  if (!server.hasArg("i")) return false;
  int v = server.arg("i").toInt();
  if (v < 0 || v >= MACRO_COUNT) return false;
  i = (uint8_t)v;
  return true;
}


void redirectHome() {
  server.sendHeader("Location", "/", true);
  server.send_P(302,PSTR("text/plain"),PSTR(""));
}

void sendStatusResponse() {
  server.sendHeader("Cache-Control","no-store");
  server.sendHeader("Connection","close");
  server.send(200,"application/json",statusJSON());
}

void handleDirect() {
  uint8_t i;

  if (!parseMacroIndex(i)) {
    server.send_P(400,PSTR("application/json"),PSTR("{\"error\":\"macro invalide\"}"));
    return;
  }

  // Ne permet aucune commande DIRECT pendant une alerte.
  if (alertRunning) {
    server.sendHeader("Connection","close");
    sendStatusResponse();
    return;
  }

  // Appui sur le DIRECT deja actif = retour HORS DIRECT.
  if (outputEnabled && activeMacro == i) {
    applyMacroIdle(i);
    sendStatusResponse();
    return;
  }

  // Une autre macro est deja active : verrouillage.
  if (outputEnabled && activeMacro >= 0 && activeMacro != i) {
    Serial.println(F("[MACRO] DIRECT refuse : une autre macro est active"));
    sendStatusResponse();
    return;
  }

  applyMacro(i);
  sendStatusResponse();
}

void handleAlert() {
  uint8_t i;

  if (!parseMacroIndex(i)) {
    server.send_P(400,PSTR("application/json"),PSTR("{\"error\":\"macro invalide\"}"));
    return;
  }

  // Une alerte ne peut etre lancee que lorsque le ON AIR est eteint.
  if (alertRunning || outputEnabled) {
    Serial.println(F("[MACRO] ALERTE refusee : sortie deja active"));
    sendStatusResponse();
    return;
  }

  startAlert(i);
  sendStatusResponse();
}

void handleAlertTest() {
  uint8_t i;

  if (!parseMacroIndex(i)) {
    server.send_P(400,PSTR("application/json"),PSTR("{\"error\":\"macro invalide\"}"));
    return;
  }

  // On refuse seulement si un vrai DIRECT est actuellement actif.
  // Apres un test, le boitier revient automatiquement TOUT ETEINT.
  if (alertRunning || outputEnabled) {
    Serial.println(F("[MACRO] TEST ALERTE refuse : sortie deja active"));
    sendStatusResponse();
    return;
  }

  startAlert(i, true);
  sendStatusResponse();
}

void handleOff() {
  // OFF est volontairement prioritaire :
  // il annule DIRECT, HORS DIRECT ou ALERTE et met physiquement le RGB a noir.
  blackout();

  Serial.println(F("[ON AIR] OFF depuis interface"));

  sendStatusResponse();
}


void handleStatus() {
  server.sendHeader("Cache-Control","no-store");
  server.sendHeader("Connection","close");
  server.send(200,"application/json",statusJSON());
}

void redirectSettings() {
  server.sendHeader("Location", "/settings", true);
  server.send_P(303,PSTR("text/plain"),PSTR(""));
}

void handleSaveGeneral() {
  String deviceName = server.arg("deviceName");
  String apSSID = server.arg("apSSID");
  String apPassword = server.arg("apPassword");
  deviceName.trim(); apSSID.trim();

  if (deviceName.length() < 1 || deviceName.length() > 32) { server.send_P(400,PSTR("text/plain"),PSTR("Nom appareil invalide")); return; }
  if (apSSID.length() < 1 || apSSID.length() > 32) { server.send_P(400,PSTR("text/plain"),PSTR("SSID invalide")); return; }
  if (apPassword.length() > 0 && apPassword.length() < 8) { server.send_P(400,PSTR("text/plain"),PSTR("Mot de passe Wi-Fi : minimum 8 caracteres")); return; }

  bool wifiChanged = apSSID != String(config.apSSID) || apPassword.length() > 0;
  deviceName.toCharArray(config.deviceName, sizeof(config.deviceName));
  apSSID.toCharArray(config.apSSID, sizeof(config.apSSID));
  if (apPassword.length() > 0) apPassword.toCharArray(config.apPassword, sizeof(config.apPassword));
  config.startupAnimation = server.hasArg("startupAnimation");
  saveConfig();

  if (wifiChanged) {
    String page;
    page.reserve(2200);

    page = F("<!doctype html><html lang='fr'><head><meta charset='utf-8'>"
      "<meta name='viewport' content='width=device-width,initial-scale=1'>"
      "<style>"
      "body{font-family:Arial;background:#090b0e;color:#fff;padding:25px}"
      ".box{max-width:600px;margin:auto;background:#14181d;border:1px solid #2a3139;border-radius:16px;padding:22px}"
      "a{color:#69a7ff}"
      "</style></head><body><div class='box'>"
      "<h2>Wi-Fi enregistre</h2>"
      "<p>L'ESP va redemarrer avec le nouveau nom de reseau :</p><h3>");

    page += htmlEscape(String(config.apSSID));

    page += F("</h3><p>Reconnecte ton telephone a ce Wi-Fi, puis ouvre :</p>"
      "<p><b>http://192.168.4.1</b></p>"
      "<p>La page essaiera de revenir automatiquement a l'accueil.</p>"
      "<p><a href='http://192.168.4.1/'>OUVRIR LE CONTROLE</a></p>"
      "<script>"
      "setTimeout(function(){window.location.replace('http://192.168.4.1/');},7000);"
      "</script></div></body></html>");

    server.sendHeader("Connection", "close");
    server.send(200,"text/html; charset=utf-8",page);

    // Donne le temps au telephone de recevoir la page avant de couper l'ancien SSID.
    delay(2200);
    ESP.restart();
    return;
  }

  redirectSettings();
}

void clearWiFiScanResults() {
  wifiScanItemCount = 0;
  memset(wifiScanItems, 0, sizeof(wifiScanItems));
}

void beginWiFiScanAsync() {
  if (wifiScanRunning) return;

  Serial.println(F("[WIFI SCAN] Demarrage asynchrone..."));

  // Le point d'acces reste actif pendant le scan.
  if (WiFi.getMode() == WIFI_AP) {
    WiFi.mode(WIFI_AP_STA);
  }

  clearWiFiScanResults();
  wifiScanReady = false;
  wifiScanFailed = false;
  wifiScanRunning = true;

  WiFi.scanDelete();

  // async=true, show_hidden=false
  int result = WiFi.scanNetworks(true, false);

  // Sur ESP8266 un scan asynchrone renvoie normalement WIFI_SCAN_RUNNING (-1).
  // Une autre valeur negative est traitee comme un echec de lancement.
  if (result < -1) {
    wifiScanRunning = false;
    wifiScanFailed = true;
    Serial.println(F("[WIFI SCAN] ECHEC lancement"));
  }
}

void finishWiFiScan(int n) {
  clearWiFiScanResults();

  Serial.println("[WIFI SCAN] Resultat brut = " + String(n));

  if (n <= 0) {
    wifiScanRunning = false;
    wifiScanReady = true;
    wifiScanFailed = false;
    WiFi.scanDelete();

    Serial.println(F("[WIFI SCAN] Aucun reseau trouve"));
    return;
  }

  for (int i = 0; i < n && wifiScanItemCount < WIFI_SCAN_MAX_RESULTS; i++) {
    String ssid = WiFi.SSID(i);

    if (ssid.length() == 0) continue;

    // Evite les doublons de SSID dans la liste affichee.
    bool duplicate = false;

    for (uint8_t j = 0; j < wifiScanItemCount; j++) {
      if (ssid == String(wifiScanItems[j].ssid)) {
        duplicate = true;

        // Si le meme SSID est vu plusieurs fois, conserve le meilleur RSSI.
        if (WiFi.RSSI(i) > wifiScanItems[j].rssi) {
          wifiScanItems[j].rssi = WiFi.RSSI(i);
          wifiScanItems[j].channel = WiFi.channel(i);
          wifiScanItems[j].secure = WiFi.encryptionType(i) != ENC_TYPE_NONE;
          wifiScanItems[j].saved = isKnownWiFi(ssid);
        }

        break;
      }
    }

    if (duplicate) continue;

    WiFiScanItem& item = wifiScanItems[wifiScanItemCount];

    ssid.toCharArray(item.ssid, sizeof(item.ssid));
    item.rssi = WiFi.RSSI(i);
    item.channel = WiFi.channel(i);
    item.secure = WiFi.encryptionType(i) != ENC_TYPE_NONE;
    item.saved = isKnownWiFi(ssid);

    wifiScanItemCount++;
  }

  // Trie du meilleur au plus faible signal.
  for (uint8_t i = 0; i < wifiScanItemCount; i++) {
    for (uint8_t j = i + 1; j < wifiScanItemCount; j++) {
      if (wifiScanItems[j].rssi > wifiScanItems[i].rssi) {
        WiFiScanItem tmp = wifiScanItems[i];
        wifiScanItems[i] = wifiScanItems[j];
        wifiScanItems[j] = tmp;
      }
    }
  }

  WiFi.scanDelete();

  wifiScanRunning = false;
  wifiScanReady = true;
  wifiScanFailed = false;

  Serial.println(
    "[WIFI SCAN] Termine : " +
    String(wifiScanItemCount) +
    " reseau(x)"
  );
}

void updateWiFiScan() {
  if (wifiScanStartRequested && !wifiScanRunning) {
    wifiScanStartRequested = false;
    beginWiFiScanAsync();
  }

  if (!wifiScanRunning) return;

  int n = WiFi.scanComplete();

  // -1 = scan toujours en cours.
  if (n == -1) return;

  // Toute autre valeur negative = echec.
  if (n < 0) {
    wifiScanRunning = false;
    wifiScanReady = false;
    wifiScanFailed = true;
    WiFi.scanDelete();

    Serial.println(F("[WIFI SCAN] ECHEC pendant le scan"));
    return;
  }

  finishWiFiScan(n);
}

void handleWiFiScanStart() {
  Serial.println(F("[WIFI SCAN] Demande recue depuis interface"));

  // Si un scan est deja actif, l'interface peut simplement continuer
  // a interroger /result.
  if (wifiScanRunning || wifiScanStartRequested) {
    server.send(
      200,
      "application/json",
      "{\"ok\":true,\"state\":\"running\"}"
    );
    return;
  }

  wifiScanReady = false;
  wifiScanFailed = false;
  wifiScanStartRequested = true;

  // La reponse HTTP part AVANT le balayage radio.
  server.sendHeader("Connection","close");
  server.send(
    200,
    "application/json",
    "{\"ok\":true,\"state\":\"starting\"}"
  );
}

void handleWiFiScanResult() {
  String json;
  json.reserve(3500);

  if (wifiScanFailed) {
    server.send(
      200,
      "application/json",
      "{\"state\":\"failed\",\"networks\":[]}"
    );
    return;
  }

  if (wifiScanRunning || wifiScanStartRequested) {
    server.send(
      200,
      "application/json",
      "{\"state\":\"running\",\"networks\":[]}"
    );
    return;
  }

  if (!wifiScanReady) {
    server.send(
      200,
      "application/json",
      "{\"state\":\"idle\",\"networks\":[]}"
    );
    return;
  }

  json = F("{\"state\":\"ready\",\"networks\":[");

  for (uint8_t i = 0; i < wifiScanItemCount; i++) {
    if (i > 0) json += F(",");

    json += F("{");
    json += "\"ssid\":\"" + jsonEscape(String(wifiScanItems[i].ssid)) + "\",";
    json += "\"rssi\":" + String(wifiScanItems[i].rssi) + ",";
    json += "\"channel\":" + String(wifiScanItems[i].channel) + ",";
    json += F("\"secure\":");
    json += wifiScanItems[i].secure ? "true" : "false";
    json += F(",");
    json += F("\"saved\":");
    json += wifiScanItems[i].saved ? "true" : "false";
    json += F("}");
  }

  json += F("]}");

  server.send(200, "application/json; charset=utf-8", json);
}

void handleSaveExternalWiFi() {
  bool enabled = server.hasArg("externalWiFiEnabled");

  String ssid = server.arg("externalSSID");
  String password = server.arg("externalPassword");
  ssid.trim();

  if (enabled && ssid.length() == 0 && config.knownWiFiCount == 0) {
    server.send_P(400,PSTR("text/plain; charset=utf-8"),PSTR("Selectionne au moins un Wi-Fi a memoriser"));
    return;
  }

  if (ssid.length() > 32) {
    server.send_P(400,PSTR("text/plain; charset=utf-8"),PSTR("SSID externe invalide"));
    return;
  }

  if (password.length() > 0 && password.length() < 8) {
    server.send_P(400,PSTR("text/plain; charset=utf-8"),PSTR("Mot de passe externe : minimum 8 caracteres"));
    return;
  }

  config.externalWiFiEnabled = enabled;

  if (ssid.length() > 0) {
    int knownIndex = findKnownWiFi(ssid);

    if (knownIndex < 0 || password.length() > 0) {
      rememberWiFi(ssid, password);
    } else {
      // Reseau deja memorise + champ mot de passe vide :
      // on conserve le mot de passe et on remonte ce reseau en priorite 1.
      rememberWiFi(ssid, "");
    }
  }

  saveConfig();

  // IMPORTANT :
  // on ne redemarre PLUS l'ESP.
  // La nouvelle connexion sera appliquee dans loop() apres que cette
  // reponse HTTP ait ete entierement envoyee au telephone.
  pendingExternalWiFiApply = true;
  pendingExternalWiFiApplyAt = millis() + EXTERNAL_APPLY_DELAY_MS;

  String page;
  page.reserve(2400);

  page = F("<!doctype html><html lang='fr'><head><meta charset='utf-8'>"
    "<meta name='viewport' content='width=device-width,initial-scale=1'>"
    "<style>"
    "body{font-family:Arial;background:#090b0e;color:#fff;padding:22px}"
    ".box{max-width:560px;margin:auto;background:#14181d;border:1px solid #2a3139;border-radius:16px;padding:20px}"
    "a{display:block;margin-top:12px;padding:14px;border-radius:12px;background:#2878d0;color:#fff;text-decoration:none;text-align:center;font-weight:bold}"
    "</style></head><body><div class='box'>");

  if (enabled) {
    page += F("<h2>Wi-Fi memorise</h2>");

    if (ssid.length() > 0) {
      page += "<p>Reseau : <b>" + htmlEscape(ssid) + "</b></p>";
    }

    if (WiFi.status() == WL_CONNECTED &&
        ssid.length() > 0 &&
        WiFi.SSID() == ssid) {

      page += F("<p>L ESP est deja connecte a ce reseau. <b>Aucun redemarrage.</b></p>");
    } else {
      page += F("<p>Connexion en cours. <b>L ESP ne redemarre pas.</b></p>");
      page += F("<p>Le Wi-Fi ON_AIR-MOC reste actif. Il peut y avoir une tres courte coupure radio pendant le changement de canal.</p>");
    }

    page += F("<p>Depuis le meme routeur, utilise ensuite : <b>http://onair-moc.local</b></p>");
  } else {
    page += F("<h2>Wi-Fi externe desactive</h2>");
    page += F("<p>Le boitier reste accessible sur ON_AIR-MOC / 192.168.4.1.</p>");
  }

  page += F("<a href='/settings'>RETOUR AUX PARAMETRES</a>");
  page += F("<a href='/'>CONTROLE</a>");
  page += F("</div></body></html>");

  server.sendHeader("Cache-Control", "no-store");
  server.sendHeader("Connection", "close");
  server.send(200, "text/html; charset=utf-8", page);

  Serial.println(F("[WIFI EXT] Configuration sauvegardee SANS redemarrage"));
}

void handleForgetWiFi() {
  int index = server.arg("i").toInt();

  if (index < 0 || index >= config.knownWiFiCount) {
    server.send_P(400,PSTR("text/plain"),PSTR("Index Wi-Fi invalide"));
    return;
  }

  String removed = config.knownWiFi[index].ssid;
  bool wasConnected = WiFi.status() == WL_CONNECTED && WiFi.SSID() == removed;

  forgetKnownWiFi((uint8_t)index);
  saveConfig();

  if (wasConnected) {
    WiFi.disconnect();
    externalConnectStarted = false;
    mdnsStarted = false;
  }

  server.send_P(200,PSTR("text/plain"),PSTR("OK"));
}

bool readMacroRequest(uint8_t& idx,
                      String& name,
                      uint8_t& directR,
                      uint8_t& directG,
                      uint8_t& directB,
                      uint8_t& directIntensity,
                      bool& idleOff,
                      uint8_t& idleR,
                      uint8_t& idleG,
                      uint8_t& idleB,
                      uint8_t& idleIntensity,
                      uint8_t& alertAnimation,
                      uint8_t& alertDuration,
                      uint16_t& blinkMs) {

  int rawIndex = server.arg("i").toInt();

  if (rawIndex < 0 || rawIndex >= MACRO_COUNT) {
    return false;
  }

  idx = (uint8_t)rawIndex;

  name = server.arg("name");
  name.trim();

  if (name.length() < 1 || name.length() > 24) {
    return false;
  }

  if (!parseHexColor(server.arg("directColor"), directR, directG, directB)) {
    return false;
  }

  if (!parseHexColor(server.arg("idleColor"), idleR, idleG, idleB)) {
    return false;
  }

  directIntensity = constrain(server.arg("directIntensity").toInt(), 0, 100);
  idleIntensity = constrain(server.arg("idleIntensity").toInt(), 0, 100);
  idleOff = server.arg("idleOff") == "1";

  int requestedAnimation=server.arg("alertAnimation").toInt();
  alertAnimation=(requestedAnimation>=0&&requestedAnimation<=ALERT_CUSTOM)||isLibraryId(requestedAnimation)?requestedAnimation:ALERT_CLASSIC;
  alertDuration = constrain(server.arg("alertDuration").toInt(), 1, 60);
  blinkMs = constrain(server.arg("blinkMs").toInt(), 100, 2000);

  return true;
}

void updateMacroFromRequest(uint8_t idx,
                            const String& name,
                            uint8_t directR,
                            uint8_t directG,
                            uint8_t directB,
                            uint8_t directIntensity,
                            bool idleOff,
                            uint8_t idleR,
                            uint8_t idleG,
                            uint8_t idleB,
                            uint8_t idleIntensity,
                            uint8_t alertAnimation,
                            uint8_t alertDuration,
                            uint16_t blinkMs) {

  MacroConfig& m = config.macro[idx];

  name.toCharArray(m.name, sizeof(m.name));

  m.r = directR;
  m.g = directG;
  m.b = directB;
  m.intensity = directIntensity;

  m.idleOff = idleOff;
  m.idleR = idleR;
  m.idleG = idleG;
  m.idleB = idleB;
  m.idleIntensity = idleIntensity;

  m.alertAnimation = alertAnimation;
  m.alertDuration = alertDuration;
  m.blinkMs = blinkMs;
  m.alertEndOn = true;
  readMotionRequest(idx);
}

void handleMacroAutoSave() {
  uint8_t idx;
  String name;

  uint8_t directR, directG, directB, directIntensity;
  bool idleOff;
  uint8_t idleR, idleG, idleB, idleIntensity;
  uint8_t alertAnimation;
  uint8_t alertDuration;
  uint16_t blinkMs;

  if (!readMacroRequest(
        idx,
        name,
        directR,
        directG,
        directB,
        directIntensity,
        idleOff,
        idleR,
        idleG,
        idleB,
        idleIntensity,
        alertAnimation,
        alertDuration,
        blinkMs)) {

    server.send_P(400,PSTR("application/json"),PSTR("{\"ok\":false}"));
    return;
  }

  updateMacroFromRequest(
    idx,
    name,
    directR,
    directG,
    directB,
    directIntensity,
    idleOff,
    idleR,
    idleG,
    idleB,
    idleIntensity,
    alertAnimation,
    alertDuration,
    blinkMs
  );

  if(!saveMotionSettings()){
    server.send_P(500,PSTR("application/json"),PSTR("{\"ok\":false,\"reason\":\"motion storage\"}"));return;
  }
  saveConfig();

  // Si c'est la macro courante, applique son nouvel etat sans attendre.
  if (!settingsPreviewActive &&
      !alertRunning &&
      activeMacro == idx) {
    renderCurrentOutput();
  }

  server.send_P(200,PSTR("application/json"),PSTR("{\"ok\":true}"));
}

void handleMacroPreview() {
  if (alertRunning) {
    server.send_P(409,PSTR("application/json"),PSTR("{\"ok\":false,\"reason\":\"alert\"}"));
    return;
  }

  uint8_t idx;
  String name;

  uint8_t directR, directG, directB, directIntensity;
  bool idleOff;
  uint8_t idleR, idleG, idleB, idleIntensity;
  uint8_t alertAnimation;
  uint8_t alertDuration;
  uint16_t blinkMs;

  if (!readMacroRequest(
        idx,
        name,
        directR,
        directG,
        directB,
        directIntensity,
        idleOff,
        idleR,
        idleG,
        idleB,
        idleIntensity,
        alertAnimation,
        alertDuration,
        blinkMs)) {

    server.send_P(400,PSTR("application/json"),PSTR("{\"ok\":false}"));
    return;
  }

  // L'apercu travaille en RAM pour rester fluide :
  // l'EEPROM est ecrite seulement par l'autosave.
  updateMacroFromRequest(
    idx,
    name,
    directR,
    directG,
    directB,
    directIntensity,
    idleOff,
    idleR,
    idleG,
    idleB,
    idleIntensity,
    alertAnimation,
    alertDuration,
    blinkMs
  );

  bool directState = server.arg("state") == "direct";

  showMacroPreview(idx, directState);

  server.send_P(200,PSTR("application/json"),PSTR("{\"ok\":true}"));
}

// Route historique conservee pour compatibilite avec d'anciennes pages.
void handleSaveMacro() {
  handleMacroAutoSave();
}

void handleUploadLogoData() {
  HTTPUpload& upload = server.upload();

  if (upload.status == UPLOAD_FILE_START) {
    uploadAccepted = false;
    uploadTargetMacro = server.arg("i").toInt();
    if (uploadTargetMacro < 0 || uploadTargetMacro >= MACRO_COUNT) return;
    if (!validImageExtension(upload.filename)) return;

    uploadTargetPath = logoPathFor(uploadTargetMacro, upload.filename);
    String png = "/m" + String(uploadTargetMacro+1) + ".png";
    String jpg = "/m" + String(uploadTargetMacro+1) + ".jpg";
    if (LittleFS.exists(png)) LittleFS.remove(png);
    if (LittleFS.exists(jpg)) LittleFS.remove(jpg);
    uploadFile = LittleFS.open(uploadTargetPath,"w");
    if (uploadFile) uploadAccepted = true;
  }
  else if (upload.status == UPLOAD_FILE_WRITE) {
    if (uploadAccepted && uploadFile) uploadFile.write(upload.buf, upload.currentSize);
  }
  else if (upload.status == UPLOAD_FILE_END) {
    if (uploadFile) uploadFile.close();
    if (uploadAccepted && uploadTargetMacro >= 0 && uploadTargetMacro < MACRO_COUNT) {
      uploadTargetPath.toCharArray(config.macro[uploadTargetMacro].logoPath, sizeof(config.macro[uploadTargetMacro].logoPath));
      saveConfig();
    }
  }
  else if (upload.status == UPLOAD_FILE_ABORTED) {
    if (uploadFile) uploadFile.close();
    if (uploadTargetPath.length() && LittleFS.exists(uploadTargetPath)) LittleFS.remove(uploadTargetPath);
    uploadAccepted = false;
  }
}

void handleUploadLogoComplete() {
  if (!uploadAccepted) { server.send_P(400,PSTR("text/plain"),PSTR("Upload refuse. Utiliser PNG ou JPG.")); return; }
  redirectSettings();
}

void handleDeleteLogo() {
  int i = server.arg("i").toInt();
  if (i < 0 || i >= MACRO_COUNT) { server.send_P(400,PSTR("text/plain"),PSTR("Macro invalide")); return; }

  String path = config.macro[i].logoPath;

  if (path.length() && !isBuiltinLogo(path) && LittleFS.exists(path)) {
    LittleFS.remove(path);
  }

  setBuiltinLogo(i);
  saveConfig();

  server.send_P(200,PSTR("text/plain"),PSTR("OK"));
}

void handleLogo() {
  int i = server.arg("i").toInt();

  if (i < 0 || i >= MACRO_COUNT) {
    server.send_P(404,PSTR("text/plain"),PSTR("Logo absent"));
    return;
  }

  String path = config.macro[i].logoPath;

  if (isBuiltinLogo(path)) {
    switch (i) {
      case 0:
        server.send_P(200, PSTR("image/jpeg"), (PGM_P)LOGO_ONE_FM, LOGO_ONE_FM_LEN);
        return;
      case 1:
        server.send_P(200, PSTR("image/jpeg"), (PGM_P)LOGO_RADIO_LAC, LOGO_RADIO_LAC_LEN);
        return;
      case 2:
        server.send_P(200, PSTR("image/jpeg"), (PGM_P)LOGO_LFM, LOGO_LFM_LEN);
        return;
      case 3:
        server.send_P(200, PSTR("image/jpeg"), (PGM_P)LOGO_ROUGE, LOGO_ROUGE_LEN);
        return;
    }
  }

  if (!path.length() || !LittleFS.exists(path)) {
    server.send_P(404,PSTR("text/plain"),PSTR("Logo absent"));
    return;
  }

  File f = LittleFS.open(path,"r");
  server.streamFile(f,mimeTypeForPath(path));
  f.close();
}

void handleStartupTest() {
  if(outputEnabled||alertRunning){server.send_P(409,PSTR("application/json"),PSTR("{\"ok\":false,\"reason\":\"live\"}"));return;}
  server.send_P(200,PSTR("application/json"),PSTR("{\"ok\":true}"));
  startupTestActive=true;startupAnimation();
}

void handleReboot() { server.send_P(200,PSTR("text/plain"),PSTR("Redemarrage")); delay(800); ESP.restart(); }

void handleFactoryReset() {
  MotionSettings previousMotion=motionSettings;
  uint32_t previousChecksum=motionSavedChecksum;
  resetMotionSettings();
  if(!saveMotionSettings()){
    motionSettings=previousMotion;motionSavedChecksum=previousChecksum;
    server.send_P(500,PSTR("text/plain"),PSTR("Impossible de reinitialiser les animations"));return;
  }
  for(uint8_t id=32;id<48;id++){char path[24];snprintf(path,sizeof(path),"/anim%u.bin",id);LittleFS.remove(path);}
  LittleFS.remove("/library.migrated");
  setDefaults();
  saveConfig();
  for (uint8_t i=0;i<MACRO_COUNT;i++) {
    char customPath[24];snprintf(customPath,sizeof(customPath),"/custom%u.bin",i);LittleFS.remove(customPath);snprintf(customPath,sizeof(customPath),"/custom%u.bin",i+MACRO_COUNT);LittleFS.remove(customPath);
    String png = "/m" + String(i+1) + ".png";
    String jpg = "/m" + String(i+1) + ".jpg";
    if (LittleFS.exists(png)) LittleFS.remove(png);
    if (LittleFS.exists(jpg)) LittleFS.remove(jpg);
  }
  server.send_P(200,PSTR("text/plain"),PSTR("Configuration reinitialisee"));
  delay(1000); ESP.restart();
}

uint32_t configChecksum(const uint8_t* data, size_t len) {
  uint32_t h = 2166136261UL;

  for (size_t i = 0; i < len; i++) {
    h ^= data[i];
    h *= 16777619UL;
  }

  return h;
}

void handleConfigExport() {
  // V2 : EEPROM historique + extension animations. V1 reste importable.
  motionSettings.checksum=configChecksum(reinterpret_cast<const uint8_t*>(&motionSettings),sizeof(motionSettings)-sizeof(motionSettings.checksum));
  const size_t payloadSize=sizeof(Config)+sizeof(MotionSettings);
  uint8_t* payload=configImportBuffer+sizeof(BackupHeader);
  memcpy(payload,&config,sizeof(Config));
  memcpy(payload+sizeof(Config),&motionSettings,sizeof(MotionSettings));
  BackupHeader header={};
  header.signature=BACKUP_SIGNATURE;header.configMagic=CONFIG_MAGIC;
  header.configSize=payloadSize;header.backupVersion=BACKUP_VERSION;
  header.checksum=configChecksum(payload,payloadSize);
  server.sendHeader("Content-Disposition","attachment; filename=\"ON_AIR-MOC_backup.cfg\"");
  server.sendHeader("Cache-Control","no-store");
  server.setContentLength(sizeof(header)+payloadSize);
  server.send_P(200,PSTR("application/octet-stream"),PSTR(""));
  WiFiClient client=server.client();
  client.write(reinterpret_cast<const uint8_t*>(&header),sizeof(header));
  client.write(payload,payloadSize);
}

void handleConfigImportData() {
  HTTPUpload& upload=server.upload();
  if(upload.status==UPLOAD_FILE_START){
    configImportReceived=0;configImportAccepted=true;configImportApplied=false;
  }else if(upload.status==UPLOAD_FILE_WRITE){
    if(!configImportAccepted)return;
    if(configImportReceived+upload.currentSize>sizeof(configImportBuffer)){configImportAccepted=false;return;}
    memcpy(configImportBuffer+configImportReceived,upload.buf,upload.currentSize);
    configImportReceived+=upload.currentSize;
  }else if(upload.status==UPLOAD_FILE_END){
    if(!configImportAccepted||configImportReceived<sizeof(BackupHeader)){configImportAccepted=false;return;}
    BackupHeader header;memcpy(&header,configImportBuffer,sizeof(header));
    bool legacy=header.backupVersion==1&&header.configSize==sizeof(Config);
    bool extended=header.backupVersion==BACKUP_VERSION&&header.configSize==sizeof(Config)+sizeof(MotionSettings);
    const uint8_t* payload=configImportBuffer+sizeof(BackupHeader);
    if((!legacy&&!extended)||header.signature!=BACKUP_SIGNATURE||header.configMagic!=CONFIG_MAGIC||
       configImportReceived!=sizeof(header)+header.configSize||
       configChecksum(payload,header.configSize)!=header.checksum){configImportAccepted=false;return;}
    Config restored;memcpy(&restored,payload,sizeof(restored));
    if(restored.magic!=CONFIG_MAGIC){configImportAccepted=false;return;}
    MotionSettings previous=motionSettings;
    if(extended){
      MotionSettings restoredMotion;memcpy(&restoredMotion,payload+sizeof(Config),sizeof(restoredMotion));
      if(!validMotionSettings(restoredMotion)){configImportAccepted=false;return;}
      motionSettings=restoredMotion;
    }else resetMotionSettings();
    if(!saveMotionSettings()){motionSettings=previous;configImportAccepted=false;return;}
    config=restored;saveConfig();configImportApplied=true;
  }else if(upload.status==UPLOAD_FILE_ABORTED)configImportAccepted=false;
}

void handleConfigImportComplete() {
  if (!configImportAccepted || !configImportApplied) {
    server.send(
      400,
      "text/html; charset=utf-8",
      "<html><body style='font-family:Arial;background:#111;color:#fff;padding:25px'>"
      "<h2>Import refuse</h2>"
      "<p>Le fichier n est pas un backup compatible avec ce firmware.</p>"
      "<a style='color:#69a7ff' href='/settings'>Retour</a>"
      "</body></html>"
    );
    return;
  }

  server.sendHeader("Connection", "close");
  server.send(
    200,
    "text/html; charset=utf-8",
    "<html><body style='font-family:Arial;background:#111;color:#fff;padding:25px'>"
    "<h2>Configuration restauree</h2>"
    "<p>L ESP redemarre pour appliquer tous les reglages.</p>"
    "</body></html>"
  );

  delay(1200);
  ESP.restart();
}

String uptimeText() {
  unsigned long totalSeconds = millis() / 1000UL;
  unsigned long days = totalSeconds / 86400UL;
  totalSeconds %= 86400UL;
  unsigned long hours = totalSeconds / 3600UL;
  totalSeconds %= 3600UL;
  unsigned long minutes = totalSeconds / 60UL;
  unsigned long seconds = totalSeconds % 60UL;

  return String(days) + "j " + String(hours) + "h " +
         String(minutes) + "m " + String(seconds) + "s";
}

void sendDiagnosticsPage() {
  if(!webMemoryReady())return;
  Serial.println(
    "[WEB] GET /diagnostics stream | heap=" + String(ESP.getFreeHeap()) +
    " | maxblock=" + String(ESP.getMaxFreeBlockSize())
  );

  beginChunkedHtml();

  {
  String c;
  c.reserve(2200);

  c = F("<!doctype html><html lang='fr'><head><meta charset='utf-8'>"
    "<meta name='viewport' content='width=device-width,initial-scale=1'>"
    "<title>Diagnostic</title>"
    "<style>html,body{margin:0;background:#f3f4f8;color:#191a20}</style>"
    "<script>(function(){var m;try{m=localStorage.getItem('onair-theme')}catch(e){}if(m!=='dark'&&m!=='light')m=matchMedia('(prefers-color-scheme: dark)').matches?'dark':'light';window.setTheme=function(v){if(v!=='dark'&&v!=='light')return;document.documentElement.dataset.theme=v;try{localStorage.setItem('onair-theme',v)}catch(e){}document.querySelectorAll('[data-theme-choice]').forEach(function(b){b.setAttribute('aria-pressed',String(b.dataset.themeChoice===v))})};document.documentElement.dataset.theme=m})()</script><link rel='stylesheet' href='/style.css?v=343'></head><body>"
    "<header class='top'><div class='title'>Diagnostic</div>"
    "<a class='iconbtn' href='/settings#system'>← Système</a></header>"
    "<div class='wrap'>"
    "<div class='section'><h2>Systeme</h2><div class='small'>");

  c += F("Firmware : <b>");
  c += String(FIRMWARE_VERSION);
  c += F("</b><br>Uptime : <b>");
  c += uptimeText();
  c += F("</b><br>Dernier reset : <b>");
  c += htmlEscape(ESP.getResetReason());
  c += F("</b><br>Heap libre : <b>");
  c += String(ESP.getFreeHeap());
  c += F(" octets</b><br>Plus gros bloc heap : <b>");
  c += String(ESP.getMaxFreeBlockSize());
  c += F(" octets</b><br>Taille firmware : <b>");
  c += String(ESP.getSketchSize());
  c += F(" octets</b><br>Espace OTA libre : <b>");
  c += String(ESP.getFreeSketchSpace());
  c += F(" octets</b></div></div>");

  sendHtmlChunk(c);
  c = F("");

  c.reserve(2000);
  c = F("<div class='section'><h2>Wi-Fi</h2><div class='small'>");
  c += F("AP : <b>");
  c += htmlEscape(String(config.apSSID));
  c += F("</b><br>IP AP : <b>");
  c += WiFi.softAPIP().toString();
  c += F("</b><br>Clients AP : <b>");
  c += String(WiFi.softAPgetStationNum());
  c += F("</b><br>Reseaux memorises : <b>");
  c += String(config.knownWiFiCount);
  c += F("</b><br>");

  if (WiFi.status() == WL_CONNECTED) {
    c += F("Externe : <b style='color:#65d487'>CONNECTE</b><br>SSID : <b>");
    c += htmlEscape(WiFi.SSID());
    c += F("</b><br>IP : <b>");
    c += WiFi.localIP().toString();
    c += F("</b><br>RSSI : <b>");
    c += String(WiFi.RSSI());
    c += F(" dBm</b><br>mDNS : <b>");
    c += (mdnsStarted ? "ACTIF" : "EN ATTENTE");
    c += F("</b>");
  } else {
    c += F("Externe : <b style='color:#ffbc42'>NON CONNECTE</b>");
  }

  c += F("</div></div>");

  sendHtmlChunk(c);
  c = F("");

  c.reserve(1600);
  c = F("<div class='section'><h2>ON AIR</h2><div class='small'>");

  if (alertRunning) c += F("Etat : <b style='color:#f4c542'>ALERTE</b><br>");
  else if (outputEnabled) c += F("Etat : <b style='color:#65d487'>DIRECT</b><br>");
  else if (activeMacro >= 0) c += F("Etat : <b>HORS DIRECT</b><br>");
  else c += F("Etat : <b>ETEINT</b><br>");

  c += F("Macro active : <b>");

  if (activeMacro >= 0 && activeMacro < MACRO_COUNT) {
    c += htmlEscape(String(config.macro[activeMacro].name));
  } else {
    c += F("Aucune");
  }

  c += F("</b><br>Sortie LED : <b>");
  c += rgbToHex(currentLedR,currentLedG,currentLedB);
  c += F(" / ");
  c += String(currentLedIntensity);
  c += F("%</b></div></div>");
  c += F("<a class='save' style='display:block;text-align:center;text-decoration:none;padding:16px' href='/diagnostics'>RAFRAICHIR</a>");
  c += F("</div></body></html>");

  sendHtmlChunk(c);
  endChunkedHtml();

  }

  Serial.println(
    "[WEB] /diagnostics stream termine | heap=" + String(ESP.getFreeHeap()) +
    " | maxblock=" + String(ESP.getMaxFreeBlockSize())
  );
}

// Minimal OTA transport with size/MD5 checks, acknowledgement before reboot and post-boot verification.
static const char FIRMWARE_PAGE[] PROGMEM = R"FWPAGE(
<!doctype html><html lang='fr'><head><meta charset='utf-8'>
<meta name='viewport' content='width=device-width,initial-scale=1'>
<title>Mise à jour · ON AIR</title><script>(function(){var m;try{m=localStorage.getItem('onair-theme')}catch(e){}if(m!=='dark'&&m!=='light')m=matchMedia('(prefers-color-scheme: dark)').matches?'dark':'light';window.setTheme=function(v){if(v!=='dark'&&v!=='light')return;document.documentElement.dataset.theme=v;try{localStorage.setItem('onair-theme',v)}catch(e){}document.querySelectorAll('[data-theme-choice]').forEach(function(b){b.setAttribute('aria-pressed',String(b.dataset.themeChoice===v))})};document.documentElement.dataset.theme=m})()</script><link rel='stylesheet' href='/style.css?v=343'>
</head><body><header class='top'><div class='title'>Mise à jour</div><a class='iconbtn' href='/settings#system'>← Système</a></header>
<main class='wrap'><div class='settings-intro'><span class='eyebrow'>Maintenance</span><h1>Mise à jour</h1><p>Installez une nouvelle version en quelques instants.</p></div>
<section class='section'><h2>Installer un firmware</h2><p>Choisissez le fichier ON_AIR_ESP8266_OTA.bin. Vos émissions, logos et connexions sont conservés lors d’une mise à jour compatible.</p>
<form id='updateForm' method='POST' action='/update' enctype='multipart/form-data'><label for='firmwareFile'>Fichier de mise à jour</label>
<input id='firmwareFile' type='file' name='firmware' accept='.bin' required>
<p class='small'>Laissez le boîtier alimenté et cette page ouverte pendant le transfert.</p><button id='uploadBtn' class='save' type='submit'>INSTALLER LA MISE À JOUR</button></form>
<progress id='uploadProgress' max='100' value='0' hidden style='width:100%;height:12px;margin-top:20px;accent-color:#8ed5b1'></progress>
<p id='uploadState' class='small' role='status' aria-live='polite'></p><button id='verifyAgain' type='button' class='save' hidden>Vérifier le boîtier</button><a id='returnConsole' class='iconbtn' href='/' hidden>Revenir à la console</a></section>
</main>
<script>
const form=document.getElementById('updateForm'),button=document.getElementById('uploadBtn'),progress=document.getElementById('uploadProgress'),message=document.getElementById('uploadState'),verifyButton=document.getElementById('verifyAgain');
let uploading=false,verification=null,lastAttempt=null;
function firmwareMD5(bytes){
 const size=bytes.length,padded=new Uint8Array(((size+8>>>6)+1)*64);padded.set(bytes);padded[size]=128;
 const view=new DataView(padded.buffer);view.setUint32(padded.length-8,(size*8)>>>0,true);view.setUint32(padded.length-4,Math.floor(size/536870912),true);
 const shifts=[7,12,17,22,5,9,14,20,4,11,16,23,6,10,15,21],constants=Array.from({length:64},(_,n)=>(Math.abs(Math.sin(n+1))*4294967296)>>>0);
 let a0=0x67452301,b0=0xefcdab89,c0=0x98badcfe,d0=0x10325476;
 for(let offset=0;offset<padded.length;offset+=64){let a=a0,b=b0,c=c0,d=d0;
  for(let n=0;n<64;n++){let f,g;if(n<16){f=(b&c)|(~b&d);g=n;}else if(n<32){f=(d&b)|(~d&c);g=(5*n+1)%16;}else if(n<48){f=b^c^d;g=(3*n+5)%16;}else{f=c^(b|~d);g=(7*n)%16;}
   const shift=shifts[(n>>>4)*4+n%4],value=(a+f+constants[n]+view.getUint32(offset+g*4,true))|0;
   const next=(b+((value<<shift)|(value>>>(32-shift))))|0;a=d;d=c;c=b;b=next;
  }
  a0=(a0+a)|0;b0=(b0+b)|0;c0=(c0+c)|0;d0=(d0+d)|0;
 }
 return [a0,b0,c0,d0].flatMap(value=>[0,8,16,24].map(shift=>((value>>>shift)&255).toString(16).padStart(2,'0'))).join('');
}
const wait=ms=>new Promise(resolve=>setTimeout(resolve,ms));
async function firmwareStatus(extra=''){
 const r=await fetch('/api/firmware/status'+extra,{cache:'no-store',signal:AbortSignal.timeout(6000)});if(!r.ok)throw Error('Boîtier indisponible');return r.json();
}
function fail(text){uploading=false;button.disabled=false;message.textContent=text;}
async function verifyAttempt(attempt){
 if(verification)return verification;
 uploading=true;button.disabled=true;verifyButton.hidden=true;
 verification=(async()=>{
  const deadline=Date.now()+75000;
  while(Date.now()<deadline){
   await wait(1500);
   try{
    const state=await firmwareStatus();
    if(state.state==='error'&&state.session===attempt.session){fail('Installation refusée. '+state.error);return;}
    if(state.boot!==attempt.boot&&state.state==='idle'){
     message.textContent='Boîtier redémarré · vérification du firmware installé…';
     const verified=await firmwareStatus('?verify_size='+attempt.size+'&flash_mode='+attempt.flashMode);
     if(verified.boot!==state.boot)continue;
     if(verified.verified_md5===attempt.md5){
      uploading=false;progress.value=100;message.textContent='Mise à jour installée et vérifiée · '+verified.version;
      document.getElementById('returnConsole').hidden=false;return;
     }
     fail('Le boîtier a redémarré, mais le fichier choisi n’est pas installé. La mise à jour n’est pas confirmée.');verifyButton.hidden=false;return;
    }
   }catch(e){}
   message.textContent='Attente du boîtier et vérification de l’installation…';
  }
  fail('Installation non confirmée. Reconnectez-vous au Wi-Fi du boîtier, puis cliquez sur « Vérifier le boîtier » avant de relancer un transfert.');verifyButton.hidden=false;
 })().finally(()=>{verification=null;});return verification;
}
form.addEventListener('submit',async event=>{
 event.preventDefault();if(uploading||!form.reportValidity())return;
 uploading=true;button.disabled=true;verifyButton.hidden=true;document.getElementById('returnConsole').hidden=true;progress.hidden=false;progress.value=0;message.textContent='Préparation et vérification du fichier…';
 const file=document.getElementById('firmwareFile').files[0];
 try{
  if(!file||file.size<32||file.size>1048576||!file.name.toLowerCase().endsWith('.bin'))throw Error('Choisissez le fichier firmware .bin.');
  const bytes=new Uint8Array(await file.arrayBuffer());if(bytes[0]!==0xe9)throw Error('Ce fichier n’est pas un firmware ESP8266 .bin.');
  const md5=firmwareMD5(bytes),before=await firmwareStatus();
  const session=Date.now().toString(36)+Math.random().toString(36).slice(2);
  const attempt={boot:before.boot,size:file.size,md5,session,flashMode:bytes[2]};lastAttempt=attempt;
  const xhr=new XMLHttpRequest();xhr.open('POST','/update?'+new URLSearchParams({size:file.size,md5,session}));xhr.timeout=180000;
  message.textContent='Transfert du firmware…';
  xhr.upload.onprogress=e=>{if(e.lengthComputable){progress.value=Math.round(e.loaded/e.total*100);message.textContent=progress.value<100?'Transfert · '+progress.value+' %':'Fichier envoyé · validation par le boîtier…';}};
  xhr.onload=()=>{
   let result;try{result=JSON.parse(xhr.responseText);}catch(e){}
   if(xhr.status===200&&result&&result.ok){message.textContent='Fichier validé · attente du redémarrage…';verifyAttempt(attempt);}
   else fail('Installation refusée. '+(result&&result.error?result.error:'Le boîtier n’a pas validé le fichier.'));
  };
  xhr.onerror=xhr.ontimeout=()=>{message.textContent='Connexion perdue · vérification du boîtier avant tout nouvel essai…';verifyAttempt(attempt);};
  xhr.send(new FormData(form));
 }catch(e){fail(e.message||'Connexion au boîtier non confirmée. Réessayez lorsque le boîtier est accessible.');}
});
verifyButton.onclick=()=>{if(lastAttempt)verifyAttempt(lastAttempt);};
window.addEventListener('beforeunload',e=>{if(uploading){e.preventDefault();e.returnValue='';}});
</script></body></html>
)FWPAGE";

void sendFirmwarePage() {
  if(!webMemoryReady())return;
  server.sendHeader("Cache-Control", "no-store");
  server.send_P(200, PSTR("text/html; charset=utf-8"), FIRMWARE_PAGE);
}

void handleStyleCSS() {
  Serial.println("[WEB] GET /style.css | heap=" + String(ESP.getFreeHeap()));

  server.sendHeader("Cache-Control", "no-store, no-cache, must-revalidate");
  server.sendHeader("Pragma", "no-cache");
  server.sendHeader("Connection", "close");

  server.send_P(
    200,
    PSTR("text/css; charset=utf-8"),
    COMMON_CSS
  );
}

// Page volontairement tres legere pour iOS CNA : renvoie du HTML non vide,
// SANS le mot 'Success' attendu par le test Internet Apple.
// Si iOS ouvre sa petite fenetre CNA, elle va vers les parametres.
static const char IOS_CAPTIVE_PAGE[] PROGMEM = R"PORTAL(
<!doctype html><html lang='fr'><head><meta charset='utf-8'>
<meta name='viewport' content='width=device-width,initial-scale=1'>
<meta http-equiv='Cache-Control' content='no-store'>

<title>ON AIR - Accès au boîtier</title>
<style>
body{background:#0c1015;color:white;font-family:Arial,sans-serif;text-align:center;padding:28px 14px}
main{max-width:420px;margin:20px auto;background:#171d24;border:1px solid #38414e;
border-radius:16px;padding:20px}a{display:block;color:white;text-decoration:none;
background:#236bc4;padding:15px;margin:12px 0;border-radius:12px;font-weight:bold}
a.alt{background:#333c49}small{color:#afb9c5}
</style></head><body><main>
<h2>ON AIR</h2><p>ON AIR est prêt</p>
<a href='http://192.168.4.1/settings'>OUVRIR LES PARAMETRES</a>
<a class='alt' href='http://192.168.4.1/'>OUVRIR LE CONTROLE</a>
<small>En cas de blocage, utilise http://192.168.4.1/settings</small>
</main></body></html>
)PORTAL";

uint32_t iosCaptiveProbeCount = 0;
uint32_t otherCaptiveProbeCount = 0;

void sendAppleCaptivePortal() {
  ++iosCaptiveProbeCount;
  Serial.println("[CAPTIVE IOS] Requete " + server.uri() +
                 " | Host=" + server.hostHeader() +
                 " | probes=" + String(iosCaptiveProbeCount) +
                 " | heap=" + String(ESP.getFreeHeap()));
  server.sendHeader("Cache-Control", "no-store, no-cache, must-revalidate");
  server.sendHeader("Pragma", "no-cache");
  server.sendHeader("Expires", "0");
  server.sendHeader("Connection", "close");
  // IMPORTANT : 200 + vrai contenu HTML (non vide), pas 302 au corps vide.
  server.send_P(200, "text/html; charset=utf-8", IOS_CAPTIVE_PAGE);
}

void redirectCaptivePortal() {
  ++otherCaptiveProbeCount;
  Serial.println("[CAPTIVE] " + server.uri() +
                 " | Host=" + server.hostHeader() +
                 " | probes=" + String(otherCaptiveProbeCount));
  server.sendHeader("Location", "http://192.168.4.1/captive", true);
  server.sendHeader("Cache-Control", "no-store, no-cache, must-revalidate");
  server.sendHeader("Connection", "close");
  // Certaines versions de CNA ne suivent pas les redirections a corps vide.
  server.send_P(302,PSTR("text/html; charset=utf-8"),PSTR("<!doctype html><html><body><a href='http://192.168.4.1/captive'>"
              "ON AIR - Ouvrir la configuration</a></body></html>"));
}

// Shared, named library: 16 slots, one atomic file = 64-byte name + checked cues.
bool validLibraryName(const char* name){
  size_t n=strlen(name);if(!n||n>63||name[0]==' '||name[n-1]==' ')return false;
  for(size_t i=0;i<n;i++)if((uint8_t)name[i]<32||name[i]==127)return false;
  return true;
}
bool libraryReadName(uint8_t id,char* name){
  if(!isLibraryId(id))return false;
  char path[24];snprintf(path,sizeof(path),"/anim%u.bin",id);File f=LittleFS.open(path,"r");
  if(!f)return false;
  bool ok=f.size()==1420&&f.read(reinterpret_cast<uint8_t*>(name),64)==64;f.close();
  if(!ok||!memchr(name,0,64))return false;
  return validLibraryName(name);
}
bool libraryWrite(uint8_t id,const char* name,const uint8_t* data){
  if(!isLibraryId(id)||!validLibraryName(name)||!validCustom(data))return false;
  char path[24],temp[24],header[64]={};strncpy(header,name,63);
  snprintf(path,sizeof(path),"/anim%u.bin",id);snprintf(temp,sizeof(temp),"/anim%u.tmp",id);
  File f=LittleFS.open(temp,"w");if(!f)return false;
  bool ok=f.write(reinterpret_cast<const uint8_t*>(header),64)==64&&f.write(data,1356)==1356;
  f.flush();f.close();if(!ok||!LittleFS.rename(temp,path))return false;
  if(customOwner==id)customOwner=-1;
  return true;
}
bool libraryNamesEqual(const char* a,const char* b){
  uint8_t previousA=0,previousB=0;
  while(*a&&*b){
    uint8_t x=(uint8_t)*a++,y=(uint8_t)*b++,rawA=x,rawB=y;
    if(x>='A'&&x<='Z')x+=32;
    if(y>='A'&&y<='Z')y+=32;
    if(previousA==0xC3&&x>=0x80&&x<=0x9E&&x!=0x97)x+=32;
    if(previousB==0xC3&&y>=0x80&&y<=0x9E&&y!=0x97)y+=32;
    if(x!=y)return false;
    previousA=rawA;previousB=rawB;
  }
  return !*a&&!*b;
}
String libraryOptions(uint8_t selected){
  String out;char name[64];
  for(uint8_t id=32;id<48;id++)if(libraryReadName(id,name)){
    out += F("<option value='");out+=String(id);out += F("'");if(id==selected)out += F(" selected");
    out += F(">");out+=htmlEscape(String(name));out += F("</option>");
  }
  return out;
}
void migrateAnimationLibrary(){
  if(LittleFS.exists("/library.migrated"))return;
  bool ok=true,changed=false;
  for(uint8_t k=0;k<8;k++){
    if(!loadCustom(k))continue;
    uint8_t id=32+k;char name[64];
    if(!libraryReadName(id,name)){
      snprintf(name,sizeof(name),"%s %u · %s",config.macro[k%4].name,k%4+1,k<4?"Direct":"Alerte");
      if(!libraryWrite(id,name,customData)){ok=false;continue;}
    }
    if(k<4&&motionSettings.mode[k]==10){motionSettings.mode[k]=id;changed=true;}
    if(k>=4&&config.macro[k-4].alertAnimation==ALERT_CUSTOM){config.macro[k-4].alertAnimation=id;changed=true;}
  }
  if(changed){if(!saveMotionSettings())return;saveConfig();}
  if(ok){File f=LittleFS.open("/library.migrated","w");if(f){const uint8_t one=1;f.write(&one,1);f.close();}}
  customOwner=-1;
}
bool decodeCueRequest(uint8_t* data){
  String hex=server.arg("data");if(hex.length()!=2712)return false;
  for(size_t n=0;n<1356;n++){
    char a=hex[n*2],b=hex[n*2+1];
    int hi=a>='0'&&a<='9'?a-'0':a>='a'&&a<='f'?a-'a'+10:-1;
    int lo=b>='0'&&b<='9'?b-'0':b>='a'&&b<='f'?b-'a'+10:-1;
    if(hi<0||lo<0)return false;data[n]=(hi<<4)|lo;
  }
  return validCustom(data);
}
void handleLibraryList(){
  String out = F("[");char name[64];bool first=true;
  for(uint8_t id=32;id<48;id++)if(libraryReadName(id,name)){
    if(!first)out += F(",");first=false;out += F("{\"id\":");out+=String(id);out += F(",\"name\":\"");out+=jsonEscape(String(name));out += F("\"}");
  }
  out += F("]");server.sendHeader("Cache-Control","no-store");server.send(200,"application/json",out);
}
void handleLibraryGet(){
  int id=server.arg("id").toInt();char name[64];
  if(!isLibraryId(id)||!libraryReadName(id,name)){server.send_P(404,PSTR("text/plain"),PSTR("Animation introuvable"));return;}
  char path[24];snprintf(path,sizeof(path),"/anim%u.bin",id);File f=LittleFS.open(path,"r");uint8_t header[64];
  if(!f||f.read(header,64)!=64){server.send_P(500,PSTR("text/plain"),PSTR("Lecture impossible"));return;}
  server.sendHeader("Cache-Control","no-store");server.setContentLength(1356);server.send_P(200,PSTR("application/octet-stream"),PSTR(""));
  uint8_t chunk[256];while(f.available()){size_t n=f.read(chunk,sizeof(chunk));if(!n)break;server.client().write(chunk,n);}f.close();
}
void handleLibrarySave(){
  String name=server.arg("name");name.trim();
  if(!name.length()){server.send_P(400,PSTR("text/plain"),PSTR("Veuillez renseigner un nom pour l’animation."));return;}
  if(!validLibraryName(name.c_str())){server.send_P(400,PSTR("text/plain"),PSTR("Veuillez choisir un nom plus court, sans retour à la ligne."));return;}
  int requested=server.hasArg("id")?server.arg("id").toInt():-1;
  if(requested!=-1&&!isLibraryId(requested)){server.send_P(400,PSTR("text/plain"),PSTR("Animation invalide"));return;}
  char previous[64];int freeId=-1;
  if(requested!=-1&&!libraryReadName(requested,previous)){server.send_P(404,PSTR("text/plain"),PSTR("Cette animation n’existe plus"));return;}
  for(uint8_t id=32;id<48;id++){
    if(libraryReadName(id,previous)){
      if(id!=requested&&libraryNamesEqual(previous,name.c_str())){server.send_P(409,PSTR("text/plain"),PSTR("Ce nom est déjà utilisé. Veuillez saisir un nom différent."));return;}
    }else if(freeId<0)freeId=id;
  }
  int id=requested==-1?freeId:requested;
  if(id<0){server.send_P(409,PSTR("text/plain"),PSTR("La bibliothèque contient déjà 16 animations. Supprimez une séquence pour en ajouter une."));return;}
  uint8_t data[1356];if(!decodeCueRequest(data)){server.send_P(400,PSTR("text/plain"),PSTR("Séquence invalide"));return;}
  if(!libraryWrite(id,name.c_str(),data)){server.send_P(500,PSTR("text/plain"),PSTR("Enregistrement impossible. La séquence précédente est conservée."));return;}
  server.send(200,"application/json",String(F("{\"id\":"))+String(id)+"}");
}
void handleLibraryDelete(){
  int id=server.arg("id").toInt();char name[64];
  if(!isLibraryId(id)||!libraryReadName(id,name)){server.send_P(404,PSTR("text/plain"),PSTR("Animation introuvable"));return;}
  MotionSettings previous=motionSettings;
  for(uint8_t i=0;i<MACRO_COUNT;i++)if(motionSettings.mode[i]==id)motionSettings.mode[i]=0;
  if(!saveMotionSettings()){motionSettings=previous;server.send_P(500,PSTR("text/plain"),PSTR("Suppression impossible"));return;}
  for(uint8_t i=0;i<MACRO_COUNT;i++)if(config.macro[i].alertAnimation==id)config.macro[i].alertAnimation=ALERT_CLASSIC;
  saveConfig();char path[24];snprintf(path,sizeof(path),"/anim%u.bin",id);
  if(!LittleFS.remove(path)){server.send_P(500,PSTR("text/plain"),PSTR("Suppression du fichier impossible"));return;}
  if(customOwner==id)customOwner=-1;
  if(!settingsPreviewActive&&!alertRunning)renderCurrentOutput();server.send_P(200,PSTR("text/plain"),PSTR("Animation supprimée"));
}
void stopLibraryPreview(){
  if(!libraryPreviewActive)return;
  strncpy(libraryPreviewRevokedToken,libraryPreviewToken,40);
  libraryPreviewActive=false;libraryPreviewToken[0]=0;
  if(settingsPreviewActive){settingsPreviewActive=false;renderCurrentOutput();}
  customOwner=-1;
}
void updateLibraryPreview(){
  if(!libraryPreviewActive)return;
  if(!settingsPreviewActive||customOwner!=-2){strncpy(libraryPreviewRevokedToken,libraryPreviewToken,40);libraryPreviewActive=false;libraryPreviewToken[0]=0;customOwner=-1;return;}
  if((long)(millis()-settingsPreviewUntil)>=0){stopLibraryPreview();return;}
  if(millis()-libraryPreviewLastFrame<cueFrameInterval(customData))return;
  libraryPreviewLastFrame=millis();
  uint8_t frame[36][3];
  if(libraryPreviewPlaying)renderCueFrame(customData,100,millis()-libraryPreviewStarted,frame);
  else{
    renderCuePixels(customData+8+libraryPreviewCue*112,0,frame);
    if(customData[4]==2)for(uint8_t i=0;i<36;i++)for(uint8_t k=0;k<3;k++)frame[i][k]=frame[i][k]*customData[6]/100;
  }
  showMotionFrame(frame);
}
void handleLibraryPreview(){
  String token=server.arg("token");
  if(!token.length()||token.length()>40){server.send_P(400,PSTR("text/plain"),PSTR("Session invalide"));return;}
  if(libraryPreviewActive&&!settingsPreviewActive){strncpy(libraryPreviewRevokedToken,libraryPreviewToken,40);libraryPreviewActive=false;libraryPreviewToken[0]=0;customOwner=-1;}
  if(token==libraryPreviewRevokedToken){server.send_P(409,PSTR("text/plain"),PSTR("Aperçu interrompu. Réactivez l’interrupteur pour reprendre."));return;}
  if(libraryPreviewActive&&token!=libraryPreviewToken){server.send_P(409,PSTR("text/plain"),PSTR("Un autre aperçu est déjà actif"));return;}
  if(outputEnabled||alertRunning){server.send_P(409,PSTR("text/plain"),PSTR("Arrêtez le direct ou l’alerte avant d’activer l’aperçu."));return;}
  uint8_t data[1356];if(!decodeCueRequest(data)){server.send_P(400,PSTR("text/plain"),PSTR("Séquence invalide"));return;}
  int cue=server.arg("cue").toInt();if(cue<0||cue>=data[5]){server.send_P(400,PSTR("text/plain"),PSTR("Étape invalide"));return;}
  cancelStartupIndicator();settingsPreviewActive=true;customPreview=false;
  memcpy(customData,data,1356);customOwner=-2;customValid=true;
  libraryPreviewActive=true;strlcpy(libraryPreviewToken,token.c_str(),sizeof(libraryPreviewToken));
  libraryPreviewCue=cue;libraryPreviewPlaying=server.arg("play")=="1";
  unsigned long elapsed=constrain(server.arg("elapsed").toInt(),0,1000000);
  libraryPreviewStarted=millis()-elapsed;libraryPreviewLastFrame=millis()-33UL;
  settingsPreviewUntil=millis()+LIBRARY_PREVIEW_LEASE_MS;updateLibraryPreview();server.send_P(200,PSTR("text/plain"),PSTR("Aperçu actif"));
}
void handleLibraryPreviewPing(){
  if(!libraryPreviewActive||!settingsPreviewActive||customOwner!=-2||server.arg("token")!=libraryPreviewToken){server.send_P(409,PSTR("text/plain"),PSTR("Aperçu interrompu"));return;}
  settingsPreviewUntil=millis()+LIBRARY_PREVIEW_LEASE_MS;server.send_P(200,PSTR("text/plain"),PSTR("OK"));
}
void handleLibraryPreviewStop(){
  if(server.arg("token")==libraryPreviewToken)stopLibraryPreview();server.send_P(200,PSTR("text/plain"),PSTR("OK"));
}

static const char ANIMATION_EDITOR_HTML[] PROGMEM = R"EDITOR(<!doctype html><html lang="fr"><meta charset="utf-8"><meta name="viewport" content="width=device-width,initial-scale=1"><title>Animation · ON AIR</title><script>try{document.documentElement.dataset.theme=localStorage.getItem('onair-theme')||(matchMedia('(prefers-color-scheme:dark)').matches?'dark':'light')}catch(e){}</script><link rel="stylesheet" href="/style.css"><style>
body{margin:0;background:var(--bg);color:var(--text);font-family:-apple-system,BlinkMacSystemFont,'Segoe UI',sans-serif}.editor{max-width:680px;margin:auto;padding:22px 20px 50px}.bar{display:flex;gap:8px;flex-wrap:wrap;align-items:center}.editor .bar button,.editor .cues button{background:var(--panel);color:var(--text);border:1px solid var(--line)}.editor .cues button.selected{background:#4669e8;color:white}.board{position:relative;margin:30px 17px;width:calc(100% - 34px);height:210px;border-radius:28px;background:var(--panel);box-shadow:inset 0 0 35px #00000010}.led{position:absolute;width:25px;height:25px;min-height:0;padding:0;border-radius:50%;transform:translate(-50%,-50%);border:2px solid #777;box-shadow:0 0 8px var(--led)}.led[aria-pressed=true]{outline:3px solid #6489ff;outline-offset:3px}.board strong{position:absolute;inset:0;display:grid;place-items:center;font-size:32px;letter-spacing:5px;pointer-events:none;opacity:.2}.cues{display:flex;gap:8px;overflow:auto;padding:8px 3px}.section input[type=color]{height:48px;padding:2px;width:75px}.primary{background:#4669e8!important;color:white!important}.status{min-height:24px;font-size:13px;line-height:1.5;margin:16px 0}.led:active{transform:translate(-50%,-50%)}a{color:inherit}h1{font-size:25px;letter-spacing:-1px}.section button{min-height:42px}.small{margin:10px 0}

.editor-meta label{margin-top:0}.editor-meta #animationName{margin-bottom:18px}.editor-toolbar{display:flex;align-items:center;justify-content:space-between;gap:12px}.preview-switch{display:flex!important;align-items:center;gap:10px;margin:0!important;font-size:13px!important;line-height:1.3;cursor:pointer}.preview-switch input{appearance:none;-webkit-appearance:none;position:relative;width:44px!important;min-width:44px;min-height:26px!important;height:26px!important;border:0!important;border-radius:20px!important;background:#c3c7d3!important;cursor:pointer}.preview-switch input:checked{background:#4669e8!important}.preview-switch input:before{content:'';position:absolute;width:20px;height:20px;border-radius:50%;background:white;left:3px;top:3px;transition:transform .15s}.preview-switch input:checked:before{transform:translateX(18px)}.editor .status{margin:12px 0 0;min-height:18px}.playbar{display:flex;justify-content:center;margin:14px 0 20px}.playbar button{background:var(--panel);color:var(--text);border:1px solid var(--line);padding:10px 20px}.library-heading{display:flex;align-items:center;justify-content:space-between;gap:10px;margin-bottom:10px}.library-heading h2{font-size:20px;margin:0}.library-heading h2 span{font-size:12px;color:var(--muted);font-weight:400}.library-heading button{background:transparent;color:var(--text);padding:7px 10px;font-size:13px}.library-row{display:flex;align-items:center;gap:10px;padding:10px 0;border-bottom:1px solid var(--line)}.library-row:last-child{border:0}.library-select{flex:1;min-width:0;justify-content:flex-start;text-align:left;background:transparent;color:var(--text);padding:8px 0;font-size:14px}.library-select span{white-space:nowrap;overflow:hidden;text-overflow:ellipsis}.library-select:before{content:'○';color:var(--muted);font-size:21px}.library-select[aria-pressed=true]:before{content:'✓';color:#6489ff}.library-delete{width:40px;min-width:40px;min-height:40px!important;padding:0;border-radius:12px;background:#ff525215;color:#e65b64;font-size:24px}.library-empty{font-size:13px;color:var(--muted);padding:16px 0}.editor-meta .primary{white-space:nowrap;padding:10px 16px}.editor .editor-meta input[type=text]{font-size:16px}.editor-meta .preview-switch span{max-width:130px}@media(max-width:350px){.editor-toolbar{align-items:stretch;flex-direction:column}.editor-meta .preview-switch span{max-width:none}.editor-meta .preview-switch{justify-content:space-between;padding:6px 0}}
.board{height:auto;aspect-ratio:3.3;margin:38px 16px;width:calc(100% - 32px);background:#101114;border:1px solid #30323b;border-radius:20px;isolation:isolate}.board #diffuser{position:absolute;left:5%;top:12%;width:90%;height:76%;pointer-events:none;z-index:0}.board .led,.board .led:active,.board .led:hover{width:28px;height:28px;min-height:28px;padding:0;border:0;background:transparent!important;border-radius:50%;transform:none!important;translate:-50% -50%;transition:none;z-index:3;box-shadow:none;touch-action:manipulation}.board .led:after{content:'';position:absolute;inset:6px;border-radius:50%;background:var(--led);border:1px solid #aab0c2;box-shadow:0 0 7px var(--led);pointer-events:none}.board .led[aria-pressed=true]{outline:none}.board .led[aria-pressed=true]:after{outline:2px solid #7599ff;outline-offset:2px}.board .led:focus-visible{outline:2px solid white;outline-offset:0}#palette{gap:8px;flex:1}#palette button{width:30px;min-height:30px;padding:0}#intensityValue{float:right;font-variant-numeric:tabular-nums}#bank{width:min(560px,calc(100% - 28px));max-height:80vh;overflow:auto;padding:22px;border:1px solid var(--line);border-radius:24px;background:var(--panel);color:var(--text)}#bank::backdrop{background:#0008;backdrop-filter:blur(5px)}#bank h3{font-size:14px;color:var(--muted);margin:20px 0 8px}.bank-row{display:flex;align-items:center;justify-content:space-between;gap:10px;padding:12px 0;border-bottom:1px solid var(--line)}.bank-row>span{min-width:0;overflow-wrap:anywhere}.bank-row button{font-size:12px;min-height:36px;padding:8px 12px;background:var(--bg);color:var(--text);white-space:nowrap}.library-copy{font-size:12px;background:transparent;color:var(--muted);padding:8px;min-height:36px}.editor [hidden]{display:none!important}
</style><main class="editor"><a id="back" href="/settings">← Retour</a><h1>Éditeur d’animation</h1><section class="section editor-meta"><label for="animationName">Nom de l’animation</label><input id="animationName" type="text" maxlength="32" placeholder="Ex. Alerte studio" autocomplete="off"><div class="editor-toolbar"><label class="preview-switch"><input id="physicalPreview" type="checkbox" role="switch"><span>Aperçu sur le boîtier</span></label><button id="save" class="primary">Enregistrer</button></div><p class="status" id="status" role="status" aria-live="polite"></p></section><div class="board" id="board"><canvas id="diffuser" aria-label="Simulation lumineuse ON AIR"></canvas></div><div class="bar" id="groups"></div><div class="playbar"><button id="play">Lire la séquence</button></div><section class="section"><div class="bar"><input aria-label="Couleur des LED sélectionnées" id="color" type="color" value="#ff0000"><div class="bar" id="palette"></div></div><label for="animationIntensity">Intensité de la séquence <output id="intensityValue">100 %</output></label><input id="animationIntensity" type="range" min="0" max="100" value="100"><p class="small" id="selection"></p><div class="grid2"><div><label for="cueKind">Outil de cette étape</label><select id="cueKind"><option value="pixels">Couleurs LED</option><option value="chase">Chenillard</option><option value="strobe">Flash / strobe</option></select></div><div id="speedGroup" hidden><label for="effectSpeed">Intervalle (ms)</label><input id="effectSpeed" type="number" min="20" max="10000" step="10" value="100"></div><div id="startGroup" hidden><label for="chaseStart">LED de départ</label><input id="chaseStart" type="number" min="1" max="36" value="1"></div><div id="endGroup" hidden><label for="chaseEnd">LED d’arrivée</label><input id="chaseEnd" type="number" min="1" max="36" value="36"></div></div><button id="applyMask" hidden>Appliquer aux LED sélectionnées</button><div class="cues" id="cues"></div><div class="bar"><button id="add">+ Étape</button><button id="duplicate">Dupliquer</button><button id="remove">Supprimer</button><button id="earlier" aria-label="Déplacer avant">←</button><button id="later" aria-label="Déplacer après">→</button></div><div class="grid2"><div><label for="hold">Maintien (secondes)</label><input id="hold" type="number" min="0.1" max="60" step="0.1" value="1"></div><div><label for="transition">Transition vers cette étape</label><select id="transition"><option value="cut">Directe</option><option value="fade">Fondu</option></select></div><div><label for="fade">Fondu (secondes)</label><input id="fade" type="number" min="0.1" max="20" step="0.1" value="1" disabled></div></div><p class="small">12 étapes maximum · Maintien et fondu par étape.</p><div class="bar"><button id="bankOpen">Banque</button><button id="export">Exporter</button><button id="import">Importer</button><input id="file" type="file" accept=".onair" hidden></div></section><section class="section"><div class="library-heading"><h2>Mes animations <span id="libraryCount"></span></h2><button id="newAnimation">+ Nouvelle</button></div><div id="libraryList"></div><p class="small">Disponibles dans les menus Direct et Alerte de toutes les émissions.</p></section></main><dialog id="bank"><div class="library-heading"><h2>Banque d’animations</h2><button id="bankClose" aria-label="Fermer la banque">×</button></div><h3>Modèles</h3><div id="templateList"></div><h3>Mes animations</h3><div id="bankSaved"></div></dialog><script>
'use strict';
const $=id=>document.getElementById(id),makeToken=()=>crypto.randomUUID?crypto.randomUUID():Date.now().toString(36)+Math.random().toString(36).slice(2);
let token=makeToken(),previewVersion=0,previewReady=false,previewBusy=false,previewPending=false,previewMisses=0;
$('back').href='/settings#animations';
let library=[],editingId=null,saving=false,loading=false,previewTimer=0,previewQueue=Promise.resolve(),previewFailed=false;
let cues=[{hold:1000,fade:0,rgb:Array(108).fill(0)}],current=0,selected=new Set(Array.from({length:36},(_,n)=>n)),dirty=false,playing=false,started=0;
const buttons=[];const cue=()=>cues[current];
const logoPath=new Path2D('M190 130A90 90 0 1 0 10 130A90 90 0 1 0 190 130Z M220 220V40H267L335 147V40H380V220H333L265 113V220Z M470 220L530 40H585L650 220H600L587 180H524L511 220Z M537 140H575L555 80Z M678 220L705 40H755L728 220Z M775 220L802 40H877Q944 40 944 100Q944 143 907 157L945 220H885L853 164H834L825 220Z M842 83L836 123H869Q892 123 892 101Q892 83 871 83Z');
const lightCanvas=document.createElement('canvas');lightCanvas.width=96;lightCanvas.height=26;const lightContext=lightCanvas.getContext('2d'),lightImage=lightContext.createImageData(96,26),weights=new Float32Array(96*26*36);
for(let y=0;y<26;y++)for(let x=0;x<96;x++)for(let n=0;n<36;n++){const lx=n<12?(11-n)/11:n<17?0:n<31?(n-17)/13:1,ly=n<12?1:n<17?(17-n)/6:n<31?0:(n-30)/6;weights[(y*96+x)*36+n]=Math.exp(-((x/95-lx)**2/.042+(y/25-ly)**2/.7))*.78;}
function drawDiffuser(rgb,level){
 const d=lightImage.data;for(let px=0;px<96*26;px++){let r=0,g=0,b=0;for(let n=0;n<36;n++){const w=weights[px*36+n]*level;r+=rgb[n*3]*w;g+=rgb[n*3+1]*w;b+=rgb[n*3+2]*w;}d[px*4]=Math.min(255,18+r);d[px*4+1]=Math.min(255,18+g);d[px*4+2]=Math.min(255,20+b);d[px*4+3]=255;}
 lightContext.putImageData(lightImage,0,0);const c=$('diffuser'),ctx=c.getContext('2d');if(c.width!==960){c.width=960;c.height=260;}ctx.clearRect(0,0,960,260);ctx.save();ctx.clip(logoPath,'evenodd');ctx.imageSmoothingEnabled=true;ctx.drawImage(lightCanvas,0,0,960,260);ctx.restore();
}
function cuePixels(c,t){
 if(!c.kind||c.kind==='pixels')return c.rgb.slice();const rgb=Array(108).fill(0),speed=c.speed||100;
 if(c.kind==='chase'){const a=c.start??0,b=c.end??35,n=a+Math.sign(b-a)*(Math.floor(t/speed)%(Math.abs(b-a)+1));rgb.splice(n*3,3,...c.color);}
 else if(Math.floor(t/speed)%2===0)for(const n of c.mask||[])rgb.splice(n*3,3,...c.color);
 return rgb;
}
function mark(){dirty=true;$('status').textContent='Modifications non enregistrées';queuePreview();}
function draw(rgb=cuePixels(cue(),0)){const level=(cues.intensity??100)/100;buttons.forEach((b,n)=>{const c='rgb('+rgb.slice(n*3,n*3+3).map(v=>Math.round(v*level)).join(',')+')';b.style.setProperty('--led',c);b.setAttribute('aria-pressed',selected.has(n));});drawDiffuser(rgb,level);$('selection').textContent=selected.size+' LED sélectionnée'+(selected.size>1?'s':'');}
for(let n=0;n<36;n++){const x=n<12?(11-n)/11:n<17?0:n<31?(n-17)/13:1,y=n<12?1:n<17?(17-n)/6:n<31?0:(n-30)/6;const b=document.createElement('button');b.className='led';b.style.left=(x*100)+'%';b.style.top=(y*100)+'%';b.title='LED '+(n+1);b.setAttribute('aria-label','LED '+(n+1));b.onclick=()=>{stop();selected.has(n)?selected.delete(n):selected.add(n);draw();};$('board').append(b);buttons.push(b);}
for(const [name,fn] of [['Tout',n=>true],['Aucune',n=>false],['Haut',n=>n>=17&&n<31],['Bas',n=>n<12],['Gauche',n=>n>=12&&n<17],['Droite',n=>n>=31]]){const b=document.createElement('button');b.textContent=name;b.onclick=()=>{selected=new Set(buttons.map((_,n)=>n).filter(fn));draw();};$('groups').append(b);}
function paint(hex){stop();const rgb=[1,3,5].map(n=>parseInt(hex.slice(n,n+2),16));if(cue().kind&&cue().kind!=='pixels')cue().color=rgb;else selected.forEach(n=>cue().rgb.splice(n*3,3,...rgb));mark();draw();}
for(const [name,c] of [['Rouge','#ff0000'],['Orange','#ff8000'],['Jaune','#ffff00'],['Vert','#00ff00'],['Menthe','#00ff80'],['Cyan','#00ffff'],['Azur','#0080ff'],['Bleu','#0000ff'],['Violet','#8000ff'],['Magenta','#ff00ff'],['Rose','#ff0080'],['Blanc','#ffffff'],['Noir','#000000']]){const b=document.createElement('button');b.setAttribute('aria-label',name);b.title=name;b.style.cssText='background:'+c+';border:1px solid #888';b.onclick=()=>{$('color').value=c;paint(c);};$('palette').append(b);}
$('color').oninput=e=>paint(e.target.value);
function refresh(){stop();$('cues').replaceChildren();cues.forEach((c,n)=>{const b=document.createElement('button');b.textContent=String(n+1).padStart(2,'0');b.className=n===current?'selected':'';b.setAttribute('aria-pressed',n===current);b.onclick=()=>{current=n;refresh();};$('cues').append(b);});$('hold').value=cue().hold/1000;$('transition').value=cue().fade?'fade':'cut';$('fade').disabled=!cue().fade;if(cue().fade)$('fade').value=cue().fade/1000;$('add').disabled=$('duplicate').disabled=cues.length>=12;$('remove').disabled=cues.length===1;$('earlier').disabled=!current;$('later').disabled=current===cues.length-1;syncEffectControls();draw();queuePreview();}
$('hold').onchange=()=>{cue().hold=Math.round(Math.max(.1,Math.min(60,Number($('hold').value)||1))*1000);mark();refresh();};
function timing(){cue().fade=$('transition').value==='fade'?Math.round(Math.max(.1,Math.min(20,Number($('fade').value)||1))*1000):0;mark();refresh();}
$('fade').onchange=$('transition').onchange=timing;
$('add').onclick=()=>{if(cues.length>=12)return;cues.splice(++current,0,{hold:1000,fade:0,rgb:Array(108).fill(0)});mark();refresh();};
$('duplicate').onclick=()=>{if(cues.length>=12)return;const copy=JSON.parse(JSON.stringify(cue()));cues.splice(++current,0,copy);mark();refresh();};
$('remove').onclick=()=>{if(cues.length===1)return;cues.splice(current,1);current=Math.min(current,cues.length-1);mark();refresh();};
function move(d){const next=current+d;if(next<0||next>=cues.length)return;[cues[current],cues[next]]=[cues[next],cues[current]];current=next;mark();refresh();}
$('earlier').onclick=()=>move(-1);$('later').onclick=()=>move(1);
function frame(elapsed){const duration=c=>c.hold+((c.kind&&c.kind!=='pixels')?0:c.fade),total=cues.reduce((a,c)=>a+duration(c),0);let t=elapsed%total;for(let n=0;n<cues.length;n++){const c=cues[n];if(t>=duration(c)){t-=duration(c);continue;}if(c.kind&&c.kind!=='pixels')return cuePixels(c,t);const prev=cues[(n+cues.length-1)%cues.length],before=cuePixels(prev,duration(prev)-1),mix=c.fade?Math.min(1,t/c.fade):1;return c.rgb.map((b,k)=>{const a=n===0&&elapsed<total?0:before[k];return Math.floor(a+(b-a)*mix);});}}
function stop(){playing=false;$('play').textContent='Lire la séquence';queuePreview();}
function tick(now){if(!playing)return;draw(frame(now-started));requestAnimationFrame(tick);}
$('play').onclick=()=>{if(playing){stop();draw();}else{playing=true;started=performance.now();$('play').textContent='Pause';requestAnimationFrame(tick);queuePreview();}};
function checksum(a){let h=2166136261;for(let n=0;n<1352;n++)h=Math.imul(h^a[n],16777619)>>>0;return h;}
function encode(){const a=new Uint8Array(1356),v=new DataView(a.buffer);a.set([67,85,69,49,2,cues.length,cues.intensity??100,165]);cues.forEach((c,n)=>{const o=8+n*112;v.setUint16(o,c.hold,true);if(!c.kind||c.kind==='pixels'){v.setUint16(o+2,c.fade,true);a.set(c.rgb,o+4);}else{v.setUint16(o+2,0x8000|(c.kind==='strobe'?0x4000:0)|(c.speed||100),true);if(c.kind==='chase')a.set([c.start??0,c.end??35,...c.color],o+4);else{a.set(c.color,o+4);for(const led of c.mask||[])a[o+7+Math.floor(led/8)]|=1<<(led%8);}}});v.setUint32(1352,checksum(a),true);return a;}
function decode(a){if(a.length!==1356)throw Error('Taille du fichier invalide');const v=new DataView(a.buffer,a.byteOffset,a.byteLength),version=a[4];if(String.fromCharCode(...a.slice(0,4))!=='CUE1'||![1,2].includes(version)||a[5]<1||a[5]>12||(version===1?(a[6]||a[7]):(a[6]>100||a[7]!==165))||v.getUint32(1352,true)!==checksum(a))throw Error('Fichier invalide ou endommagé');const result=[];result.intensity=version===2?a[6]:100;for(let n=0;n<a[5];n++){const o=8+n*112,hold=v.getUint16(o,true),f=v.getUint16(o+2,true),rgb=Array.from(a.slice(o+4,o+112));if(hold<100||hold>60000)throw Error('Durée invalide');if(f&0x8000){const speed=f&0x3fff;if(version!==2||speed<20||speed>10000)throw Error('Vitesse invalide');if(f&0x4000)result.push({hold,fade:0,kind:'strobe',color:rgb.slice(0,3),speed,mask:Array.from({length:36},(_,i)=>i).filter(i=>rgb[3+Math.floor(i/8)]&(1<<(i%8))),rgb:Array(108).fill(0)});else{if(rgb[0]>35||rgb[1]>35)throw Error('LED invalide');result.push({hold,fade:0,kind:'chase',start:rgb[0],end:rgb[1],color:rgb.slice(2,5),speed,rgb:Array(108).fill(0)});}}else{if(f>20000)throw Error('Durée invalide');result.push({hold,fade:f,rgb});}}return result;}
async function request(url,options={}){const r=await fetch(url,{...options,signal:options.signal||AbortSignal.timeout(8000)});if(!r.ok){const e=Error(await r.text()||'Connexion impossible');e.status=r.status;throw e;}return r;}

function hexData(){return Array.from(encode()).map(n=>n.toString(16).padStart(2,'0')).join('');}
function normalizedName(value){return value.trim().normalize('NFC');}
function action(fn){return async()=>{try{await fn();}catch(e){$('status').textContent=e.message;}};}
function paintLibrary(){
  $('libraryList').replaceChildren();$('libraryCount').textContent=library.length+'/16';
  if(!library.length){const p=document.createElement('p');p.className='library-empty';p.textContent='Vos séquences enregistrées apparaîtront ici.';$('libraryList').append(p);}
  for(const item of library){const row=document.createElement('div');row.className='library-row';
    const select=document.createElement('button');select.className='library-select';select.setAttribute('aria-label',item.name);select.setAttribute('aria-pressed',item.id===editingId);select.disabled=saving||loading;const text=document.createElement('span');text.textContent=item.name;select.append(text);select.onclick=action(()=>loadAnimation(item));
    const remove=document.createElement('button');remove.className='library-delete';remove.textContent='×';remove.setAttribute('aria-label','Supprimer '+item.name);remove.disabled=saving||loading;remove.onclick=action(()=>deleteAnimation(item));row.append(select,remove);$('libraryList').append(row);
  }
  $('newAnimation').disabled=saving||loading;
}
async function refreshLibrary(){library=await (await request('/api/library')).json();paintLibrary();}
function snapshot(){return {data:hexData(),name:normalizedName($('animationName').value),id:editingId};}
async function save(){
  if(saving||loading)return;const saved=snapshot();
  if(!saved.name){$('status').textContent='Veuillez renseigner un nom pour l’animation.';$('animationName').focus();return;}
  if(library.some(item=>item.id!==saved.id&&item.name.toLocaleLowerCase('fr')===saved.name.toLocaleLowerCase('fr'))){$('status').textContent='Ce nom est déjà utilisé. Veuillez saisir un nom différent.';return;}
  saving=true;$('save').disabled=true;paintLibrary();
  try{const body=new URLSearchParams({name:saved.name,data:saved.data});if(saved.id!==null)body.set('id',saved.id);
    const result=await (await request('/api/library/save',{method:'POST',body})).json();
    editingId=result.id;const unchanged=hexData()===saved.data&&normalizedName($('animationName').value)===saved.name;
    if(unchanged){dirty=false;$('animationName').value=saved.name;}
    $('status').textContent=unchanged?'Animation enregistrée':'Enregistrée ; des modifications restent à enregistrer.';
    await refreshLibrary();
  }finally{saving=false;$('save').disabled=false;paintLibrary();}
}
async function loadAnimation(item){
  if(saving||loading)return;if(dirty&&!confirm('Abandonner les modifications non enregistrées ?'))return;
  loading=true;paintLibrary();
  try{const parsed=decode(new Uint8Array(await (await request('/api/library/get?id='+item.id)).arrayBuffer()));cues=parsed;current=0;editingId=item.id;$('animationName').value=item.name;dirty=false;refresh();$('status').textContent='';}
  finally{loading=false;paintLibrary();}
}
function clearEditor(){editingId=null;cues=[{hold:1000,fade:0,rgb:Array(108).fill(0)}];current=0;$('animationName').value='';dirty=false;refresh();paintLibrary();$('status').textContent='';}
$('newAnimation').onclick=()=>{if(saving||loading)return;if(dirty&&!confirm('Abandonner les modifications non enregistrées ?'))return;clearEditor();};
async function deleteAnimation(item){
  if(saving||loading)return;await request('/api/library/delete',{method:'POST',body:new URLSearchParams({id:item.id})});
  if(editingId===item.id)clearEditor();await refreshLibrary();$('status').textContent='Animation supprimée';
}
function previewError(e){
  const fatal=e.status&&e.status<500;
  if(!fatal&&++previewMisses<3){$('status').textContent='Reconnexion de l’aperçu…';queuePreview();return;}
  $('physicalPreview').checked=false;previewReady=false;previewPending=false;previewFailed=true;clearTimeout(previewTimer);previewTimer=0;$('status').textContent='Aperçu arrêté : '+e.message;
}
function queuePreview(){
  if(!$('physicalPreview').checked)return;
  previewPending=true;
  if(previewTimer||previewBusy)return;
  previewTimer=setTimeout(flushPhysicalPreview,100);
}
function flushPhysicalPreview(){
  previewTimer=0;
  if(previewBusy||!$('physicalPreview').checked||!previewPending)return;
  previewPending=false;
  sendPhysicalPreview(false);
}
function sendPhysicalPreview(ping){
  if(previewBusy||!$('physicalPreview').checked)return;
  const version=previewVersion,activeToken=token;
  const body=ping?new URLSearchParams({token:activeToken}):new URLSearchParams({token:activeToken,data:hexData(),cue:current,play:playing?'1':'0',elapsed:playing?Math.floor(performance.now()-started):0});
  previewBusy=true;
  previewQueue=(async()=>{
    try{
      await request('/api/library/preview'+(ping?'/ping':''),{method:'POST',body,signal:AbortSignal.timeout(4000)});
      if(version===previewVersion){previewReady=true;previewMisses=0;}
    }catch(e){if(version===previewVersion)previewError(e);}
    finally{previewBusy=false;if($('physicalPreview').checked&&previewPending)queuePreview();}
  })();
}
async function stopPhysicalPreview(){
  const stoppedToken=token;previewVersion++;previewReady=false;previewPending=false;clearTimeout(previewTimer);previewTimer=0;$('physicalPreview').checked=false;
  await previewQueue.catch(()=>{});await request('/api/library/preview/stop',{method:'POST',body:new URLSearchParams({token:stoppedToken})});
}
$('physicalPreview').onchange=action(async()=>{
  if($('physicalPreview').checked){token=makeToken();previewVersion++;previewReady=false;previewMisses=0;previewFailed=false;queuePreview();$('status').textContent='Aperçu sur le boîtier activé';}
  else{await stopPhysicalPreview();$('status').textContent='Aperçu sur le boîtier désactivé';}
});
setInterval(()=>{
  if(!$('physicalPreview').checked||previewBusy||previewTimer||previewPending)return;
  if(!previewReady){queuePreview();return;}
  sendPhysicalPreview(true);
},1000);
document.addEventListener('visibilitychange',()=>{if(document.hidden&&$('physicalPreview').checked){stop();stopPhysicalPreview().catch(previewError);}});
window.addEventListener('pagehide',()=>{navigator.sendBeacon('/api/library/preview/stop',new URLSearchParams({token}));});
function syncEffectControls(){
 const c=cue(),kind=c.kind||'pixels';$('cueKind').value=kind;$('speedGroup').hidden=kind==='pixels';$('startGroup').hidden=$('endGroup').hidden=kind!=='chase';$('applyMask').hidden=kind!=='strobe';$('effectSpeed').value=c.speed||100;$('chaseStart').value=(c.start??0)+1;$('chaseEnd').value=(c.end??35)+1;$('transition').disabled=kind!=='pixels';$('fade').disabled=kind!=='pixels'||!c.fade;$('animationIntensity').value=cues.intensity??100;$('intensityValue').value=(cues.intensity??100)+' %';
}
$('animationIntensity').oninput=()=>{cues.intensity=Number($('animationIntensity').value);$('intensityValue').value=cues.intensity+' %';mark();draw();};
$('cueKind').onchange=()=>{stop();const c=cue(),kind=$('cueKind').value;if(kind==='pixels'){c.rgb=cuePixels(c,0);c.kind='pixels';c.fade=0;}else{c.kind=kind;c.color=[1,3,5].map(n=>parseInt($('color').value.slice(n,n+2),16));c.start=0;c.end=35;c.speed=100;c.mask=Array.from(selected);c.fade=0;if(kind==='chase')c.hold=3600;}mark();refresh();};
function setEffect(){const c=cue();c.speed=Math.round(Math.max(20,Math.min(10000,Number($('effectSpeed').value)||100)));c.start=Math.round(Math.max(1,Math.min(36,Number($('chaseStart').value)||1)))-1;c.end=Math.round(Math.max(1,Math.min(36,Number($('chaseEnd').value)||36)))-1;if(c.kind==='chase'){const count=Math.abs(c.end-c.start)+1;c.speed=Math.min(c.speed,Math.floor(60000/count));c.hold=Math.max(100,count*c.speed);}mark();refresh();}
$('effectSpeed').onchange=$('chaseStart').onchange=$('chaseEnd').onchange=setEffect;$('applyMask').onclick=()=>{cue().mask=Array.from(selected);mark();draw();};
function solidCue(rgb,hold=1000,fade=0){return {hold,fade,rgb:Array.from({length:36},()=>rgb).flat()};}
const templates=[
 ['Rouge · Bleu · Vert',()=>[[255,0,0],[0,0,255],[0,255,0]].map(c=>solidCue(c,1000,400))],
 ['Respiration',()=>[solidCue([255,0,0],100,1800),solidCue([12,0,0],100,1800)]],
 ['Arc-en-ciel horizontal',()=>Array.from({length:6},(_,phase)=>({hold:250,fade:200,rgb:Array.from({length:36},(_,n)=>{const x=n<12?(11-n)/11:n<17?0:n<31?(n-17)/13:1,h=((x*.8-phase/6)%1+1)%1,f=h*6,k=Math.floor(f),v=Math.round((f-k)*255);return [[255,v,0],[255-v,255,0],[0,255,v],[0,255-v,255],[v,0,255],[255,0,255-v]][k];}).flat()}))],
 ['Chenillard',()=>[{...solidCue([0,0,0],4000),kind:'chase',start:0,end:35,speed:100,color:[0,255,0]}]],
 ['Flash / strobe',()=>[{...solidCue([0,0,0],3000),kind:'strobe',speed:100,color:[255,255,255],mask:Array.from({length:36},(_,n)=>n)}]]
];
function replaceTimeline(data,name,id=null){if(dirty&&!confirm('Abandonner les modifications non enregistrées ?'))return;stop();cues=data;current=0;editingId=id;$('animationName').value=name;dirty=id===null;refresh();paintLibrary();$('bank').close();$('status').textContent=id===null?'Nouvelle animation à enregistrer':'';}
async function recallAnimation(item,copy=false){const data=decode(new Uint8Array(await (await request('/api/library/get?id='+item.id)).arrayBuffer()));replaceTimeline(data,copy?item.name+' copie':item.name,copy?null:item.id);}
function bankRow(name,actions){const row=document.createElement('div');row.className='bank-row';const label=document.createElement('span');label.textContent=name;row.append(label);for(const [title,fn] of actions){const button=document.createElement('button');button.textContent=title;button.onclick=action(fn);row.append(button);}return row;}
$('bankOpen').onclick=action(async()=>{await refreshLibrary();$('templateList').replaceChildren();$('bankSaved').replaceChildren();for(const [name,make] of templates)$('templateList').append(bankRow(name,[['Utiliser',()=>replaceTimeline(make(),name)]]));for(const item of library)$('bankSaved').append(bankRow(item.name,[['Modifier',()=>recallAnimation(item)],['Copier',()=>recallAnimation(item,true)]]));if(!library.length)$('bankSaved').textContent='Aucune animation enregistrée';$('bank').showModal();});$('bankClose').onclick=()=>$('bank').close();
$('animationName').oninput=mark;$('save').onclick=action(save);
$('export').onclick=()=>{const url=URL.createObjectURL(new Blob([encode()],{type:'application/octet-stream'})),a=document.createElement('a');a.href=url;a.download=(normalizedName($('animationName').value)||'ON_AIR_animation')+'.onair';document.body.append(a);a.click();a.remove();setTimeout(()=>URL.revokeObjectURL(url),60000);};
$('import').onclick=()=>$('file').click();$('file').onchange=action(async()=>{const f=$('file').files[0];if(!f)return;const parsed=decode(new Uint8Array(await f.arrayBuffer()));cues=parsed;current=0;if(!$('animationName').value)$('animationName').value=f.name.replace(/\.onair$/i,'').slice(0,32);mark();refresh();});
window.addEventListener('beforeunload',e=>{if(dirty){e.preventDefault();e.returnValue='';}});
refresh();refreshLibrary().catch(e=>{$('status').textContent=e.message;});
</script></html>)EDITOR";
void sendAnimationPage(){
  if(!webMemoryReady())return;
  server.sendHeader("Cache-Control","no-store");server.send_P(200,"text/html; charset=utf-8",ANIMATION_EDITOR_HTML);
}

void handleCustomGet(){
  uint8_t i;if(!parseMacroIndex(i)){server.send_P(400,PSTR("text/plain"),PSTR("Émission invalide"));return;}
  i+=server.arg("kind")=="alert"?MACRO_COUNT:0;
  char path[24];snprintf(path,sizeof(path),"/custom%u.bin",i);
  File f=LittleFS.open(path,"r");
  if(!f){server.send_P(204,PSTR("text/plain"),PSTR(""));return;}
  server.streamFile(f,"application/octet-stream");f.close();
}
void handleCustomSave(){
  uint8_t i;if(!parseMacroIndex(i)){server.send_P(400,PSTR("text/plain"),PSTR("Émission invalide"));return;}
  i+=server.arg("kind")=="alert"?MACRO_COUNT:0;
  String hex=server.arg("data");
  if(hex.length()!=2712){server.send_P(400,PSTR("text/plain"),PSTR("Taille invalide"));return;}
  uint8_t data[1356];
  for(size_t n=0;n<sizeof(data);n++){
    char a=hex[n*2],b=hex[n*2+1];
    int hi=a>='0'&&a<='9'?a-'0':a>='a'&&a<='f'?a-'a'+10:-1;
    int lo=b>='0'&&b<='9'?b-'0':b>='a'&&b<='f'?b-'a'+10:-1;
    if(hi<0||lo<0){server.send_P(400,PSTR("text/plain"),PSTR("Format invalide"));return;}data[n]=(hi<<4)|lo;
  }
  if(!validCustom(data)){server.send_P(400,PSTR("text/plain"),PSTR("Animation invalide"));return;}
  char path[24],temp[24];snprintf(path,sizeof(path),"/custom%u.bin",i);snprintf(temp,sizeof(temp),"/custom%u.tmp",i);
  File f=LittleFS.open(temp,"w");bool ok=f&&f.write(data,sizeof(data))==sizeof(data);f.flush();f.close();
  if(!ok||!LittleFS.rename(temp,path)){server.send_P(500,PSTR("text/plain"),PSTR("Enregistrement impossible"));return;}
  customOwner=-1;server.send_P(200,PSTR("text/plain"),PSTR("Enregistré"));
}
void handleCustomTest(){
  uint8_t i;if(!parseMacroIndex(i)){server.send_P(400,PSTR("text/plain"),PSTR("Émission invalide"));return;}
  if(outputEnabled||alertRunning){server.send_P(409,PSTR("text/plain"),PSTR("Arrêtez le direct avant le test"));return;}
  bool alert=server.arg("kind")=="alert";
  if(!loadCustom(i+(alert?MACRO_COUNT:0))){server.send_P(400,PSTR("text/plain"),PSTR("Enregistrez une animation"));return;}
  // Preview uses the normal bounded preview scheduler, without changing saved settings.
  showMacroPreview(i,true);previewMotionMacro=i;previewMotionDirect=true;
  customPreview=true;customPreviewAlert=alert;renderCustomOutput(i,0,alert);settingsPreviewUntil=millis()+15000UL;
  server.send_P(200,PSTR("text/plain"),PSTR("Test : 15 secondes maximum"));
}

// BEGIN OTA STATE
static bool otaReceiving=false,otaValidated=false,otaRejected=false,otaRequestOpen=false;
static size_t otaReceived=0,otaExpected=0;
static uint32_t otaRestartAt=0,otaBootId=0;
static char otaError[192]={},otaExpectedMD5[33]={},otaSession[41]={};
// END OTA STATE
void otaFail(const char* error){
  snprintf(otaError,sizeof(otaError),"%s",error);otaValidated=false;otaReceiving=false;
}
void otaStopEffects(){
  blackout();libraryPreviewActive=false;libraryPreviewToken[0]=0;customOwner=-1;
}
void otaCancelWriter(){
  if(Update.isRunning())Update.end(false);
}
void handleFirmwareUpload(){
  HTTPUpload& u=server.upload();
  if(u.status==UPLOAD_FILE_START){
    otaRejected=otaRestartAt!=0||otaRequestOpen;
    if(otaRejected)return;
    otaRequestOpen=true;otaValidated=false;otaReceiving=false;otaReceived=0;otaExpected=0;
    otaError[0]=0;otaExpectedMD5[0]=0;
    String session=server.arg("session");snprintf(otaSession,sizeof(otaSession),"%s",session.c_str());
    if(u.name!="firmware"){otaFail("Sélectionnez un fichier firmware .bin.");return;}
    String sizeArg=server.arg("size"),md5=server.arg("md5");md5.toLowerCase();
    if(sizeArg.length()){
      for(size_t i=0;i<sizeArg.length();i++)if(sizeArg[i]<'0'||sizeArg[i]>'9'){otaFail("Taille du fichier invalide.");return;}
      long size=sizeArg.toInt();if(size<32||size>1048576){otaFail("Taille du firmware invalide.");return;}otaExpected=(size_t)size;
      if(md5.length()!=32){otaFail("Empreinte du fichier manquante.");return;}
    }
    if(md5.length()){
      if(md5.length()!=32){otaFail("Empreinte du fichier invalide.");return;}
      for(size_t i=0;i<32;i++)if(!((md5[i]>='0'&&md5[i]<='9')||(md5[i]>='a'&&md5[i]<='f'))){otaFail("Empreinte du fichier invalide.");return;}
      snprintf(otaExpectedMD5,sizeof(otaExpectedMD5),"%s",md5.c_str());
    }
    uint32_t freeSpace=ESP.getFreeSketchSpace();
    uint32_t maximum=freeSpace>0x1000?(freeSpace-0x1000)&0xFFFFF000:0;
    if(!maximum||(otaExpected&&otaExpected>maximum)){otaFail("Espace OTA insuffisant pour ce fichier.");return;}
    // Exactly one blackout BEFORE flash writes. No pixel.show or animation callbacks during OTA.
    otaStopEffects();WiFi.setSleepMode(WIFI_NONE_SLEEP);
    if(!Update.begin(otaExpected?otaExpected:maximum,U_FLASH)){otaFail(Update.getErrorString().c_str());return;}
    if(otaExpectedMD5[0]&&!Update.setMD5(otaExpectedMD5)){otaFail("Empreinte refusée.");otaCancelWriter();return;}
    otaReceiving=true;
  }else if(u.status==UPLOAD_FILE_WRITE){
    if(otaRejected||!otaReceiving||otaError[0])return;
    if(!otaReceived&&(!u.currentSize||u.buf[0]!=0xE9)){otaFail("Le fichier choisi n’est pas un firmware ESP8266 .bin.");otaCancelWriter();return;}
    if(otaExpected&&u.currentSize>otaExpected-otaReceived){otaFail("Le fichier dépasse la taille annoncée.");otaCancelWriter();return;}
    if(Update.write(u.buf,u.currentSize)!=u.currentSize){otaFail(Update.getErrorString().c_str());otaCancelWriter();return;}
    otaReceived+=u.currentSize;
  }else if(u.status==UPLOAD_FILE_END){
    if(otaRejected||!otaReceiving||otaError[0])return;
    if(!otaReceived||otaReceived!=u.totalSize||(otaExpected&&otaReceived!=otaExpected)){
      otaFail("Transfert incomplet. Le boîtier n’a pas reçu tout le fichier.");otaCancelWriter();return;
    }
    if(!Update.end(otaExpected==0)||Update.hasError()){
      otaFail(Update.getErrorString().c_str());otaCancelWriter();return;
    }
    otaReceiving=false;otaValidated=true;
  }else if(u.status==UPLOAD_FILE_ABORTED){
    if(!otaRejected){otaFail("Transfert interrompu avant validation.");otaCancelWriter();}otaRequestOpen=false;
  }
  yield();
}
void handleFirmwareComplete(){
  otaRequestOpen=false;
  server.sendHeader("Cache-Control","no-store");server.sendHeader("Connection","close");
  if(otaRejected||otaRestartAt){server.send_P(409,PSTR("application/json"),PSTR("{\"ok\":false,\"error\":\"Une mise à jour est déjà en cours.\"}"));return;}
  if(!otaValidated||otaError[0]){
    if(!otaError[0])otaFail("Aucun firmware validé n’a été reçu.");
    server.send(400,"application/json",String(F("{\"ok\":false,\"error\":\""))+jsonEscape(String(otaError))+"\"}");return;
  }
  server.client().setNoDelay(true);
  server.send(200,"application/json",String(F("{\"ok\":true,\"md5\":\""))+otaExpectedMD5+"\"}");
  // The acknowledgement is sent first; the main loop restarts later without animations.
  otaRestartAt=millis()+1800UL;
}
void serviceFirmwareUpdate(){
  if(otaRestartAt&&(int32_t)(millis()-otaRestartAt)>=0){otaRestartAt=0;ESP.restart();}
}
String firmwareFlashMD5(size_t size,int originalFlashMode){
  if(!size||size>1048576)return String();
  alignas(4) uint8_t buffer[512];MD5Builder hash;hash.begin();
  for(size_t offset=0;offset<size;offset+=sizeof(buffer)){
    size_t n=min(sizeof(buffer),size-offset);
    if(!ESP.flashRead(offset,reinterpret_cast<uint32_t*>(buffer),(n+3)&~size_t(3)))return String();
    // The ESP8266 updater may adapt header byte 2 to the chip flash mode.
    if(offset==0&&originalFlashMode>=0&&originalFlashMode<=3)buffer[2]=(uint8_t)originalFlashMode;
    hash.add(buffer,n);yield();
  }
  hash.calculate();return hash.toString();
}
void handleFirmwareStatus(){
  String verified;
  if(server.hasArg("verify_size")&&!otaReceiving&&!otaRestartAt)verified=firmwareFlashMD5(server.arg("verify_size").toInt(),server.hasArg("flash_mode")?server.arg("flash_mode").toInt():-1);
  String state=otaReceiving?"receiving":otaRestartAt?"ready":otaError[0]?"error":"idle";
  String out = F("{\"boot\":\"");out+=String(otaBootId,HEX);out += F("\",\"version\":\"");out+=FIRMWARE_VERSION;
  out += F("\",\"state\":\"");out+=state;out += F("\",\"session\":\"");out+=jsonEscape(String(otaSession));
  out += F("\",\"error\":\"");out+=jsonEscape(String(otaError));out += F("\",\"verified_md5\":\"");out+=verified;out += F("\"}");
  server.sendHeader("Cache-Control","no-store");server.send(200,"application/json",out);
}

void setupWebServer() {
  server.on("/health",HTTP_GET,handleHealth);
  server.on("/api/health",HTTP_GET,handleHealth);
  server.on("/favicon.ico",HTTP_GET,[](){server.send(204,"text/plain","");});
  server.on("/apple-touch-icon.png",HTTP_GET,[](){server.send(204,"text/plain","");});
  server.on("/api/library",HTTP_GET,handleLibraryList);
  server.on("/api/library/get",HTTP_GET,handleLibraryGet);
  server.on("/api/library/save",HTTP_POST,handleLibrarySave);
  server.on("/api/library/delete",HTTP_POST,handleLibraryDelete);
  server.on("/api/library/preview",HTTP_POST,handleLibraryPreview);
  server.on("/api/library/preview/ping",HTTP_POST,handleLibraryPreviewPing);
  server.on("/api/library/preview/stop",HTTP_POST,handleLibraryPreviewStop);
  server.on("/animation",HTTP_GET,sendAnimationPage);
  server.on("/api/custom",HTTP_GET,handleCustomGet);
  server.on("/api/custom/save",HTTP_POST,handleCustomSave);
  server.on("/api/custom/test",HTTP_POST,handleCustomTest);
  server.on("/style.css",HTTP_GET,handleStyleCSS);

  server.on("/",HTTP_GET,sendControlPage);

  server.on("/settings",HTTP_GET,sendSettingsPage);

  server.on("/macro",HTTP_GET,[](){
    if (!server.hasArg("i")) {
      server.send_P(400,PSTR("text/plain"),PSTR("Macro invalide"));
      return;
    }

    int i = server.arg("i").toInt();

    if (i < 0 || i >= MACRO_COUNT) {
      server.send_P(400,PSTR("text/plain"),PSTR("Macro invalide"));
      return;
    }

    sendMacroSettingsPage((uint8_t)i);
  });
  server.on("/ping",HTTP_GET,[](){
    server.sendHeader("Connection","close");
    server.send_P(200,PSTR("text/plain"),PSTR("ON_AIR-MOC OK"));
  });

  server.on("/diagnostics",HTTP_GET,sendDiagnosticsPage);

  server.on("/config/export",HTTP_GET,handleConfigExport);
  server.on("/config/import",HTTP_POST,handleConfigImportComplete,handleConfigImportData);
  server.on("/api/status",HTTP_GET,handleStatus);
  server.on("/api/uihealth",HTTP_GET,[](){
    server.send_P(200,PSTR("application/json"),PSTR("{\"css\":true,\"version\":\"2.13\"}"));
  });
  server.on("/api/direct",HTTP_GET,handleDirect);
  server.on("/api/alert",HTTP_GET,handleAlert);
  server.on("/api/alertTest",HTTP_GET,handleAlertTest);
  server.on("/api/off",HTTP_GET,handleOff);
  server.on("/api/startup",HTTP_GET,handleStartupTest);
  server.on("/api/wifiscan/start",HTTP_GET,handleWiFiScanStart);
  server.on("/api/wifiscan/result",HTTP_GET,handleWiFiScanResult);
  server.on("/api/macroSave",HTTP_GET,handleMacroAutoSave);
  server.on("/api/macroPreview",HTTP_GET,handleMacroPreview);
  server.on("/saveGeneral",HTTP_POST,handleSaveGeneral);
  server.on("/saveExternalWiFi",HTTP_POST,handleSaveExternalWiFi);
  server.on("/forgetWiFi",HTTP_POST,handleForgetWiFi);
  server.on("/saveMacro",HTTP_POST,handleSaveMacro);
  server.on("/uploadLogo",HTTP_POST,handleUploadLogoComplete,handleUploadLogoData);
  server.on("/deleteLogo",HTTP_POST,handleDeleteLogo);
  server.on("/logo",HTTP_GET,handleLogo);
  server.on("/reboot",HTTP_POST,handleReboot);
  server.on("/factoryReset",HTTP_POST,handleFactoryReset);

  // Un navigateur peut conserver l'URL du formulaire apres le redemarrage.
  // Ces GET evitent alors un faux 404.
  server.on("/saveGeneral",HTTP_GET,redirectHome);
  server.on("/saveExternalWiFi",HTTP_GET,redirectHome);
  server.on("/saveMacro",HTTP_GET,redirectHome);
  server.on("/uploadLogo",HTTP_GET,redirectHome);

  // Apple's Captive Network Assistant (CNA) attend une REPONSE HTML
  // reelle a hotspot-detect.html, et non une redirection HTTP vide.
  server.on("/hotspot-detect.html",HTTP_GET,sendAppleCaptivePortal);
  server.on("/library/test/success.html",HTTP_GET,sendAppleCaptivePortal);
  server.on("/success.html",HTTP_GET,sendAppleCaptivePortal);
  server.on("/captive",HTTP_GET,sendAppleCaptivePortal);

  // Android / Windows utilisent des sondes differentes.
  server.on("/generate_204",HTTP_GET,redirectCaptivePortal);
  server.on("/gen_204",HTTP_GET,redirectCaptivePortal);
  server.on("/connecttest.txt",HTTP_GET,redirectCaptivePortal);
  server.on("/ncsi.txt",HTTP_GET,redirectCaptivePortal);
  server.on("/fwlink",HTTP_GET,redirectCaptivePortal);
  server.on("/redirect",HTTP_GET,redirectCaptivePortal);

  // Diagnostic accessible sans navigateur CNA.
  server.on("/api/captiveStatus",HTTP_GET,[](){
    char buf[125];
    snprintf(buf,sizeof(buf),
      "{\"ios\":%lu,\"other\":%lu,\"ap_clients\":%u}",
      (unsigned long)iosCaptiveProbeCount,
      (unsigned long)otherCaptiveProbeCount,
      (unsigned int)WiFi.softAPgetStationNum());
    server.sendHeader("Cache-Control","no-store");
    server.send(200,"application/json",buf);
  });

  // Les adresses inconnues renvoient vers le mini portail.
  server.onNotFound(redirectCaptivePortal);

  server.on("/firmware", HTTP_GET, sendFirmwarePage);
  server.on("/update",HTTP_GET,sendFirmwarePage);
  server.on("/update",HTTP_POST,handleFirmwareComplete,handleFirmwareUpload);
  server.on("/api/firmware/status",HTTP_GET,handleFirmwareStatus);

  // DNS wildcard necessaire au popup de portail captif iOS.
  // Les clients connectes a l'AP utilisent l'ESP comme DNS et tous les domaines
  // inconnus sont renvoyes vers 192.168.4.1.
  dnsServer.start(53, "*", AP_IP);
  Serial.println(F("[CAPTIVE] DNS wildcard actif sur 192.168.4.1"));

  server.begin();
  Serial.println(F("[WEB] Serveur HTTP demarre"));
  Serial.println(F("[OTA] Interface : /update"));
}

void startAccessPoint() {
  Serial.println();
  Serial.println(F("[WIFI AP] Initialisation..."));

  WiFi.persistent(false);
  WiFi.mode(WIFI_OFF);
  delay(250);

  // Si le Wi-Fi externe est active, l'ESP travaille simultanement
  // en point d'acces + station.
  WiFi.mode(config.externalWiFiEnabled ? WIFI_AP_STA : WIFI_AP);
  delay(250);

  bool ipOK = WiFi.softAPConfig(AP_IP, AP_GW, AP_MASK);
  Serial.println("[WIFI AP] Config IP = " + String(ipOK ? "OK" : "ECHEC"));

  bool ok = WiFi.softAP(
    config.apSSID,
    config.apPassword,
    6,
    false,
    4
  );

  delay(300);

  if (ok) {
    Serial.println(F("[WIFI AP] OK"));
    Serial.println("[WIFI AP] SSID = " + String(config.apSSID));
    Serial.println("[WIFI AP] IP = " + WiFi.softAPIP().toString());

    // Priorite a la reactivite de l'interface.
    WiFi.setSleepMode(WIFI_NONE_SLEEP);
    Serial.println(F("[WIFI AP] Sleep Wi-Fi desactive pour stabilite"));

  } else {
    setStartupIndicatorState(STARTUP_IND_ERROR);
    Serial.println(F("[WIFI AP] ECHEC du reseau securise"));
    Serial.println(F("[WIFI AP] Tentative ONAIR-RECOVERY sans mot de passe"));

    WiFi.softAPdisconnect(true);
    delay(250);

    WiFi.mode(config.externalWiFiEnabled ? WIFI_AP_STA : WIFI_AP);
    WiFi.softAPConfig(AP_IP, AP_GW, AP_MASK);

    bool recoveryOK = WiFi.softAP("ONAIR-RECOVERY", nullptr, 6, false, 4);

    if (recoveryOK) {
      Serial.println(F("[WIFI AP] RECOVERY OK"));
      Serial.println("[WIFI AP] IP = " + WiFi.softAPIP().toString());
      WiFi.setSleepMode(WIFI_NONE_SLEEP);
    } else {
      Serial.println(F("[WIFI AP] ECHEC TOTAL"));
    }
  }
}

bool connectBestKnownWiFi() {
  if (!config.externalWiFiEnabled || config.knownWiFiCount == 0) {
    return false;
  }

  Serial.println();
  Serial.println(F("[WIFI EXT] Recherche du meilleur reseau memorise..."));

  if (WiFi.getMode() != WIFI_AP_STA) {
    WiFi.mode(WIFI_AP_STA);
    delay(100);
  }

  WiFi.hostname(MDNS_HOSTNAME);

  WiFi.scanDelete();
  int n = WiFi.scanNetworks(false, false);

  int bestKnown = -1;
  int32_t bestRSSI = -1000;

  if (n > 0) {
    for (int scanIndex = 0; scanIndex < n; scanIndex++) {
      String seenSSID = WiFi.SSID(scanIndex);
      int knownIndex = findKnownWiFi(seenSSID);

      if (knownIndex >= 0 && WiFi.RSSI(scanIndex) > bestRSSI) {
        bestRSSI = WiFi.RSSI(scanIndex);
        bestKnown = knownIndex;
      }
    }
  }

  WiFi.scanDelete();

  if (bestKnown < 0) {
    Serial.println(F("[WIFI EXT] Aucun reseau memorise disponible"));
    currentKnownWiFiAttempt = -1;
    return false;
  }

  currentKnownWiFiAttempt = bestKnown;

  Serial.println(
    "[WIFI EXT] Connexion a " +
    String(config.knownWiFi[bestKnown].ssid) +
    " | RSSI " + String(bestRSSI) + " dBm"
  );

  WiFi.begin(
    config.knownWiFi[bestKnown].ssid,
    config.knownWiFi[bestKnown].password
  );

  externalConnectStarted = true;
  lastExternalReconnectAt = millis();

  return true;
}

void startMDNSIfPossible();

void applyPendingExternalWiFi() {
  if (!pendingExternalWiFiApply) return;

  if ((long)(millis() - pendingExternalWiFiApplyAt) < 0) {
    return;
  }

  pendingExternalWiFiApply = false;

  if (!config.externalWiFiEnabled) {
    Serial.println(F("[WIFI EXT] Desactivation a chaud"));

    // Deconnecte uniquement la partie station.
    WiFi.disconnect(false);
    externalConnectStarted = false;
    currentKnownWiFiAttempt = -1;
    mdnsStarted = false;

    // Le point d'acces ON_AIR-MOC reste present.
    if (WiFi.getMode() != WIFI_AP) {
      WiFi.mode(WIFI_AP);
    }

    return;
  }

  if (config.knownWiFiCount == 0) {
    Serial.println(F("[WIFI EXT] Aucun reseau memorise a appliquer"));
    return;
  }

  const char* targetSSID = config.knownWiFi[0].ssid;
  const char* targetPassword = config.knownWiFi[0].password;

  // Si on est deja connecte au reseau demande, ne touche a rien.
  if (WiFi.status() == WL_CONNECTED &&
      WiFi.SSID() == String(targetSSID)) {

    Serial.println(
      "[WIFI EXT] Deja connecte a " +
      String(targetSSID) +
      " | IP=" + WiFi.localIP().toString()
    );

    externalConnectStarted = true;
    lastExternalReconnectAt = millis();

    startMDNSIfPossible();
    return;
  }

  Serial.println(
    "[WIFI EXT] Connexion a chaud vers " +
    String(targetSSID) +
    " (sans reboot)"
  );

  if (WiFi.getMode() != WIFI_AP_STA) {
    WiFi.mode(WIFI_AP_STA);
    delay(20);
  }

  WiFi.hostname(MDNS_HOSTNAME);

  // Coupe/reinitialise uniquement le client STA.
  WiFi.disconnect(false);
  delay(20);

  mdnsStarted = false;

  WiFi.begin(targetSSID, targetPassword);

  externalConnectStarted = true;
  currentKnownWiFiAttempt = 0;
  lastExternalReconnectAt = millis();
}

void startExternalWiFi() {
  if (!config.externalWiFiEnabled) {
    Serial.println(F("[WIFI EXT] Desactive"));
    return;
  }

  if (config.knownWiFiCount == 0) {
    Serial.println(F("[WIFI EXT] Aucun Wi-Fi memorise"));
    return;
  }

  // IMPORTANT POUR IPHONE :
  // Ne pas lancer de scan Wi-Fi synchrone pendant que le telephone effectue
  // sa premiere detection captive. WiFi.begin() rend la main immediatement.
  // Le scan du meilleur reseau reste disponible pour la reconnexion plus tard.
  if (WiFi.getMode() != WIFI_AP_STA) WiFi.mode(WIFI_AP_STA);
  WiFi.hostname(MDNS_HOSTNAME);
  WiFi.begin(config.knownWiFi[0].ssid,config.knownWiFi[0].password);
  currentKnownWiFiAttempt = 0;
  externalConnectStarted = true;
  lastExternalReconnectAt = millis();

  Serial.println("[WIFI EXT] Connexion directe sans scan bloquant : " +
                 String(config.knownWiFi[0].ssid));
}

void startMDNSIfPossible() {
  if (mdnsStarted || WiFi.status() != WL_CONNECTED) return;
  // A failed discovery allocation must not trigger another attempt every loop.
  static unsigned long lastMDNSAttempt=0;
  if(lastMDNSAttempt&&millis()-lastMDNSAttempt<5000UL)return;
  if(ESP.getFreeHeap()<12000||ESP.getMaxFreeBlockSize()<6000)return;
  lastMDNSAttempt=millis();

  setStartupIndicatorState(STARTUP_IND_MDNS);

  if (MDNS.begin(MDNS_HOSTNAME)) {
    MDNS.addService("http", "tcp", 80);
    mdnsStarted = true;

    Serial.println(F("[mDNS] OK"));
    Serial.println("[mDNS] http://" + String(MDNS_HOSTNAME) + ".local");
  } else {
    Serial.println(F("[mDNS] ECHEC"));
  }
}

void updateExternalWiFi() {
  if (!config.externalWiFiEnabled || config.knownWiFiCount == 0) return;

  // Ne lance jamais un second scan pendant une operation manuelle.
  if (wifiScanRunning || wifiScanStartRequested || pendingExternalWiFiApply) return;

  if (WiFi.status() == WL_CONNECTED) {
    startMDNSIfPossible();
    return;
  }

  mdnsStarted = false;

  unsigned long now = millis();

  if (!externalConnectStarted ||
      now - lastExternalReconnectAt >= EXTERNAL_RECONNECT_MS) {

    // Un scan automatique peut faire sauter momentanement un client
    // connecte directement a ON_AIR-MOC. On privilegie donc l'interface :
    // tant qu'un telephone est sur l'AP, aucun scan automatique.
    if (WiFi.softAPgetStationNum() > 0) {
      return;
    }

    externalConnectStarted = true;
    lastExternalReconnectAt = now;

    connectBestKnownWiFi();
  }
}

void setup() {
  otaBootId=ESP.random();
  Serial.begin(115200);
  delay(150);
  Serial.println();
  Serial.println(F("==========================================="));
  Serial.println(F(" CARAC ON AIR MANUAL - ESP8266"));
  Serial.println(" Firmware " + String(FIRMWARE_VERSION));
  Serial.println(F("==========================================="));

  pixels.begin();
  pixels.setBrightness(255);
  pixels.clear();
  pixels.show();

  Serial.println(F("[LED] WS2812E adressable"));
  Serial.println(F("[LED] D5 / GPIO14 | 36 LED | GRB 800 kHz"));
  Serial.println("[LED SAFETY] Limite globale sortie = " + String(LED_GLOBAL_MAX_PERCENT) + "%");

  if (!LittleFS.begin()) Serial.println(F("[FS] ECHEC LittleFS"));
  else Serial.println(F("[FS] LittleFS OK"));

  Serial.printf_P(PSTR("[BOOT] reset=%s | heap=%u | maxblock=%u\n"),ESP.getResetReason().c_str(),ESP.getFreeHeap(),ESP.getMaxFreeBlockSize());
  Serial.println(ESP.getResetInfo());
  loadConfig();
  loadMotionSettings();
  migrateAnimationLibrary();

  // Etat initial propre, puis indicateur de progression sans ralentir le boot.
  blackout();

  // Le Wi-Fi apparait immediatement au demarrage.
  startAccessPoint();
  setupWebServer();

  if (config.externalWiFiEnabled && config.knownWiFiCount > 0) {
    setStartupIndicatorState(STARTUP_IND_WIFI);
  }

  startExternalWiFi();

  if (!config.externalWiFiEnabled || config.knownWiFiCount == 0) {
    setStartupIndicatorState(STARTUP_IND_READY);
  }

  Serial.println("[READY] Wi-Fi autonome : " + String(config.apSSID));
  Serial.println(F("[READY] Acces direct GARANTI : http://192.168.4.1"));
  Serial.println(F("[READY] .local uniquement sur le Wi-Fi externe"));
  if (config.externalWiFiEnabled) {
    Serial.println("[READY] Wi-Fi memorises : " + String(config.knownWiFiCount));
    Serial.println(F("[READY] Acces stable via routeur : http://onair-moc.local"));
  }
  Serial.printf_P(PSTR("[MEMORY] ready heap=%u maxblock=%u stack=%u\n"),ESP.getFreeHeap(),ESP.getMaxFreeBlockSize(),ESP.getFreeContStack());
  // Start the cinematic clock only after blocking hardware/network setup.
  if(config.startupAnimation)startupAnimation();
}

void loop() {
  // Portail captif : traiter les requetes DNS avant le HTTP.
  if(!webMinimumHeap||ESP.getFreeHeap()<webMinimumHeap)webMinimumHeap=ESP.getFreeHeap();
  dnsServer.processNextRequest();

  // Le serveur HTTP est toujours prioritaire.
  server.handleClient();

  serviceFirmwareUpdate();
  if(otaReceiving||otaRestartAt){yield();return;}

  updateLibraryPreview();
  updateAlert();
  updateSettingsPreview();
  updateDirectMotion();
  updateWiFiScan();
  applyPendingExternalWiFi();

  updateStartupIndicatorNetworkState();
  updateExternalWiFi();
  updateStartupIndicator();

  if (mdnsStarted) {
    MDNS.update();
  }

  static unsigned long lastAPDiag = 0;
  if (millis() - lastAPDiag >= 15000UL) {
    lastAPDiag = millis();

    Serial.println(
      "[WIFI AP] Actif | IP=" + WiFi.softAPIP().toString() +
      " | clients=" + String(WiFi.softAPgetStationNum())
    );

    if (config.externalWiFiEnabled) {
      if (WiFi.status() == WL_CONNECTED) {
        Serial.println(
          "[WIFI EXT] CONNECTE | SSID=" + WiFi.SSID() +
          " | IP=" + WiFi.localIP().toString()
        );
      } else {
        Serial.println(F("[WIFI EXT] NON CONNECTE"));
      }
    }
  }

  yield();
}
